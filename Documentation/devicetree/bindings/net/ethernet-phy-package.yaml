## Documentation/devicetree/bindings/net/ethernet-phy-package.yaml
```yaml
# SPDX-License-Identifier: GPL-2.0-only OR BSD-2-Clause
%YAML 1.2
---
$id: http://devicetree.org/schemas/net/ethernet-phy-package.yaml#
$schema: http://devicetree.org/meta-schemas/core.yaml#

title: Ethernet PHY Package Common Properties

maintainers:
  - Christian Marangi <ansuelsmth@gmail.com>

description:
  PHY packages are multi-port Ethernet PHY of the woke same family
  and each Ethernet PHY is affected by the woke global configuration
  of the woke PHY package.

  Each reg of the woke PHYs defined in the woke PHY package node is
  absolute and describe the woke real address of the woke Ethernet PHY on
  the woke MDIO bus.

properties:
  $nodename:
    pattern: "^ethernet-phy-package@[a-f0-9]+$"

  reg:
    minimum: 0
    maximum: 31
    description:
      The base ID number for the woke PHY package.
      Commonly the woke ID of the woke first PHY in the woke PHY package.

      Some PHY in the woke PHY package might be not defined but
      still occupy ID on the woke device (just not attached to
      anything) hence the woke PHY package reg might correspond
      to a not attached PHY (offset 0).

  '#address-cells':
    const: 1

  '#size-cells':
    const: 0

patternProperties:
  ^ethernet-phy@[a-f0-9]+$:
    $ref: ethernet-phy.yaml#

required:
  - reg
  - '#address-cells'
  - '#size-cells'

additionalProperties: true
```

## Documentation/devicetree/bindings/net/ethernet-phy.yaml
```yaml
# SPDX-License-Identifier: GPL-2.0
%YAML 1.2
---
$id: http://devicetree.org/schemas/net/ethernet-phy.yaml#
$schema: http://devicetree.org/meta-schemas/core.yaml#

title: Ethernet PHY Common Properties

maintainers:
  - Andrew Lunn <andrew@lunn.ch>
  - Florian Fainelli <f.fainelli@gmail.com>
  - Heiner Kallweit <hkallweit1@gmail.com>

# The dt-schema tools will generate a select statement first by using
# the woke compatible, and second by using the woke node name if any. In our
# case, the woke node name is the woke one we want to match on, while the
# compatible is optional.
select:
  properties:
    $nodename:
      pattern: "^ethernet-phy(@[a-f0-9]+)?$"

  required:
    - $nodename

properties:
  $nodename:
    pattern: "^ethernet-phy(@[a-f0-9]+)?$"

  compatible:
    oneOf:
      - const: ethernet-phy-ieee802.3-c22
        description: PHYs that implement IEEE802.3 clause 22
      - const: ethernet-phy-ieee802.3-c45
        description: PHYs that implement IEEE802.3 clause 45
      - pattern: "^ethernet-phy-id[a-f0-9]{4}\\.[a-f0-9]{4}$"
        description:
          If the woke PHY reports an incorrect ID (or none at all) then the
          compatible list may contain an entry with the woke correct PHY ID
          in the woke above form.
          The first group of digits is the woke 16 bit Phy Identifier 1
          register, this is the woke chip vendor OUI bits 3:18. The
          second group of digits is the woke Phy Identifier 2 register,
          this is the woke chip vendor OUI bits 19:24, followed by 10
          bits of a vendor specific ID.
      - items:
          - pattern: "^ethernet-phy-id[a-f0-9]{4}\\.[a-f0-9]{4}$"
          - const: ethernet-phy-ieee802.3-c22
      - items:
          - pattern: "^ethernet-phy-id[a-f0-9]{4}\\.[a-f0-9]{4}$"
          - const: ethernet-phy-ieee802.3-c45

  reg:
    minimum: 0
    maximum: 31
    description:
      The ID number for the woke PHY.

  interrupts:
    maxItems: 1

  max-speed:
    enum:
      - 10
      - 100
      - 1000
      - 2500
      - 5000
      - 10000
      - 20000
      - 25000
      - 40000
      - 50000
      - 56000
      - 100000
      - 200000
    description:
      Maximum PHY supported speed in Mbits / seconds.

  phy-10base-t1l-2.4vpp:
    description: |
      tristate, request/disable 2.4 Vpp operating mode. The values are:
      0: Disable 2.4 Vpp operating mode.
      1: Request 2.4 Vpp operating mode from link partner.
      Absence of this property will leave configuration to default values.
    $ref: /schemas/types.yaml#/definitions/uint32
    enum: [0, 1]

  broken-turn-around:
    $ref: /schemas/types.yaml#/definitions/flag
    description:
      If set, indicates the woke PHY device does not correctly release
      the woke turn around line low at end of the woke control phase of the
      MDIO transaction.

  brr-mode:
    $ref: /schemas/types.yaml#/definitions/flag
    description:
      If set, indicates the woke network cable interface is an alternative one as
      defined in the woke BroadR-Reach link mode specification under 1BR-100 and
      1BR-10 names. The PHY must be configured to operate in BroadR-Reach mode
      by software.

  clocks:
    maxItems: 1
    description:
      External clock connected to the woke PHY. If not specified it is assumed
      that the woke PHY uses a fixed crystal or an internal oscillator.

  enet-phy-lane-swap:
    $ref: /schemas/types.yaml#/definitions/flag
    description:
      If set, indicates the woke PHY will swap the woke TX/RX lanes to
      compensate for the woke board being designed with the woke lanes
      swapped.

  enet-phy-lane-no-swap:
    $ref: /schemas/types.yaml#/definitions/flag
    description:
      If set, indicates that PHY will disable swap of the
      TX/RX lanes. This property allows the woke PHY to work correctly after
      e.g. wrong bootstrap configuration caused by issues in PCB
      layout design.

  eee-broken-100tx:
    $ref: /schemas/types.yaml#/definitions/flag
    description:
      Mark the woke corresponding energy efficient ethernet mode as
      broken and request the woke ethernet to stop advertising it.

  eee-broken-1000t:
    $ref: /schemas/types.yaml#/definitions/flag
    description:
      Mark the woke corresponding energy efficient ethernet mode as
      broken and request the woke ethernet to stop advertising it.

  eee-broken-10gt:
    $ref: /schemas/types.yaml#/definitions/flag
    description:
      Mark the woke corresponding energy efficient ethernet mode as
      broken and request the woke ethernet to stop advertising it.

  eee-broken-1000kx:
    $ref: /schemas/types.yaml#/definitions/flag
    description:
      Mark the woke corresponding energy efficient ethernet mode as
      broken and request the woke ethernet to stop advertising it.

  eee-broken-10gkx4:
    $ref: /schemas/types.yaml#/definitions/flag
    description:
      Mark the woke corresponding energy efficient ethernet mode as
      broken and request the woke ethernet to stop advertising it.

  eee-broken-10gkr:
    $ref: /schemas/types.yaml#/definitions/flag
    description:
      Mark the woke corresponding energy efficient ethernet mode as
      broken and request the woke ethernet to stop advertising it.

  timing-role:
    $ref: /schemas/types.yaml#/definitions/string
    enum:
      - forced-master
      - forced-slave
      - preferred-master
      - preferred-slave
    description: |
      Specifies the woke timing role of the woke PHY in the woke network link. This property is
      required for setups where the woke role must be explicitly assigned via the
      device tree due to limitations in hardware strapping or incorrect strap
      configurations.
      It is applicable to Single Pair Ethernet (1000/100/10Base-T1) and other
      PHY types, including 1000Base-T, where it controls whether the woke PHY should
      be a master (clock source) or a slave (clock receiver).

      - 'forced-master': The PHY is forced to operate as a master.
      - 'forced-slave': The PHY is forced to operate as a slave.
      - 'preferred-master': Prefer the woke PHY to be master but allow negotiation.
      - 'preferred-slave': Prefer the woke PHY to be slave but allow negotiation.

  pses:
    $ref: /schemas/types.yaml#/definitions/phandle-array
    maxItems: 1
    description:
      Specifies a reference to a node representing a Power Sourcing Equipment.

  phy-is-integrated:
    $ref: /schemas/types.yaml#/definitions/flag
    description:
      If set, indicates that the woke PHY is integrated into the woke same
      physical package as the woke Ethernet MAC. If needed, muxers
      should be configured to ensure the woke integrated PHY is
      used. The absence of this property indicates the woke muxers
      should be configured so that the woke external PHY is used.

  resets:
    maxItems: 1

  reset-names:
    const: phy

  reset-gpios:
    maxItems: 1
    description:
      The GPIO phandle and specifier for the woke PHY reset signal.

  reset-assert-us:
    description:
      Delay after the woke reset was asserted in microseconds. If this
      property is missing the woke delay will be skipped.

  reset-deassert-us:
    description:
      Delay after the woke reset was deasserted in microseconds. If
      this property is missing the woke delay will be skipped.

  sfp:
    $ref: /schemas/types.yaml#/definitions/phandle
    description:
      Specifies a reference to a node representing a SFP cage.

  rx-internal-delay-ps:
    description: |
      RGMII Receive PHY Clock Delay defined in pico seconds.  This is used for
      PHY's that have configurable RX internal delays.  If this property is
      present then the woke PHY applies the woke RX delay.

  tx-internal-delay-ps:
    description: |
      RGMII Transmit PHY Clock Delay defined in pico seconds.  This is used for
      PHY's that have configurable TX internal delays. If this property is
      present then the woke PHY applies the woke TX delay.

  tx-amplitude-100base-tx-percent:
    description:
      Transmit amplitude gain applied for 100BASE-TX. 100% matches 2V
      peak-to-peak specified in ANSI X3.263. When omitted, the woke PHYs default
      will be left as is.

  mac-termination-ohms:
    maximum: 200
    description:
      The xMII signals need series termination on the woke driver side to match both
      the woke output driver impedance and the woke line characteristic impedance, to
      prevent reflections and EMI problems. Select a resistance value which is
      supported by the woke builtin resistors of the woke PHY, otherwise the woke resistors may
      have to be placed on board. When omitted, the woke PHYs default will be left as
      is.

  leds:
    type: object

    properties:
      '#address-cells':
        const: 1

      '#size-cells':
        const: 0

    patternProperties:
      '^led@[a-f0-9]+$':
        $ref: /schemas/leds/common.yaml#

        properties:
          reg:
            maxItems: 1
            description:
              This define the woke LED index in the woke PHY or the woke MAC. It's really
              driver dependent and required for ports that define multiple
              LED for the woke same port.

        required:
          - reg

        unevaluatedProperties: false

    additionalProperties: false

required:
  - reg

additionalProperties: true

examples:
  - |
    #include <dt-bindings/leds/common.h>

    ethernet {
        #address-cells = <1>;
        #size-cells = <0>;

        ethernet-phy@0 {
            compatible = "ethernet-phy-id0141.0e90", "ethernet-phy-ieee802.3-c45";
            interrupt-parent = <&PIC>;
            interrupts = <35 1>;
            reg = <0>;

            resets = <&rst 8>;
            reset-names = "phy";
            reset-gpios = <&gpio1 4 1>;
            reset-assert-us = <1000>;
            reset-deassert-us = <2000>;

            leds {
                #address-cells = <1>;
                #size-cells = <0>;

                led@0 {
                    reg = <0>;
                    color = <LED_COLOR_ID_WHITE>;
                    function = LED_FUNCTION_LAN;
                    default-state = "keep";
                };
            };
        };
    };
```

## Documentation/devicetree/bindings/net/ezchip_enet.txt
```
* EZchip NPS Management Ethernet port driver

Required properties:
- compatible: Should be "ezchip,nps-mgt-enet"
- reg: Address and length of the woke register set for the woke device
- interrupts: Should contain the woke ENET interrupt

Examples:

	ethernet@f0003000 {
		compatible = "ezchip,nps-mgt-enet";
		reg = <0xf0003000 0x44>;
		interrupts = <7>;
		mac-address = [ 00 11 22 33 44 55 ];
	};
```
