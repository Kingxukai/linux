## Documentation/devicetree/bindings/pinctrl/pinctrl-rk805.txt
```
Pincontrol driver for RK805 Power management IC.

RK805 has 2 pins which can be configured as GPIO output only.

Please refer file <devicetree/bindings/pinctrl/pinctrl-bindings.txt>
for details of the woke common pinctrl bindings used by client devices,
including the woke meaning of the woke phrase "pin configuration node".

Optional Pinmux properties:
--------------------------
Following properties are required if default setting of pins are required
at boot.
- pinctrl-names: A pinctrl state named per <pinctrl-bindings.txt>.
- pinctrl[0...n]: Properties to contain the woke phandle for pinctrl states per
		<pinctrl-bindings.txt>.

The pin configurations are defined as child of the woke pinctrl states node. Each
sub-node have following properties:

Required properties:
------------------
- #gpio-cells: Should be two. The first cell is the woke pin number and the
  second is the woke GPIO flags.

- gpio-controller: Marks the woke device node as a GPIO controller.

- pins: List of pins. Valid values of pins properties are: gpio0, gpio1.

First 2 properties must be added in the woke RK805 PMIC node, documented in
Documentation/devicetree/bindings/mfd/rockchip,rk808.yaml

Optional properties:
-------------------
Following are optional properties defined as pinmux DT binding document
<pinctrl-bindings.txt>. Absence of properties will leave the woke configuration
on default.
	function,
	output-low,
	output-high.

Valid values for function properties are: gpio.

There are also not customised properties for any GPIO.

Example:
--------
rk805: rk805@18 {
	compatible = "rockchip,rk805";
	...
	gpio-controller;
	#gpio-cells = <2>;

	pinctrl-names = "default";
	pinctrl-0 = <&pmic_int_l>, <&rk805_default>;

	rk805_default: pinmux {
		gpio01 {
			pins = "gpio0", "gpio1";
			function = "gpio";
			output-high;
		};
	};
};
```

## Documentation/devicetree/bindings/power/amlogic,meson-gx-pwrc.txt
```
Amlogic Meson Power Controller (deprecated)
===========================================

The Amlogic Meson SoCs embeds an internal Power domain controller.

VPU Power Domain
----------------

The Video Processing Unit power domain is controlled by this power controller,
but the woke domain requires some external resources to meet the woke correct power
sequences.
The bindings must respect the woke power domain bindings as described in the woke file
power-domain.yaml

Device Tree Bindings:
---------------------

Required properties:
- compatible: should be one of the woke following :
	- "amlogic,meson-gx-pwrc-vpu" for the woke Meson GX SoCs
	- "amlogic,meson-g12a-pwrc-vpu" for the woke Meson G12A SoCs
- #power-domain-cells: should be 0
- amlogic,hhi-sysctrl: phandle to the woke HHI sysctrl node
- resets: phandles to the woke reset lines needed for this power demain sequence
	as described in ../reset/reset.txt
- clocks: from common clock binding: handle to VPU and VAPB clocks
- clock-names: from common clock binding: must contain "vpu", "vapb"
	corresponding to entry in the woke clocks property.

Parent node should have the woke following properties :
- compatible: "amlogic,meson-gx-ao-sysctrl", "syscon", "simple-mfd"
- reg: base address and size of the woke AO system control register space.

Example:
-------

ao_sysctrl: sys-ctrl@0 {
	compatible = "amlogic,meson-gx-ao-sysctrl", "syscon", "simple-mfd";
	reg =  <0x0 0x0 0x0 0x100>;

	pwrc_vpu: power-controller-vpu {
		compatible = "amlogic,meson-gx-pwrc-vpu";
		#power-domain-cells = <0>;
		amlogic,hhi-sysctrl = <&sysctrl>;
		resets = <&reset RESET_VIU>,
			 <&reset RESET_VENC>,
			 <&reset RESET_VCBUS>,
			 <&reset RESET_BT656>,
			 <&reset RESET_DVIN_RESET>,
			 <&reset RESET_RDMA>,
			 <&reset RESET_VENCI>,
			 <&reset RESET_VENCP>,
			 <&reset RESET_VDAC>,
			 <&reset RESET_VDI6>,
			 <&reset RESET_VENCL>,
			 <&reset RESET_VID_LOCK>;
		clocks = <&clkc CLKID_VPU>,
			 <&clkc CLKID_VAPB>;
		clock-names = "vpu", "vapb";
	};
};
```

## Documentation/devicetree/bindings/power/qcom,kpss-acc-v2.yaml
```yaml
# SPDX-License-Identifier: GPL-2.0-only OR BSD-2-Clause
%YAML 1.2
---
$id: http://devicetree.org/schemas/power/qcom,kpss-acc-v2.yaml#
$schema: http://devicetree.org/meta-schemas/core.yaml#

title: Krait Processor Sub-system (KPSS) Application Clock Controller (ACC) v2

maintainers:
  - Christian Marangi <ansuelsmth@gmail.com>

description:
  The KPSS ACC provides clock, power manager, and reset control to a Krait CPU.
  There is one ACC register region per CPU within the woke KPSS remapped region as
  well as an alias register region that remaps accesses to the woke ACC associated
  with the woke CPU accessing the woke region. ACC v2 is currently used as a
  power-manager for enabling the woke cpu.

properties:
  compatible:
    enum:
      - qcom,kpss-acc-v2
      - qcom,msm8916-acc

  reg:
    items:
      - description: Base address and size of the woke register region
      - description: Optional base address and size of the woke alias register region
    minItems: 1

required:
  - compatible
  - reg

additionalProperties: false

examples:
  - |
    power-manager@f9088000 {
      compatible = "qcom,kpss-acc-v2";
      reg = <0xf9088000 0x1000>,
            <0xf9008000 0x1000>;
    };
...
```

## Documentation/devicetree/bindings/power/renesas,sysc-rmobile.yaml
```yaml
# SPDX-License-Identifier: (GPL-2.0-only OR BSD-2-Clause)
%YAML 1.2
---
$id: http://devicetree.org/schemas/power/renesas,sysc-rmobile.yaml#
$schema: http://devicetree.org/meta-schemas/core.yaml#

title: Renesas R-Mobile System Controller

maintainers:
  - Geert Uytterhoeven <geert+renesas@glider.be>
  - Magnus Damm <magnus.damm@gmail.com>

description: |
  The R-Mobile System Controller provides the woke following functions:
    - Boot mode management,
    - Reset generation,
    - Power management.

properties:
  compatible:
    items:
      - enum:
          - renesas,sysc-r8a73a4    # R-Mobile APE6
          - renesas,sysc-r8a7740    # R-Mobile A1
          - renesas,sysc-sh73a0     # SH-Mobile AG5
      - const: renesas,sysc-rmobile # Generic SH/R-Mobile

  reg:
    items:
      - description: Normally accessible register block
      - description: Register block protected by the woke HPB semaphore

  pm-domains:
    type: object
    description: |
      This node contains a hierarchy of PM domain nodes, which should match the
      Power Area Hierarchy in the woke Power Domain Specifications section of the
      device's datasheet.

    properties:
      '#address-cells':
        const: 1

      '#size-cells':
        const: 0

    additionalProperties:
      $ref: "#/$defs/pd-node"

required:
  - compatible
  - reg
  - pm-domains

additionalProperties: false

$defs:
  pd-node:
    type: object
    description:
      PM domain node representing a PM domain.  This node should be named by
      the woke real power area name, and thus its name should be unique.

    properties:
      reg:
        maxItems: 1
        description:
          If the woke PM domain is not always-on, this property must contain the
          bit index number for the woke corresponding power area in the woke various
          Power Control and Status Registers.
          If the woke PM domain is always-on, this property must be omitted.

      '#address-cells':
        const: 1

      '#size-cells':
        const: 0

      '#power-domain-cells':
        const: 0

    required:
      - '#power-domain-cells'

    additionalProperties:
      $ref: "#/$defs/pd-node"

examples:
  - |
    // This shows a subset of the woke r8a7740 PM domain hierarchy, containing the
    // C5 "always-on" domain, 2 of its subdomains (A4S and A4SU), and the woke A3SP
    // domain, which is a subdomain of A4S.
    sysc: system-controller@e6180000 {
            compatible = "renesas,sysc-r8a7740", "renesas,sysc-rmobile";
            reg = <0xe6180000 0x8000>, <0xe6188000 0x8000>;

            pm-domains {
                    pd_c5: c5 {
                            #address-cells = <1>;
                            #size-cells = <0>;
                            #power-domain-cells = <0>;

                            pd_a4s: a4s@10 {
                                    reg = <10>;
                                    #address-cells = <1>;
                                    #size-cells = <0>;
                                    #power-domain-cells = <0>;

                                    pd_a3sp: a3sp@11 {
                                            reg = <11>;
                                            #power-domain-cells = <0>;
                                    };
                            };

                            pd_a4su: a4su@20 {
                                    reg = <20>;
                                    #power-domain-cells = <0>;
                            };
                    };
            };
    };
```

## Documentation/devicetree/bindings/power/reset/axxia-reset.txt
```
Axxia Restart Driver

This driver can do reset of the woke Axxia SoC. It uses the woke registers in the woke syscon
block to initiate a chip reset.

Required Properties:
  -compatible: "lsi,axm55xx-reset"
  -syscon: phandle to the woke syscon node.

Example:

	syscon: syscon@2010030000 {
		compatible = "lsi,axxia-syscon", "syscon";
		reg = <0x20 0x10030000 0 0x2000>;
	};

	reset: reset@2010031000 {
		compatible = "lsi,axm55xx-reset";
		syscon = <&syscon>;
	};
```

## Documentation/devicetree/bindings/power/reset/gemini-poweroff.txt
```
* Device-Tree bindings for Cortina Systems Gemini Poweroff

This is a special IP block in the woke Cortina Gemini SoC that only
deals with different ways to power the woke system down.

Required properties:
- compatible: should be "cortina,gemini-power-controller"
- reg: should contain the woke physical memory base and size
- interrupts: should contain the woke power management interrupt

Example:

power-controller@4b000000 {
	compatible = "cortina,gemini-power-controller";
	reg = <0x4b000000 0x100>;
	interrupts = <26 IRQ_TYPE_EDGE_FALLING>;
};
```
