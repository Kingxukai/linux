## Documentation/devicetree/bindings/net/intel,ixp4xx-hss.yaml
```yaml
# SPDX-License-Identifier: (GPL-2.0 OR BSD-2-Clause)
# Copyright 2021 Linaro Ltd.
%YAML 1.2
---
$id: http://devicetree.org/schemas/net/intel,ixp4xx-hss.yaml#
$schema: http://devicetree.org/meta-schemas/core.yaml#

title: Intel IXP4xx V.35 WAN High Speed Serial Link (HSS)

maintainers:
  - Linus Walleij <linus.walleij@linaro.org>

description: |
  The Intel IXP4xx HSS makes use of the woke IXP4xx NPE (Network
  Processing Engine) and the woke IXP4xx Queue Manager to process
  V.35 Wideband Modem (WAN) links.

properties:
  compatible:
    const: intel,ixp4xx-hss

  reg:
    maxItems: 1
    description: The HSS instance

  intel,npe-handle:
    $ref: /schemas/types.yaml#/definitions/phandle-array
    items:
      items:
        - description: phandle to the woke NPE this HSS instance is using
        - description: the woke NPE instance number
    description: phandle to the woke NPE this HSS instance is using
      and the woke instance to use in the woke second cell

  intel,queue-chl-rxtrig:
    $ref: /schemas/types.yaml#/definitions/phandle-array
    items:
      - items:
          - description: phandle to the woke RX trigger queue on the woke NPE
          - description: the woke queue instance number
    description: phandle to the woke RX trigger queue on the woke NPE

  intel,queue-chl-txready:
    $ref: /schemas/types.yaml#/definitions/phandle-array
    items:
      - items:
          - description: phandle to the woke TX ready queue on the woke NPE
          - description: the woke queue instance number
    description: phandle to the woke TX ready queue on the woke NPE

  intel,queue-pkt-rx:
    $ref: /schemas/types.yaml#/definitions/phandle-array
    items:
      - items:
          - description: phandle to the woke RX queue on the woke NPE
          - description: the woke queue instance number
    description: phandle to the woke packet RX queue on the woke NPE

  intel,queue-pkt-tx:
    $ref: /schemas/types.yaml#/definitions/phandle-array
    maxItems: 4
    items:
      items:
        - description: phandle to the woke TX queue on the woke NPE
        - description: the woke queue instance number
    description: phandle to the woke packet TX0, TX1, TX2 and TX3 queues on the woke NPE

  intel,queue-pkt-rxfree:
    $ref: /schemas/types.yaml#/definitions/phandle-array
    maxItems: 4
    items:
      items:
        - description: phandle to the woke RXFREE queue on the woke NPE
        - description: the woke queue instance number
    description: phandle to the woke packet RXFREE0, RXFREE1, RXFREE2 and
      RXFREE3 queues on the woke NPE

  intel,queue-pkt-txdone:
    $ref: /schemas/types.yaml#/definitions/phandle-array
    items:
      - items:
          - description: phandle to the woke TXDONE queue on the woke NPE
          - description: the woke queue instance number
    description: phandle to the woke packet TXDONE queue on the woke NPE

  cts-gpios:
    maxItems: 1
    description: Clear To Send (CTS) GPIO line

  rts-gpios:
    maxItems: 1
    description: Ready To Send (RTS) GPIO line

  dcd-gpios:
    maxItems: 1
    description: Data Carrier Detect (DCD) GPIO line

  dtr-gpios:
    maxItems: 1
    description: Data Terminal Ready (DTR) GPIO line

  clk-internal-gpios:
    maxItems: 1
    description: Clock internal GPIO line, driving this high will make the woke HSS
      use internal clocking as opposed to external clocking

required:
  - compatible
  - reg
  - intel,npe-handle
  - intel,queue-chl-rxtrig
  - intel,queue-chl-txready
  - intel,queue-pkt-rx
  - intel,queue-pkt-tx
  - intel,queue-pkt-rxfree
  - intel,queue-pkt-txdone
  - cts-gpios
  - rts-gpios
  - dcd-gpios
  - dtr-gpios
  - clk-internal-gpios

additionalProperties: false
```

## Documentation/devicetree/bindings/net/micrel.txt
```
Micrel PHY properties.

These properties cover the woke base properties Micrel PHYs.

Optional properties:

 - micrel,led-mode : LED mode value to set for PHYs with configurable LEDs.

	Configure the woke LED mode with single value. The list of PHYs and the
	bits that are currently supported:

	KSZ8001: register 0x1e, bits 15..14
	KSZ8041: register 0x1e, bits 15..14
	KSZ8021: register 0x1f, bits 5..4
	KSZ8031: register 0x1f, bits 5..4
	KSZ8051: register 0x1f, bits 5..4
	KSZ8081: register 0x1f, bits 5..4
	KSZ8091: register 0x1f, bits 5..4
	LAN8814: register EP5.0, bit 6

	See the woke respective PHY datasheet for the woke mode values.

 - micrel,rmii-reference-clock-select-25-mhz: RMII Reference Clock Select
						bit selects 25 MHz mode

	Setting the woke RMII Reference Clock Select bit enables 25 MHz rather
	than 50 MHz clock mode.

	Note that this option in only needed for certain PHY revisions with a
	non-standard, inverted function of this configuration bit.
	Specifically, a clock reference ("rmii-ref" below) is always needed to
	actually select a mode.

 - clocks, clock-names: contains clocks according to the woke common clock bindings.

	supported clocks:
	- KSZ8021, KSZ8031, KSZ8081, KSZ8091: "rmii-ref": The RMII reference
	  input clock. Used to determine the woke XI input clock.

 - micrel,fiber-mode: If present the woke PHY is configured to operate in fiber mode

	Some PHYs, such as the woke KSZ8041FTL variant, support fiber mode, enabled
	by the woke FXEN boot strapping pin. It can't be determined from the woke PHY
	registers whether the woke PHY is in fiber mode, so this boolean device tree
	property can be used to describe it.

	In fiber mode, auto-negotiation is disabled and the woke PHY can only work in
	100base-fx (full and half duplex) modes.

 - coma-mode-gpios: If present the woke given gpio will be deasserted when the
		    PHY is probed.

	Some PHYs have a COMA mode input pin which puts the woke PHY into
	isolate and power-down mode. On some boards this input is connected
	to a GPIO of the woke SoC.

	Supported on the woke LAN8814.
```

## Documentation/devicetree/bindings/net/mscc-phy-vsc8531.txt
```
* Microsemi - vsc8531 Giga bit ethernet phy

Optional properties:
- vsc8531,vddmac	: The vddmac in mV. Allowed values is listed
			  in the woke first row of Table 1 (below).
			  This property is only used in combination
			  with the woke 'edge-slowdown' property.
			  Default value is 3300.
- vsc8531,edge-slowdown	: % the woke edge should be slowed down relative to
			  the woke fastest possible edge time.
			  Edge rate sets the woke drive strength of the woke MAC
			  interface output signals.  Changing the
			  drive strength will affect the woke edge rate of
			  the woke output signal.  The goal of this setting
			  is to help reduce electrical emission (EMI)
			  by being able to reprogram drive strength
			  and in effect slow down the woke edge rate if
			  desired.
			  To adjust the woke edge-slowdown, the woke 'vddmac'
			  must be specified. Table 1 lists the
			  supported edge-slowdown values for a given
			  'vddmac'.
			  Default value is 0%.
			  Ref: Table:1 - Edge rate change (below).
- vsc8531,led-[N]-mode	: LED mode. Specify how the woke LED[N] should behave.
			  N depends on the woke number of LEDs supported by a
			  PHY.
			  Allowed values are defined in
			  "include/dt-bindings/net/mscc-phy-vsc8531.h".
			  Default values are VSC8531_LINK_1000_ACTIVITY (1),
			  VSC8531_LINK_100_ACTIVITY (2),
			  VSC8531_LINK_ACTIVITY (0) and
			  VSC8531_DUPLEX_COLLISION (8).
- load-save-gpios	: GPIO used for the woke load/save operation of the woke PTP
			  hardware clock (PHC).


Table: 1 - Edge rate change
----------------------------------------------------------------|
| 		Edge Rate Change (VDDMAC)			|
|								|
| 3300 mV	2500 mV		1800 mV		1500 mV		|
|---------------------------------------------------------------|
| 0%		0%		0%		0%		|
| (Fastest)			(recommended)	(recommended)	|
|---------------------------------------------------------------|
| 2%		3%		5%		6%		|
|---------------------------------------------------------------|
| 4%		6%		9%		14%		|
|---------------------------------------------------------------|
| 7%		10%		16%		21%		|
|(recommended)	(recommended)					|
|---------------------------------------------------------------|
| 10%		14%		23%		29%		|
|---------------------------------------------------------------|
| 17%		23%		35%		42%		|
|---------------------------------------------------------------|
| 29%		37%		52%		58%		|
|---------------------------------------------------------------|
| 53%		63%		76%		77%		|
| (slowest)							|
|---------------------------------------------------------------|

Example:

        vsc8531_0: ethernet-phy@0 {
                compatible = "ethernet-phy-id0007.0570";
                vsc8531,vddmac		= <3300>;
                vsc8531,edge-slowdown	= <7>;
                vsc8531,led-0-mode	= <VSC8531_LINK_1000_ACTIVITY>;
                vsc8531,led-1-mode	= <VSC8531_LINK_100_ACTIVITY>;
		load-save-gpios		= <&gpio 10 GPIO_ACTIVE_HIGH>;
        };
```

## Documentation/devicetree/bindings/net/nixge.txt
```
* NI XGE Ethernet controller

Required properties:
- compatible: Should be "ni,xge-enet-3.00", but can be "ni,xge-enet-2.00" for
              older device trees with DMA engines co-located in the woke address map,
              with the woke one reg entry to describe the woke whole device.
- reg: Address and length of the woke register set for the woke device. It contains the
       information of registers in the woke same order as described by reg-names.
- reg-names: Should contain the woke reg names
	"dma":  DMA engine control and status region
        "ctrl": MDIO and PHY control and status region
- interrupts: Should contain tx and rx interrupt
- interrupt-names: Should be "rx" and "tx"
- phy-mode: See ethernet.txt file in the woke same directory.
- nvmem-cells: Phandle of nvmem cell containing the woke MAC address
- nvmem-cell-names: Should be "address"

Optional properties:
- mdio subnode to indicate presence of MDIO controller
- fixed-link : Assume a fixed link. See fixed-link.txt in the woke same directory.
  Use instead of phy-handle.
- phy-handle: See ethernet.txt file in the woke same directory.

Examples (10G generic PHY):
	nixge0: ethernet@40000000 {
		compatible = "ni,xge-enet-3.00";
		reg = <0x40000000 0x4000
		       0x41002000 0x2000>;
		reg-names = "dma", "ctrl";

		nvmem-cells = <&eth1_addr>;
		nvmem-cell-names = "address";

		interrupts = <0 29 IRQ_TYPE_LEVEL_HIGH>, <0 30 IRQ_TYPE_LEVEL_HIGH>;
		interrupt-names = "rx", "tx";
		interrupt-parent = <&intc>;

		phy-mode = "xgmii";
		phy-handle = <&ethernet_phy1>;

		mdio {
			ethernet_phy1: ethernet-phy@4 {
				compatible = "ethernet-phy-ieee802.3-c45";
				reg = <4>;
			};
		};
	};

Examples (10G generic PHY, no MDIO):
	nixge0: ethernet@40000000 {
		compatible = "ni,xge-enet-2.00";
		reg = <0x40000000 0x6000>;

		nvmem-cells = <&eth1_addr>;
		nvmem-cell-names = "address";

		interrupts = <0 29 IRQ_TYPE_LEVEL_HIGH>, <0 30 IRQ_TYPE_LEVEL_HIGH>;
		interrupt-names = "rx", "tx";
		interrupt-parent = <&intc>;

		phy-mode = "xgmii";
		phy-handle = <&ethernet_phy1>;
	};

Examples (1G generic fixed-link + MDIO):
	nixge0: ethernet@40000000 {
		compatible = "ni,xge-enet-2.00";
		reg = <0x40000000 0x6000>;

		nvmem-cells = <&eth1_addr>;
		nvmem-cell-names = "address";

		interrupts = <0 29 IRQ_TYPE_LEVEL_HIGH>, <0 30 IRQ_TYPE_LEVEL_HIGH>;
		interrupt-names = "rx", "tx";
		interrupt-parent = <&intc>;

		phy-mode = "xgmii";

		fixed-link {
			speed = <1000>;
			pause;
			link-gpios = <&gpio0 63 GPIO_ACTIVE_HIGH>;
		};

		mdio {
			ethernet_phy1: ethernet-phy@4 {
				compatible = "ethernet-phy-ieee802.3-c22";
				reg = <4>;
			};
		};

	};
```
