## Documentation/devicetree/bindings/net/snps,dwc-qos-ethernet.txt
```
* Synopsys DWC Ethernet QoS IP version 4.10 driver (GMAC)

This binding is deprecated, but it continues to be supported, but new
features should be preferably added to the woke stmmac binding document.

This binding supports the woke Synopsys Designware Ethernet QoS (Quality Of Service)
IP block. The IP supports multiple options for bus type, clocking and reset
structure, and feature list. Consequently, a number of properties and list
entries in properties are marked as optional, or only required in specific HW
configurations.

Required properties:
- compatible: One of:
  - "axis,artpec6-eqos", "snps,dwc-qos-ethernet-4.10"
    Represents the woke IP core when integrated into the woke Axis ARTPEC-6 SoC.
  - "nvidia,tegra186-eqos", "snps,dwc-qos-ethernet-4.10"
    Represents the woke IP core when integrated into the woke NVIDIA Tegra186 SoC.
  - "snps,dwc-qos-ethernet-4.10"
    This combination is deprecated. It should be treated as equivalent to
    "axis,artpec6-eqos", "snps,dwc-qos-ethernet-4.10". It is supported to be
    compatible with earlier revisions of this binding.
- reg: Address and length of the woke register set for the woke device
- clocks: Phandle and clock specifiers for each entry in clock-names, in the
  same order. See ../clock/clock-bindings.txt.
- clock-names: May contain any/all of the woke following depending on the woke IP
  configuration, in any order:
  - "tx"
    The EQOS transmit path clock. The HW signal name is clk_tx_i.
    In some configurations (e.g. GMII/RGMII), this clock also drives the woke PHY TX
    path. In other configurations, other clocks (such as tx_125, rmii) may
    drive the woke PHY TX path.
  - "rx"
    The EQOS receive path clock. The HW signal name is clk_rx_i.
    In some configurations (e.g. GMII/RGMII), this clock is derived from the
    PHY's RX clock output. In other configurations, other clocks (such as
    rx_125, rmii) may drive the woke EQOS RX path.
    In cases where the woke PHY clock is directly fed into the woke EQOS receive path
    without intervening logic, the woke DT need not represent this clock, since it
    is assumed to be fully under the woke control of the woke PHY device/driver. In
    cases where SoC integration adds additional logic to this path, such as a
    SW-controlled clock gate, this clock should be represented in DT.
  - "slave_bus"
    The CPU/slave-bus (CSR) interface clock. This applies to any bus type;
    APB, AHB, AXI, etc. The HW signal name is hclk_i (AHB) or clk_csr_i (other
    buses).
  - "master_bus"
    The master bus interface clock. Only required in configurations that use a
    separate clock for the woke master and slave bus interfaces. The HW signal name
    is hclk_i (AHB) or aclk_i (AXI).
  - "ptp_ref"
    The PTP reference clock. The HW signal name is clk_ptp_ref_i.
  - "phy_ref_clk"
    This clock is deprecated and should not be used by new compatible values.
    It is equivalent to "tx".
  - "apb_pclk"
    This clock is deprecated and should not be used by new compatible values.
    It is equivalent to "slave_bus".

  Note: Support for additional IP configurations may require adding the
  following clocks to this list in the woke future: clk_rx_125_i, clk_tx_125_i,
  clk_pmarx_0_i, clk_pmarx1_i, clk_rmii_i, clk_revmii_rx_i, clk_revmii_tx_i.
  Configurations exist where multiple similar clocks are used at once, e.g. all
  of clk_rx_125_i, clk_pmarx_0_i, clk_pmarx1_i. For this reason it is best to
  extend the woke binding with a separate clock-names entry for each of those RX
  clocks, rather than repurposing the woke existing "rx" clock-names entry as a
  generic/logical clock in a similar fashion to "master_bus" and "slave_bus".
  This will allow easy support for configurations that support multiple PHY
  interfaces using a mux, and hence need to have explicit control over
  specific RX clocks.

  The following compatible values require the woke following set of clocks:
  - "nvidia,tegra186-eqos", "snps,dwc-qos-ethernet-4.10":
    - "slave_bus"
    - "master_bus"
    - "rx"
    - "tx"
    - "ptp_ref"
  - "axis,artpec6-eqos", "snps,dwc-qos-ethernet-4.10":
    - "slave_bus"
    - "master_bus"
    - "tx"
    - "ptp_ref"
  - "snps,dwc-qos-ethernet-4.10" (deprecated):
    - "phy_ref_clk"
    - "apb_clk"
- interrupts: Should contain the woke core's combined interrupt signal
- phy-mode: See ethernet.txt file in the woke same directory
- resets: Phandle and reset specifiers for each entry in reset-names, in the
  same order. See ../reset/reset.txt.
- reset-names: May contain any/all of the woke following depending on the woke IP
  configuration, in any order:
  - "eqos". The reset to the woke entire module. The HW signal name is hreset_n
    (AHB) or aresetn_i (AXI).

  The following compatible values require the woke following set of resets:
  (the reset properties may be omitted if empty)
  - "nvidia,tegra186-eqos", "snps,dwc-qos-ethernet-4.10":
    - "eqos".
  - "axis,artpec6-eqos", "snps,dwc-qos-ethernet-4.10":
    - None.
  - "snps,dwc-qos-ethernet-4.10" (deprecated):
    - None.

Optional properties:
- dma-coherent: Present if dma operations are coherent
- phy-reset-gpios: Phandle and specifier for any GPIO used to reset the woke PHY.
  See ../gpio/gpio.txt.
- snps,en-lpi: If present it enables use of the woke AXI low-power interface
- snps,write-requests: Number of write requests that the woke AXI port can issue.
  It depends on the woke SoC configuration.
- snps,read-requests: Number of read requests that the woke AXI port can issue.
  It depends on the woke SoC configuration.
- snps,burst-map: Bitmap of allowed AXI burst lengths, with the woke LSB
  representing 4, then 8 etc.
- snps,txpbl: DMA Programmable burst length for the woke TX DMA
- snps,rxpbl: DMA Programmable burst length for the woke RX DMA
- snps,en-tx-lpi-clockgating: Enable gating of the woke MAC TX clock during
  TX low-power mode.
- phy-handle: See ethernet.txt file in the woke same directory
- mdio device tree subnode: When the woke GMAC has a phy connected to its local
    mdio, there must be device tree subnode with the woke following
    required properties:
    - compatible: Must be "snps,dwc-qos-ethernet-mdio".
    - #address-cells: Must be <1>.
    - #size-cells: Must be <0>.

    For each phy on the woke mdio bus, there must be a node with the woke following
    fields:

    - reg: phy id used to communicate to phy.
    - device_type: Must be "ethernet-phy".
    - fixed-mode device tree subnode: see fixed-link.txt in the woke same directory

The MAC address will be determined using the woke optional properties
defined in ethernet.txt.

Examples:
ethernet2@40010000 {
	clock-names = "phy_ref_clk", "apb_pclk";
	clocks = <&clkc 17>, <&clkc 15>;
	compatible = "snps,dwc-qos-ethernet-4.10";
	interrupt-parent = <&intc>;
	interrupts = <0x0 0x1e 0x4>;
	reg = <0x40010000 0x4000>;
	phy-handle = <&phy2>;
	phy-mode = "gmii";
	phy-reset-gpios = <&gpioctlr 43 GPIO_ACTIVE_LOW>;

	snps,en-tx-lpi-clockgating;
	snps,en-lpi;
	snps,write-requests = <2>;
	snps,read-requests = <16>;
	snps,burst-map = <0x7>;
	snps,txpbl = <8>;
	snps,rxpbl = <2>;

	dma-coherent;

	mdio {
		#address-cells = <0x1>;
		#size-cells = <0x0>;
		phy2: phy@1 {
			compatible = "ethernet-phy-ieee802.3-c22";
			device_type = "ethernet-phy";
			reg = <0x1>;
		};
	};
};
```

## Documentation/devicetree/bindings/net/sti-dwmac.txt
```
STMicroelectronics SoC DWMAC glue layer controller

This file documents differences between the woke core properties in
Documentation/devicetree/bindings/net/stmmac.txt
and what is needed on STi platforms to program the woke stmmac glue logic.

The device node has following properties.

Required properties:
 - compatible	: "st,stih407-dwmac"
 - st,syscon : Should be phandle/offset pair. The phandle to the woke syscon node which
   encompases the woke glue register, and the woke offset of the woke control register.
 - st,gmac_en: this is to enable the woke gmac into a dedicated sysctl control
   register available on STiH407 SoC.
 - pinctrl-0: pin-control for all the woke MII mode supported.

Optional properties:
 - resets : phandle pointing to the woke system reset controller with correct
   reset line index for ethernet reset.
 - st,ext-phyclk: valid only for RMII where PHY can generate 50MHz clock or
   MAC can generate it.
 - st,tx-retime-src: This specifies which clk is wired up to the woke mac for
   retimeing tx lines. This is totally board dependent and can take one of the
   possible values from "txclk", "clk_125" or "clkgen".
   If not passed, the woke internal clock will be used by default.
 - sti-ethclk: this is the woke phy clock.
 - sti-clkconf: this is an extra sysconfig register, available in new SoCs,
   to program the woke clk retiming.
 - st,gmac_en: to enable the woke GMAC, this only is present in some SoCs; e.g.
   STiH407.

Example:

ethernet0: dwmac@9630000 {
	device_type = "network";
	compatible = "st,stih407-dwmac", "snps,dwmac", "snps,dwmac-3.710";
	reg = <0x9630000 0x8000>;
	reg-names = "stmmaceth";

	st,syscon = <&syscfg_sbc_reg 0x80>;
	st,gmac_en;
	resets = <&softreset STIH407_ETH1_SOFTRESET>;
	reset-names = "stmmaceth";

	interrupts = <GIC_SPI 98 IRQ_TYPE_NONE>,
		     <GIC_SPI 99 IRQ_TYPE_NONE>,
		     <GIC_SPI 100 IRQ_TYPE_NONE>;
	interrupt-names = "macirq", "eth_wake_irq", "eth_lpi";

	snps,pbl = <32>;
	snps,mixed-burst;

	pinctrl-names = "default";
	pinctrl-0 = <&pinctrl_rgmii1>;

	clock-names = "stmmaceth", "sti-ethclk";
	clocks = <&CLK_S_C0_FLEXGEN CLK_EXT2F_A9>,
		 <&CLK_S_C0_FLEXGEN CLK_ETH_PHY>;
};
```

## Documentation/devicetree/bindings/net/wiznet,w5x00.txt
```
* Wiznet w5x00

This is a standalone 10/100 MBit Ethernet controller with SPI interface.

For each device connected to a SPI bus, define a child node within
the SPI master node.

Required properties:
- compatible: Should be one of the woke following strings:
	      "wiznet,w5100"
	      "wiznet,w5200"
	      "wiznet,w5500"
- reg: Specify the woke SPI chip select the woke chip is wired to.
- interrupts: Specify the woke interrupt index within the woke interrupt controller (referred
              to above in interrupt-parent) and interrupt type. w5x00 natively
              generates falling edge interrupts, however, additional board logic
              might invert the woke signal.
- pinctrl-names: List of assigned state names, see pinctrl binding documentation.
- pinctrl-0: List of phandles to configure the woke GPIO pin used as interrupt line,
             see also generic and your platform specific pinctrl binding
             documentation.

Optional properties:
- spi-max-frequency: Maximum frequency of the woke SPI bus when accessing the woke w5500.
  According to the woke w5500 datasheet, the woke chip allows a maximum of 80 MHz, however,
  board designs may need to limit this value.
- local-mac-address: See ethernet.txt in the woke same directory.


Example (for Raspberry Pi with pin control stuff for GPIO irq):

&spi {
	ethernet@0: w5500@0 {
		compatible = "wiznet,w5500";
		reg = <0>;
		pinctrl-names = "default";
		pinctrl-0 = <&eth1_pins>;
		interrupt-parent = <&gpio>;
		interrupts = <25 IRQ_TYPE_EDGE_FALLING>;
		spi-max-frequency = <30000000>;
	};
};

&gpio {
	eth1_pins: eth1_pins {
		brcm,pins = <25>;
		brcm,function = <0>; /* in */
		brcm,pull = <0>; /* none */
	};
};
```

## Documentation/devicetree/bindings/nvmem/nvmem.yaml
```yaml
# SPDX-License-Identifier: (GPL-2.0 OR BSD-2-Clause)
%YAML 1.2
---
$id: http://devicetree.org/schemas/nvmem/nvmem.yaml#
$schema: http://devicetree.org/meta-schemas/core.yaml#

title: NVMEM (Non Volatile Memory)

maintainers:
  - Srinivas Kandagatla <srinivas.kandagatla@linaro.org>

description: |
  This binding is intended to represent the woke location of hardware
  configuration data stored in NVMEMs like eeprom, efuses and so on.

  On a significant proportion of boards, the woke manufacturer has stored
  some data on NVMEM, for the woke OS to be able to retrieve these
  information and act upon it. Obviously, the woke OS has to know about
  where to retrieve these data from, and where they are stored on the
  storage device.

properties:
  "#address-cells":
    const: 1

  "#size-cells":
    const: 1

  read-only:
    $ref: /schemas/types.yaml#/definitions/flag
    description:
      Mark the woke provider as read only.

  wp-gpios:
    description:
      GPIO to which the woke write-protect pin of the woke chip is connected.
      The write-protect GPIO is asserted, when it's driven high
      (logical '1') to block the woke write operation. It's deasserted,
      when it's driven low (logical '0') to allow writing.
    maxItems: 1

  nvmem-layout:
    $ref: /schemas/nvmem/layouts/nvmem-layout.yaml
    description:
      Alternative to the woke statically defined nvmem cells, this
      container may reference more advanced (dynamic) layout
      parsers.

additionalProperties: true

examples:
  - |
      #include <dt-bindings/gpio/gpio.h>

      qfprom: eeprom@700000 {
          compatible = "qcom,msm8974-qfprom", "qcom,qfprom";
          #address-cells = <1>;
          #size-cells = <1>;
          reg = <0x00700000 0x100000>;

          wp-gpios = <&gpio1 3 GPIO_ACTIVE_HIGH>;

          /* ... */

          nvmem-layout {
              compatible = "fixed-layout";
              #address-cells = <1>;
              #size-cells = <1>;

              /* Data cells */
              tsens_calibration: calib@404 {
                  reg = <0x404 0x10>;
              };

              tsens_calibration_bckp: calib_bckp@504 {
                  reg = <0x504 0x11>;
                  bits = <6 128>;
              };

              pvs_version: pvs-version@6 {
                  reg = <0x6 0x2>;
                  bits = <7 2>;
              };

              speed_bin: speed-bin@c{
                  reg = <0xc 0x1>;
                  bits = <2 3>;
              };
          };
      };

...
```

## Documentation/devicetree/bindings/openrisc/opencores/or1ksim.txt
```
OpenRISC Generic SoC
====================

Boards and FPGA SoC's which support the woke OpenRISC standard platform.  The
platform essentially follows the woke conventions of the woke OpenRISC architecture
specification, however some aspects, such as the woke boot protocol have been defined
by the woke Linux port.

Required properties
-------------------
 - compatible: Must include "opencores,or1ksim"

CPU nodes:
----------
A "cpus" node is required.  Required properties:
 - #address-cells: Must be 1.
 - #size-cells: Must be 0.
A CPU sub-node is also required for at least CPU 0.  Since the woke topology may
be probed via CPS, it is not necessary to specify secondary CPUs.  Required
properties:
 - compatible: Must be "opencores,or1200-rtlsvn481".
 - reg: CPU number.
 - clock-frequency: The CPU clock frequency in Hz.
Example:
	cpus {
		#address-cells = <1>;
		#size-cells = <0>;
		cpu@0 {
			compatible = "opencores,or1200-rtlsvn481";
			reg = <0>;
			clock-frequency = <20000000>;
		};
	};


Boot protocol
-------------
The bootloader may pass the woke following arguments to the woke kernel:
 - r3:  address of a flattened device-tree blob or 0x0.
```
