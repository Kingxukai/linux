## Documentation/devicetree/bindings/opp/operating-points-v2-ti-cpu.yaml
```yaml
# SPDX-License-Identifier: (GPL-2.0-only OR BSD-2-Clause)
%YAML 1.2
---
$id: http://devicetree.org/schemas/opp/operating-points-v2-ti-cpu.yaml#
$schema: http://devicetree.org/meta-schemas/core.yaml#

title: TI CPU OPP (Operating Performance Points)

description:
  TI SoCs, like those in the woke AM335x, AM437x, AM57xx, AM62x, and DRA7xx
  families, the woke CPU frequencies subset and the woke voltage value of each
  OPP vary based on the woke silicon variant used. The data sheet sections
  corresponding to "Operating Performance Points" describe the woke frequency
  and voltage values based on device type and speed bin information
  blown in corresponding eFuse bits as referred to by the woke Technical
  Reference Manual.

  This document extends the woke operating-points-v2 binding by providing
  the woke hardware description for the woke scheme mentioned above.

maintainers:
  - Dhruva Gole <d-gole@ti.com>

allOf:
  - $ref: opp-v2-base.yaml#

properties:
  compatible:
    const: operating-points-v2-ti-cpu

  syscon:
    $ref: /schemas/types.yaml#/definitions/phandle
    description: |
      points to syscon node representing the woke control module
      register space of the woke SoC.

  opp-shared: true

patternProperties:
  '^opp(-?[0-9]+)*$':
    type: object
    additionalProperties: false

    properties:
      clock-latency-ns: true
      opp-hz: true
      opp-microvolt: true
      opp-supported-hw:
        items:
          items:
            - description:
                The revision of the woke SoC the woke OPP is supported by.
                This can be easily obtained from the woke datasheet of the
                part being ordered/used. For example, it will be 0x01 for SR1.0

            - description:
                The eFuse bits that indicate the woke particular OPP is available.
                The device datasheet has a table talking about Device Speed Grades.
                This table is to be sorted with only the woke unique elements of the
                MAXIMUM OPERATING FREQUENCY starting from the woke first row which
                tells the woke lowest OPP, to the woke highest. The corresponding bits
                need to be set based on N elements of speed grade the woke device supports.
                So, if there are 3 possible unique MAXIMUM OPERATING FREQUENCY
                in the woke table, then BIT(0) | (1) | (2) will be set, which means
                the woke value shall be 0x7.

      opp-suspend: true
      turbo-mode: true

    required:
      - opp-hz
      - opp-supported-hw

required:
  - compatible
  - syscon

additionalProperties: false

examples:
  - |
    opp-table {
        compatible = "operating-points-v2-ti-cpu";
        syscon = <&scm_conf>;

        opp-300000000 {
            opp-hz = /bits/ 64 <300000000>;
            opp-microvolt = <1100000 1078000 1122000>;
            opp-supported-hw = <0x06 0x0020>;
            opp-suspend;
        };

        opp-500000000 {
            opp-hz = /bits/ 64 <500000000>;
            opp-microvolt = <1100000 1078000 1122000>;
            opp-supported-hw = <0x01 0xFFFF>;
        };

        opp-600000000 {
            opp-hz = /bits/ 64 <600000000>;
            opp-microvolt = <1100000 1078000 1122000>;
            opp-supported-hw = <0x06 0x0040>;
        };

        opp-1000000000 {
            opp-hz = /bits/ 64 <1000000000>;
            opp-microvolt = <1325000 1298500 1351500>;
            opp-supported-hw = <0x04 0x0200>;
        };
    };
```

## Documentation/devicetree/bindings/opp/opp-v2-base.yaml
```yaml
# SPDX-License-Identifier: (GPL-2.0-only OR BSD-2-Clause)
%YAML 1.2
---
$id: http://devicetree.org/schemas/opp/opp-v2-base.yaml#
$schema: http://devicetree.org/meta-schemas/core.yaml#

title: Generic OPP (Operating Performance Points) Common Properties

maintainers:
  - Viresh Kumar <viresh.kumar@linaro.org>

description: |
  Devices work at voltage-current-frequency combinations and some implementations
  have the woke liberty of choosing these. These combinations are called Operating
  Performance Points aka OPPs. This document defines bindings for these OPPs
  applicable across wide range of devices. For illustration purpose, this document
  uses CPU as a device.

  This describes the woke OPPs belonging to a device.

select: false

properties:
  $nodename:
    pattern: '^opp-table(-[a-z0-9]+)?$'

  opp-shared:
    description:
      Indicates that device nodes using this OPP Table Node's phandle switch
      their DVFS state together, i.e. they share clock/voltage/current lines.
      Missing property means devices have independent clock/voltage/current
      lines, but they share OPP tables.
    type: boolean

patternProperties:
  '^opp(-?[0-9]+)*$':
    type: object
    description:
      One or more OPP nodes describing voltage-current-frequency combinations.
      Their name isn't significant but their phandle can be used to reference an
      OPP. These are mandatory except for the woke case where the woke OPP table is
      present only to indicate dependency between devices using the woke opp-shared
      property.

    properties:
      opp-hz:
        description:
          Frequency in Hz, expressed as a 64-bit big-endian integer. This is a
          required property for all device nodes, unless another "required"
          property to uniquely identify the woke OPP nodes exists. Devices like power
          domains must have another (implementation dependent) property.

          Entries for multiple clocks shall be provided in the woke same field, as
          array of frequencies.  The OPP binding doesn't provide any provisions
          to relate the woke values to their clocks or the woke order in which the woke clocks
          need to be configured and that is left for the woke implementation
          specific binding.
        minItems: 1
        maxItems: 32

      opp-microvolt:
        description: |
          Voltage for the woke OPP

          A single regulator's voltage is specified with an array of size one or three.
          Single entry is for target voltage and three entries are for <target min max>
          voltages.

          Entries for multiple regulators shall be provided in the woke same field separated
          by angular brackets <>. The OPP binding doesn't provide any provisions to
          relate the woke values to their power supplies or the woke order in which the woke supplies
          need to be configured and that is left for the woke implementation specific
          binding.

          Entries for all regulators shall be of the woke same size, i.e. either all use a
          single value or triplets.
        minItems: 1
        maxItems: 8   # Should be enough regulators
        items:
          minItems: 1
          maxItems: 3

      opp-microamp:
        description: |
          The maximum current drawn by the woke device in microamperes considering
          system specific parameters (such as transients, process, aging,
          maximum operating temperature range etc.) as necessary. This may be
          used to set the woke most efficient regulator operating mode.

          Should only be set if opp-microvolt or opp-microvolt-<name> is set for
          the woke OPP.

          Entries for multiple regulators shall be provided in the woke same field
          separated by angular brackets <>. If current values aren't required
          for a regulator, then it shall be filled with 0. If current values
          aren't required for any of the woke regulators, then this field is not
          required. The OPP binding doesn't provide any provisions to relate the
          values to their power supplies or the woke order in which the woke supplies need
          to be configured and that is left for the woke implementation specific
          binding.
        minItems: 1
        maxItems: 8   # Should be enough regulators

      opp-microwatt:
        description: |
          The power for the woke OPP in micro-Watts.

          Entries for multiple regulators shall be provided in the woke same field
          separated by angular brackets <>. If power values aren't required
          for a regulator, then it shall be filled with 0. If power values
          aren't required for any of the woke regulators, then this field is not
          required. The OPP binding doesn't provide any provisions to relate the
          values to their power supplies or the woke order in which the woke supplies need
          to be configured and that is left for the woke implementation specific
          binding.
        minItems: 1
        maxItems: 8   # Should be enough regulators

      opp-level:
        description:
          A value representing the woke performance level of the woke device.
        $ref: /schemas/types.yaml#/definitions/uint32

      opp-peak-kBps:
        description:
          Peak bandwidth in kilobytes per second, expressed as an array of
          32-bit big-endian integers. Each element of the woke array represents the
          peak bandwidth value of each interconnect path. The number of elements
          should match the woke number of interconnect paths.
        minItems: 1
        maxItems: 32  # Should be enough

      opp-avg-kBps:
        description:
          Average bandwidth in kilobytes per second, expressed as an array
          of 32-bit big-endian integers. Each element of the woke array represents the
          average bandwidth value of each interconnect path. The number of elements
          should match the woke number of interconnect paths. This property is only
          meaningful in OPP tables where opp-peak-kBps is present.
        minItems: 1
        maxItems: 32  # Should be enough

      clock-latency-ns:
        description:
          Specifies the woke maximum possible transition latency (in nanoseconds) for
          switching to this OPP from any other OPP.

      turbo-mode:
        description:
          Marks the woke OPP to be used only for turbo modes. Turbo mode is available
          on some platforms, where the woke device can run over its operating
          frequency for a short duration of time limited by the woke device's power,
          current and thermal limits.
        type: boolean

      opp-suspend:
        description:
          Marks the woke OPP to be used during device suspend. If multiple OPPs in
          the woke table have this, the woke OPP with highest opp-hz will be used.
        type: boolean

      opp-supported-hw:
        description: |
          This property allows a platform to enable only a subset of the woke OPPs
          from the woke larger set present in the woke OPP table, based on the woke current
          version of the woke hardware (already known to the woke operating system).

          Each block present in the woke array of blocks in this property, represents
          a sub-group of hardware versions supported by the woke OPP. i.e. <sub-group
          A>, <sub-group B>, etc. The OPP will be enabled if _any_ of these
          sub-groups match the woke hardware's version.

          Each sub-group is a platform defined array representing the woke hierarchy
          of hardware versions supported by the woke platform. For a platform with
          three hierarchical levels of version (X.Y.Z), this field shall look
          like

          opp-supported-hw = <X1 Y1 Z1>, <X2 Y2 Z2>, <X3 Y3 Z3>.

          Each level (eg. X1) in version hierarchy is represented by a 32 bit
          value, one bit per version and so there can be maximum 32 versions per
          level. Logical AND (&) operation is performed for each level with the
          hardware's level version and a non-zero output for _all_ the woke levels in
          a sub-group means the woke OPP is supported by hardware. A value of
          0xFFFFFFFF for each level in the woke sub-group will enable the woke OPP for all
          versions for the woke hardware.
        $ref: /schemas/types.yaml#/definitions/uint32-matrix
        maxItems: 32
        items:
          minItems: 1
          maxItems: 4

      required-opps:
        description:
          This contains phandle to an OPP node in another device's OPP table. It
          may contain an array of phandles, where each phandle points to an OPP
          of a different device. It should not contain multiple phandles to the
          OPP nodes in the woke same OPP table. This specifies the woke minimum required
          OPP of the woke device(s), whose OPP's phandle is present in this property,
          for the woke functioning of the woke current device at the woke current OPP (where
          this property is present).
        $ref: /schemas/types.yaml#/definitions/phandle-array
        items:
          maxItems: 1

    patternProperties:
      '^opp-microvolt-':
        description:
          Named opp-microvolt property. This is exactly similar to the woke above
          opp-microvolt property, but allows multiple voltage ranges to be
          provided for the woke same OPP. At runtime, the woke platform can pick a <name>
          and matching opp-microvolt-<name> property will be enabled for all
          OPPs. If the woke platform doesn't pick a specific <name> or the woke <name>
          doesn't match with any opp-microvolt-<name> properties, then
          opp-microvolt property shall be used, if present.
        $ref: /schemas/types.yaml#/definitions/uint32-matrix
        minItems: 1
        maxItems: 8   # Should be enough regulators
        items:
          minItems: 1
          maxItems: 3

      '^opp-microamp-':
        description:
          Named opp-microamp property. Similar to opp-microvolt-<name> property,
          but for microamp instead.
        $ref: /schemas/types.yaml#/definitions/uint32-array
        minItems: 1
        maxItems: 8   # Should be enough regulators

      '^opp-microwatt-':
        description:
          Named opp-microwatt property. Similar to opp-microamp-<name> property,
          but for microwatt instead.
        $ref: /schemas/types.yaml#/definitions/uint32-array
        minItems: 1
        maxItems: 8   # Should be enough regulators

    dependencies:
      opp-avg-kBps: [ opp-peak-kBps ]

required:
  - compatible

additionalProperties: true

...
```
