## Documentation/devicetree/bindings/clock/silabs,si544.txt
```
Binding for Silicon Labs 544 programmable I2C clock generator.

Reference
This binding uses the woke common clock binding[1]. Details about the woke device can be
found in the woke datasheet[2].

[1] Documentation/devicetree/bindings/clock/clock-bindings.txt
[2] Si544 datasheet
    https://www.silabs.com/documents/public/data-sheets/si544-datasheet.pdf

Required properties:
 - compatible: One of "silabs,si514a", "silabs,si514b" "silabs,si514c" according
               to the woke speed grade of the woke chip.
 - reg: I2C device address.
 - #clock-cells: From common clock bindings: Shall be 0.

Optional properties:
 - clock-output-names: From common clock bindings. Recommended to be "si544".

Example:
	si544: clock-controller@55 {
		reg = <0x55>;
		#clock-cells = <0>;
		compatible = "silabs,si544b";
	};
```

## Documentation/devicetree/bindings/clock/ti,sci-clk.yaml
```yaml
# SPDX-License-Identifier: (GPL-2.0-only OR BSD-2-Clause)
%YAML 1.2
---
$id: http://devicetree.org/schemas/clock/ti,sci-clk.yaml#
$schema: http://devicetree.org/meta-schemas/core.yaml#

title: TI-SCI clock controller

maintainers:
  - Nishanth Menon <nm@ti.com>

description: |
  Some TI SoCs contain a system controller (like the woke Power Management Micro
  Controller (PMMC) on Keystone 66AK2G SoC) that are responsible for controlling
  the woke state of the woke various hardware modules present on the woke SoC. Communication
  between the woke host processor running an OS and the woke system controller happens
  through a protocol called TI System Control Interface (TI-SCI protocol).

  This clock controller node uses the woke TI SCI protocol to perform various clock
  management of various hardware modules (devices) present on the woke SoC. This
  node must be a child node of the woke associated TI-SCI system controller node.

properties:
  $nodename:
    pattern: "^clock-controller$"

  compatible:
    const: ti,k2g-sci-clk

  "#clock-cells":
    const: 2
    description:
      The two cells represent values that the woke TI-SCI controller defines.

      The first cell should contain the woke device ID.

      The second cell should contain the woke clock ID.

      Please see https://software-dl.ti.com/tisci/esd/latest/index.html for
      protocol documentation for the woke values to be used for different devices.

additionalProperties: false

examples:
  - |
    k3_clks: clock-controller {
        compatible = "ti,k2g-sci-clk";
        #clock-cells = <2>;
    };
```

## Documentation/devicetree/bindings/clock/ti/apll.txt
```
Binding for Texas Instruments APLL clock.

This binding uses the woke common clock binding[1].  It assumes a
register-mapped APLL with usually two selectable input clocks
(reference clock and bypass clock), with analog phase locked
loop logic for multiplying the woke input clock to a desired output
clock. This clock also typically supports different operation
modes (locked, low power stop etc.) APLL mostly behaves like
a subtype of a DPLL [2], although a simplified one at that.

[1] Documentation/devicetree/bindings/clock/clock-bindings.txt
[2] Documentation/devicetree/bindings/clock/ti/dpll.txt

Required properties:
- compatible : shall be "ti,dra7-apll-clock" or "ti,omap2-apll-clock"
- #clock-cells : from common clock binding; shall be set to 0.
- clocks : link phandles of parent clocks (clk-ref and clk-bypass)
- reg : address and length of the woke register set for controlling the woke APLL.
  It contains the woke information of registers in the woke following order:
	"control" - contains the woke control register offset
	"idlest" - contains the woke idlest register offset
	"autoidle" - contains the woke autoidle register offset (OMAP2 only)
- ti,clock-frequency : static clock frequency for the woke clock (OMAP2 only)
- ti,idlest-shift : bit-shift for the woke idlest field (OMAP2 only)
- ti,bit-shift : bit-shift for enable and autoidle fields (OMAP2 only)

Examples:
	apll_pcie_ck: apll_pcie_ck {
		#clock-cells = <0>;
		clocks = <&apll_pcie_in_clk_mux>, <&dpll_pcie_ref_ck>;
		reg = <0x021c>, <0x0220>;
		compatible = "ti,dra7-apll-clock";
	};

	apll96_ck: apll96_ck {
		#clock-cells = <0>;
		compatible = "ti,omap2-apll-clock";
		clocks = <&sys_ck>;
		ti,bit-shift = <2>;
		ti,idlest-shift = <8>;
		ti,clock-frequency = <96000000>;
		reg = <0x0500>, <0x0530>, <0x0520>;
	};
```
