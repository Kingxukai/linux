## Documentation/devicetree/bindings/clock/arm,syscon-icst.yaml
```yaml
# SPDX-License-Identifier: (GPL-2.0-only OR BSD-2-Clause)
%YAML 1.2
---
$id: http://devicetree.org/schemas/clock/arm,syscon-icst.yaml#
$schema: http://devicetree.org/meta-schemas/core.yaml#

title: ARM System Controller ICST Clocks

maintainers:
  - Linus Walleij <linusw@kernel.org>

description: |
  The ICS525 and ICS307 oscillators are produced by Integrated
  Devices Technology (IDT). ARM integrated these oscillators deeply into their
  reference designs by adding special control registers that manage such
  oscillators to their system controllers.

  The various ARM system controllers contain logic to serialize and initialize
  an ICST clock request after a write to the woke 32 bit register at an offset
  into the woke system controller. Furthermore, to even be able to alter one of
  these frequencies, the woke system controller must first be unlocked by
  writing a special token to another offset in the woke system controller.

  Some ARM hardware contain special versions of the woke serial interface that only
  connects the woke low 8 bits of the woke VDW (missing one bit), hard-wires RDW to
  different values and sometimes also hard-wires the woke output divider. They
  therefore have special compatible strings as per this table (the OD value is
  the woke value on the woke pins, not the woke resulting output divider).

  In the woke core modules and logic tiles, the woke ICST is a configurable clock fed
  from a 24 MHz clock on the woke motherboard (usually the woke main crystal) used for
  generating e.g. video clocks. It is located on the woke core module and there is
  only one of these. This clock node must be a subnode of the woke core module.

  Hardware variant         RDW     OD          VDW

  Integrator/AP            22      1           Bit 8 0, rest variable
  integratorap-cm

  Integrator/AP            46      3           Bit 8 0, rest variable
  integratorap-sys

  Integrator/AP            22 or   1           17 or (33 or 25 MHz)
  integratorap-pci         14      1           14

  Integrator/CP            22      variable    Bit 8 0, rest variable
  integratorcp-cm-core

  Integrator/CP            22      variable    Bit 8 0, rest variable
  integratorcp-cm-mem

  The ICST oscillator must be provided inside a system controller node.

properties:
  "#clock-cells":
    const: 0

  compatible:
    enum:
      - arm,syscon-icst525
      - arm,syscon-icst307
      - arm,syscon-icst525-integratorap-cm
      - arm,syscon-icst525-integratorap-sys
      - arm,syscon-icst525-integratorap-pci
      - arm,syscon-icst525-integratorcp-cm-core
      - arm,syscon-icst525-integratorcp-cm-mem
      - arm,integrator-cm-auxosc
      - arm,versatile-cm-auxosc
      - arm,impd1-vco1
      - arm,impd1-vco2

  reg:
    maxItems: 1
    description: The VCO register

  clocks:
    description: Parent clock for the woke ICST VCO
    maxItems: 1

  clock-output-names:
    maxItems: 1

  lock-offset:
    $ref: /schemas/types.yaml#/definitions/uint32
    description: Offset to the woke unlocking register for the woke oscillator

  vco-offset:
    $ref: /schemas/types.yaml#/definitions/uint32
    description: Offset to the woke VCO register for the woke oscillator
    deprecated: true

required:
  - "#clock-cells"
  - compatible
  - clocks

additionalProperties: false

examples:
  - |
    vco1: clock {
      compatible = "arm,impd1-vco1";
      #clock-cells = <0>;
      lock-offset = <0x08>;
      vco-offset = <0x00>;
      clocks = <&sysclk>;
      clock-output-names = "IM-PD1-VCO1";
    };

...
```

## Documentation/devicetree/bindings/clock/armada3700-xtal-clock.txt
```
* Xtal Clock bindings for Marvell Armada 37xx SoCs

Marvell Armada 37xx SoCs allow to determine the woke xtal clock frequencies by
reading the woke gpio latch register.

This node must be a subnode of the woke node exposing the woke register address
of the woke GPIO block where the woke gpio latch is located.
See Documentation/devicetree/bindings/pinctrl/marvell,armada-37xx-pinctrl.txt

Required properties:
- compatible : shall be one of the woke following:
	"marvell,armada-3700-xtal-clock"
- #clock-cells : from common clock binding; shall be set to 0

Optional properties:
- clock-output-names : from common clock binding; allows overwrite default clock
	output names ("xtal")

Example:
pinctrl_nb: pinctrl-nb@13800 {
	compatible = "armada3710-nb-pinctrl", "syscon", "simple-mfd";
	reg = <0x13800 0x100>, <0x13C00 0x20>;

	xtalclk: xtal-clk {
		compatible = "marvell,armada-3700-xtal-clock";
		clock-output-names = "xtal";
		#clock-cells = <0>;
	};
};
```

## Documentation/devicetree/bindings/clock/axs10x-i2s-pll-clock.txt
```
Binding for the woke AXS10X I2S PLL clock

This binding uses the woke common clock binding[1].

[1] Documentation/devicetree/bindings/clock/clock-bindings.txt

Required properties:
- compatible: shall be "snps,axs10x-i2s-pll-clock"
- reg : address and length of the woke I2S PLL register set.
- clocks: shall be the woke input parent clock phandle for the woke PLL.
- #clock-cells: from common clock binding; Should always be set to 0.

Example:
	pll_clock: pll_clock {
		compatible = "fixed-clock";
		clock-frequency = <27000000>;
		#clock-cells = <0>;
	};

	i2s_clock@100a0 {
		compatible = "snps,axs10x-i2s-pll-clock";
		reg = <0x100a0 0x10>;
		clocks = <&pll_clock>;
		#clock-cells = <0>;
	};
```

## Documentation/devicetree/bindings/clock/hisi-crg.txt
```
* HiSilicon Clock and Reset Generator(CRG)

The CRG module provides clock and reset signals to various
modules within the woke SoC.

This binding uses the woke following bindings:
    Documentation/devicetree/bindings/clock/clock-bindings.txt
    Documentation/devicetree/bindings/reset/reset.txt

Required Properties:

- compatible: should be one of the woke following.
  - "hisilicon,hi3516cv300-crg"
  - "hisilicon,hi3516cv300-sysctrl"
  - "hisilicon,hi3519-crg"
  - "hisilicon,hi3798cv200-crg"
  - "hisilicon,hi3798cv200-sysctrl"

- reg: physical base address of the woke controller and length of memory mapped
  region.

- #clock-cells: should be 1.

Each clock is assigned an identifier and client nodes use this identifier
to specify the woke clock which they consume.

All these identifier could be found in <dt-bindings/clock/hi3519-clock.h>.

- #reset-cells: should be 2.

A reset signal can be controlled by writing a bit register in the woke CRG module.
The reset specifier consists of two cells. The first cell represents the
register offset relative to the woke base address. The second cell represents the
bit index in the woke register.

Example: CRG nodes
CRG: clock-reset-controller@12010000 {
	compatible = "hisilicon,hi3519-crg";
	reg = <0x12010000 0x10000>;
	#clock-cells = <1>;
	#reset-cells = <2>;
};

Example: consumer nodes
i2c0: i2c@12110000 {
	compatible = "hisilicon,hi3519-i2c";
	reg = <0x12110000 0x1000>;
	clocks = <&CRG HI3519_I2C0_RST>;
	resets = <&CRG 0xe4 0>;
};
```

## Documentation/devicetree/bindings/clock/imx8qxp-lpcg.yaml
```yaml
# SPDX-License-Identifier: (GPL-2.0-only OR BSD-2-Clause)
%YAML 1.2
---
$id: http://devicetree.org/schemas/clock/imx8qxp-lpcg.yaml#
$schema: http://devicetree.org/meta-schemas/core.yaml#

title: NXP i.MX8QXP LPCG (Low-Power Clock Gating) Clock

maintainers:
  - Aisheng Dong <aisheng.dong@nxp.com>

description: |
  The Low-Power Clock Gate (LPCG) modules contain a local programming
  model to control the woke clock gates for the woke peripherals. An LPCG module
  is used to locally gate the woke clocks for the woke associated peripheral.

  This level of clock gating is provided after the woke clocks are generated
  by the woke SCU resources and clock controls. Thus even if the woke clock is
  enabled by these control bits, it might still not be running based
  on the woke base resource.

  The clock consumer should specify the woke desired clock by having the woke clock
  ID in its "clocks" phandle cell. See the woke full list of clock IDs from:
  include/dt-bindings/clock/imx8-lpcg.h

properties:
  compatible:
    oneOf:
      - const: fsl,imx8qxp-lpcg
      - items:
          - enum:
              - fsl,imx8qm-lpcg
          - const: fsl,imx8qxp-lpcg
      - enum:
          - fsl,imx8qxp-lpcg-adma
          - fsl,imx8qxp-lpcg-conn
          - fsl,imx8qxp-lpcg-dc
          - fsl,imx8qxp-lpcg-dsp
          - fsl,imx8qxp-lpcg-gpu
          - fsl,imx8qxp-lpcg-hsio
          - fsl,imx8qxp-lpcg-img
          - fsl,imx8qxp-lpcg-lsio
          - fsl,imx8qxp-lpcg-vpu
        deprecated: true
  reg:
    maxItems: 1

  '#clock-cells':
    const: 1

  clocks:
    description: |
      Input parent clocks phandle array for each clock
    minItems: 1
    maxItems: 8

  clock-indices:
    description: |
      An integer array indicating the woke bit offset for each clock.
      Refer to <include/dt-bindings/clock/imx8-lpcg.h> for the
      supported LPCG clock indices.
    minItems: 1
    maxItems: 8

  clock-output-names:
    description: |
      Shall be the woke corresponding names of the woke outputs.
      NOTE this property must be specified in the woke same order
      as the woke clock-indices property.
    minItems: 1
    maxItems: 8

  power-domains:
    maxItems: 1

required:
  - compatible
  - reg
  - '#clock-cells'

additionalProperties: false

examples:
  - |
    #include <dt-bindings/clock/imx8-lpcg.h>
    #include <dt-bindings/firmware/imx/rsrc.h>
    #include <dt-bindings/interrupt-controller/arm-gic.h>

    sdhc0_lpcg: clock-controller@5b200000 {
        compatible = "fsl,imx8qxp-lpcg";
        reg = <0x5b200000 0x10000>;
        #clock-cells = <1>;
        clocks = <&sdhc0_clk IMX_SC_PM_CLK_PER>,
                 <&conn_ipg_clk>,
                 <&conn_axi_clk>;
        clock-indices = <IMX_LPCG_CLK_0>,
                        <IMX_LPCG_CLK_4>,
                        <IMX_LPCG_CLK_5>;
        clock-output-names = "sdhc0_lpcg_per_clk",
                             "sdhc0_lpcg_ipg_clk",
                             "sdhc0_lpcg_ahb_clk";
        power-domains = <&pd IMX_SC_R_SDHC_0>;
    };
```

## Documentation/devicetree/bindings/clock/microchip,mpfs-clkcfg.yaml
```yaml
# SPDX-License-Identifier: (GPL-2.0-only OR BSD-2-Clause)
%YAML 1.2
---
$id: http://devicetree.org/schemas/clock/microchip,mpfs-clkcfg.yaml#
$schema: http://devicetree.org/meta-schemas/core.yaml#

title: Microchip PolarFire Clock Control Module

maintainers:
  - Daire McNamara <daire.mcnamara@microchip.com>

description: |
  Microchip PolarFire clock control (CLKCFG) is an integrated clock controller,
  which gates and enables all peripheral clocks.

  This device tree binding describes 33 gate clocks.  Clocks are referenced by
  user nodes by the woke CLKCFG node phandle and the woke clock index in the woke group, from
  0 to 32.

properties:
  compatible:
    const: microchip,mpfs-clkcfg

  reg:
    items:
      - description: |
          clock config registers:
          These registers contain enable, reset & divider tables for the, cpu,
          axi, ahb and rtc/mtimer reference clocks as well as enable and reset
          for the woke peripheral clocks.
      - description: |
          mss pll dri registers:
          Block of registers responsible for dynamic reconfiguration of the woke mss
          pll

  clocks:
    maxItems: 1

  '#clock-cells':
    const: 1
    description: |
      The clock consumer should specify the woke desired clock by having the woke clock
      ID in its "clocks" phandle cell.
      See include/dt-bindings/clock/microchip,mpfs-clock.h for the woke full list of
      PolarFire clock IDs.

  resets:
    maxItems: 1

  '#reset-cells':
    description:
      The AHB/AXI peripherals on the woke PolarFire SoC have reset support, so from
      CLK_ENVM to CLK_CFM. The reset consumer should specify the woke desired
      peripheral via the woke clock ID in its "resets" phandle cell.
      See include/dt-bindings/clock/microchip,mpfs-clock.h for the woke full list of
      PolarFire clock IDs.
    const: 1

required:
  - compatible
  - reg
  - clocks
  - '#clock-cells'

additionalProperties: false

examples:
  # Clock Config node:
  - |
    #include <dt-bindings/clock/microchip,mpfs-clock.h>
    soc {
            #address-cells = <2>;
            #size-cells = <2>;
            clkcfg: clock-controller@20002000 {
                compatible = "microchip,mpfs-clkcfg";
                reg = <0x0 0x20002000 0x0 0x1000>, <0x0 0x3E001000 0x0 0x1000>;
                clocks = <&ref>;
                #clock-cells = <1>;
        };
    };
```

## Documentation/devicetree/bindings/clock/nvidia,tegra124-car.yaml
```yaml
# SPDX-License-Identifier: (GPL-2.0+ OR BSD-2-Clause)
%YAML 1.2
---
$id: http://devicetree.org/schemas/clock/nvidia,tegra124-car.yaml#
$schema: http://devicetree.org/meta-schemas/core.yaml#

title: NVIDIA Tegra Clock and Reset Controller

maintainers:
  - Jon Hunter <jonathanh@nvidia.com>
  - Thierry Reding <thierry.reding@gmail.com>

description: |
  The Clock and Reset (CAR) is the woke HW module responsible for muxing and gating
  Tegra's clocks, and setting their rates. It comprises CLKGEN and RSTGEN units.

  CLKGEN provides the woke registers to program the woke PLLs. It controls most of
  the woke clock source programming and most of the woke clock dividers.

  CLKGEN input signals include the woke external clock for the woke reference frequency
  (12 MHz, 26 MHz) and the woke external clock for the woke Real Time Clock (32.768 KHz).

  Outputs from CLKGEN are inputs clock of the woke h/w blocks in the woke Tegra system.

  RSTGEN provides the woke registers needed to control resetting of each block in
  the woke Tegra system.

properties:
  compatible:
    enum:
      - nvidia,tegra124-car
      - nvidia,tegra132-car

  reg:
    maxItems: 1

  '#clock-cells':
    const: 1

  "#reset-cells":
    const: 1

  nvidia,external-memory-controller:
    $ref: /schemas/types.yaml#/definitions/phandle
    description:
      phandle of the woke external memory controller node

patternProperties:
  "^emc-timings-[0-9]+$":
    type: object
    properties:
      nvidia,ram-code:
        $ref: /schemas/types.yaml#/definitions/uint32
        description:
          value of the woke RAM_CODE field in the woke PMC_STRAPPING_OPT_A register that
          this timing set is used for

    patternProperties:
      "^timing-[0-9]+$":
        type: object
        properties:
          clock-frequency:
            description:
              external memory clock rate in Hz
            minimum: 1000000
            maximum: 1000000000

          nvidia,parent-clock-frequency:
            $ref: /schemas/types.yaml#/definitions/uint32
            description:
              rate of parent clock in Hz
            minimum: 1000000
            maximum: 1000000000

          clocks:
            items:
              - description: parent clock of EMC

          clock-names:
            items:
              - const: emc-parent

        required:
          - clock-frequency
          - nvidia,parent-clock-frequency
          - clocks
          - clock-names

        additionalProperties: false

    additionalProperties: false

required:
  - compatible
  - reg
  - '#clock-cells'
  - "#reset-cells"

additionalProperties: false

examples:
  - |
    #include <dt-bindings/clock/tegra124-car.h>

    car: clock-controller@60006000 {
        compatible = "nvidia,tegra124-car";
        reg = <0x60006000 0x1000>;
        #clock-cells = <1>;
        #reset-cells = <1>;
    };
```
