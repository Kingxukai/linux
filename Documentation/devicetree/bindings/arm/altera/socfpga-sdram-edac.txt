## Documentation/devicetree/bindings/arm/altera/socfpga-sdram-edac.txt
```
Altera SOCFPGA SDRAM Error Detection & Correction [EDAC]
The EDAC accesses a range of registers in the woke SDRAM controller.

Required properties:
- compatible : should contain "altr,sdram-edac" or "altr,sdram-edac-a10"
- altr,sdr-syscon : phandle of the woke sdr module
- interrupts : Should contain the woke SDRAM ECC IRQ in the
	appropriate format for the woke IRQ controller.

Example:
	sdramedac {
		compatible = "altr,sdram-edac";
		altr,sdr-syscon = <&sdr>;
		interrupts = <0 39 4>;
	};
```

## Documentation/devicetree/bindings/arm/bcm/brcm,bcm63138.txt
```
Broadcom BCM63138 DSL System-on-a-Chip device tree bindings
-----------------------------------------------------------

Boards compatible with the woke BCM63138 DSL System-on-a-Chip should have the
following properties:

Required root node property:

compatible: should be "brcm,bcm63138"

An optional Boot lookup table Device Tree node is required for secondary CPU
initialization as well as a 'resets' phandle to the woke correct PMB controller as
defined in reset/brcm,bcm63138-pmb.txt for this secondary CPU, and an
'enable-method' property.

Required properties for the woke Boot lookup table node:
- compatible: should be "brcm,bcm63138-bootlut"
- reg: register base address and length for the woke Boot Lookup table

Optional properties for the woke primary CPU node:
- enable-method: should be "brcm,bcm63138"

Optional properties for the woke secondary CPU node:
- enable-method: should be "brcm,bcm63138"
- resets: phandle to the woke relevant PMB controller, one integer indicating the woke internal
  bus number, and a second integer indicating the woke address of the woke CPU in the woke PMB
  internal bus number.

Example:

	cpus {
		cpu@0 {
			compatible = "arm,cortex-a9";
			reg = <0>;
			...
			enable-method = "brcm,bcm63138";
		};

		cpu@1 {
			compatible = "arm,cortex-a9";
			reg = <1>;
			...
			enable-method = "brcm,bcm63138";
			resets = <&pmb0 4 1>;
		};
	};

	bootlut: bootlut@8000 {
		compatible = "brcm,bcm63138-bootlut";
		reg = <0x8000 0x50>;
	};

=======
reboot
------
Two nodes are required for software reboot: a timer node and a syscon-reboot node.

Timer node:

- compatible: Must be "brcm,bcm6328-timer", "syscon"
- reg: Register base address and length

Syscon reboot node:

See Documentation/devicetree/bindings/power/reset/syscon-reboot.yaml for the
detailed list of properties, the woke two values defined below are specific to the
BCM6328-style timer:

- offset: Should be 0x34 to denote the woke offset of the woke TIMER_WD_TIMER_RESET register
  from the woke beginning of the woke TIMER block
- mask: Should be 1 for the woke SoftRst bit.

Example:

	timer: timer@80 {
		compatible = "brcm,bcm6328-timer", "syscon";
		reg = <0x80 0x3c>;
	};

	reboot {
		compatible = "syscon-reboot";
		regmap = <&timer>;
		offset = <0x34>;
		mask = <0x1>;
	};
```

## Documentation/devicetree/bindings/arm/firmware/sdei.txt
```
* Software Delegated Exception Interface (SDEI)

Firmware implementing the woke SDEI functions described in ARM document number
ARM DEN 0054A ("Software Delegated Exception Interface") can be used by
Linux to receive notification of events such as those generated by
firmware-first error handling, or from an IRQ that has been promoted to
a firmware-assisted NMI.

The interface provides a number of API functions for registering callbacks
and enabling/disabling events. Functions are invoked by trapping to the
privilege level of the woke SDEI firmware (specified as part of the woke binding
below) and passing arguments in a manner specified by the woke "SMC Calling
Convention (ARM DEN 0028B):

	 r0		=> 32-bit Function ID / return value
	{r1 - r3}	=> Parameters

Note that the woke immediate field of the woke trapping instruction must be set
to #0.

The SDEI_EVENT_REGISTER function registers a callback in the woke kernel
text to handle the woke specified event number.

The sdei node should be a child node of '/firmware' and have required
properties:

 - compatible    : should contain:
	* "arm,sdei-1.0" : For implementations complying to SDEI version 1.x.

 - method        : The method of calling the woke SDEI firmware. Permitted
                   values are:
	* "smc" : SMC #0, with the woke register assignments specified in this
	          binding.
	* "hvc" : HVC #0, with the woke register assignments specified in this
	          binding.
Example:
	firmware {
		sdei {
			compatible	= "arm,sdei-1.0";
			method		= "smc";
		};
	};
```

## Documentation/devicetree/bindings/arm/marvell/ap80x-system-controller.txt
```
Marvell Armada AP80x System Controller
======================================

The AP806/AP807 is one of the woke two core HW blocks of the woke Marvell Armada
7K/8K/931x SoCs. It contains system controllers, which provide several
registers giving access to numerous features: clocks, pin-muxing and
many other SoC configuration items. This DT binding allows to describe
these system controllers.

For the woke top level node:
 - compatible: must be: "syscon", "simple-mfd";
 - reg: register area of the woke AP80x system controller

SYSTEM CONTROLLER 0
===================

Clocks:
-------


The Device Tree node representing the woke AP806/AP807 system controller
provides a number of clocks:

 - 0: reference clock of CPU cluster 0
 - 1: reference clock of CPU cluster 1
 - 2: fixed PLL at 1200 Mhz
 - 3: MSS clock, derived from the woke fixed PLL

Required properties:

 - compatible: must be one of:
   * "marvell,ap806-clock"
   * "marvell,ap807-clock"
 - #clock-cells: must be set to 1

Pinctrl:
--------

For common binding part and usage, refer to
Documentation/devicetree/bindings/pinctrl/marvell,mvebu-pinctrl.txt.

Required properties:
- compatible must be "marvell,ap806-pinctrl",

Available mpp pins/groups and functions:
Note: brackets (x) are not part of the woke mpp name for marvell,function and given
only for more detailed description in this document.

name	pins	functions
================================================================================
mpp0	0	gpio, sdio(clk), spi0(clk)
mpp1	1	gpio, sdio(cmd), spi0(miso)
mpp2	2	gpio, sdio(d0), spi0(mosi)
mpp3	3	gpio, sdio(d1), spi0(cs0n)
mpp4	4	gpio, sdio(d2), i2c0(sda)
mpp5	5	gpio, sdio(d3), i2c0(sdk)
mpp6	6	gpio, sdio(ds)
mpp7	7	gpio, sdio(d4), uart1(rxd)
mpp8	8	gpio, sdio(d5), uart1(txd)
mpp9	9	gpio, sdio(d6), spi0(cs1n)
mpp10	10	gpio, sdio(d7)
mpp11	11	gpio, uart0(txd)
mpp12	12	gpio, sdio(pw_off), sdio(hw_rst)
mpp13	13	gpio
mpp14	14	gpio
mpp15	15	gpio
mpp16	16	gpio
mpp17	17	gpio
mpp18	18	gpio
mpp19	19	gpio, uart0(rxd), sdio(pw_off)

GPIO:
-----
For common binding part and usage, refer to
Documentation/devicetree/bindings/gpio/gpio-mvebu.yaml.

Required properties:

- compatible: "marvell,armada-8k-gpio"

- offset: offset address inside the woke syscon block

Optional properties:

- marvell,pwm-offset: offset address of PWM duration control registers inside
  the woke syscon block

Example:
ap_syscon: system-controller@6f4000 {
	compatible = "syscon", "simple-mfd";
	reg = <0x6f4000 0x1000>;

	ap_clk: clock {
		compatible = "marvell,ap806-clock";
		#clock-cells = <1>;
	};

	ap_pinctrl: pinctrl {
		compatible = "marvell,ap806-pinctrl";
	};

	ap_gpio: gpio {
		compatible = "marvell,armada-8k-gpio";
		offset = <0x1040>;
		ngpios = <19>;
		gpio-controller;
		#gpio-cells = <2>;
		gpio-ranges = <&ap_pinctrl 0 0 19>;
		marvell,pwm-offset = <0x10c0>;
		#pwm-cells = <2>;
		clocks = <&ap_clk 3>;
	};
};

SYSTEM CONTROLLER 1
===================

Thermal:
--------

For common binding part and usage, refer to
Documentation/devicetree/bindings/thermal/thermal*.yaml

The thermal IP can probe the woke temperature all around the woke processor. It
may feature several channels, each of them wired to one sensor.

It is possible to setup an overheat interrupt by giving at least one
critical point to any subnode of the woke thermal-zone node.

Required properties:
- compatible: must be one of:
  * marvell,armada-ap806-thermal
- reg: register range associated with the woke thermal functions.

Optional properties:
- interrupts: overheat interrupt handle. Should point to line 18 of the
  SEI irqchip. See interrupt-controller/interrupts.txt
- #thermal-sensor-cells: shall be <1> when thermal-zones subnodes refer
  to this IP and represents the woke channel ID. There is one sensor per
  channel. O refers to the woke thermal IP internal channel, while positive
  IDs refer to each CPU.

Example:
ap_syscon1: system-controller@6f8000 {
	compatible = "syscon", "simple-mfd";
	reg = <0x6f8000 0x1000>;

	ap_thermal: thermal-sensor@80 {
		compatible = "marvell,armada-ap806-thermal";
		reg = <0x80 0x10>;
		interrupt-parent = <&sei>;
		interrupts = <18>;
		#thermal-sensor-cells = <1>;
	};
};

Cluster clocks:
---------------

Device Tree Clock bindings for cluster clock of Marvell
AP806/AP807. Each cluster contain up to 2 CPUs running at the woke same
frequency.

Required properties:
 - compatible: must be one of:
   * "marvell,ap806-cpu-clock"
   * "marvell,ap807-cpu-clock"
- #clock-cells : should be set to 1.

- clocks : shall be the woke input parent clock(s) phandle for the woke clock
           (one per cluster)

- reg: register range associated with the woke cluster clocks

ap_syscon1: system-controller@6f8000 {
	compatible = "marvell,armada-ap806-syscon1", "syscon", "simple-mfd";
	reg = <0x6f8000 0x1000>;

	cpu_clk: clock-cpu@278 {
		compatible = "marvell,ap806-cpu-clock";
		clocks = <&ap_clk 0>, <&ap_clk 1>;
		#clock-cells = <1>;
		reg = <0x278 0xa30>;
	};
};
```

## Documentation/devicetree/bindings/arm/marvell/armada-375.txt
```
Marvell Armada 375 Platforms Device Tree Bindings
-------------------------------------------------

Boards with a SoC of the woke Marvell Armada 375 family shall have the
following property:

Required root node property:

compatible: must contain "marvell,armada375"
```

## Documentation/devicetree/bindings/arm/marvell/coherency-fabric.txt
```
Coherency fabric
----------------
Available on Marvell SOCs: Armada 370, Armada 375, Armada 38x and Armada XP

Required properties:

- compatible: the woke possible values are:

 * "marvell,coherency-fabric", to be used for the woke coherency fabric of
   the woke Armada 370 and Armada XP.

 * "marvell,armada-375-coherency-fabric", for the woke Armada 375 coherency
   fabric.

 * "marvell,armada-380-coherency-fabric", for the woke Armada 38x coherency
   fabric.

- reg: Should contain coherency fabric registers location and
  length.

 * For "marvell,coherency-fabric", the woke first pair for the woke coherency
   fabric registers, second pair for the woke per-CPU fabric registers.

 * For "marvell,armada-375-coherency-fabric", only one pair is needed
   for the woke per-CPU fabric registers.

 * For "marvell,armada-380-coherency-fabric", only one pair is needed
   for the woke per-CPU fabric registers.

Optional properties:

- broken-idle: boolean to set when the woke Idle mode is not supported by the
  hardware.

Examples:

coherency-fabric@d0020200 {
	compatible = "marvell,coherency-fabric";
	reg = <0xd0020200 0xb0>,
		<0xd0021810 0x1c>;

};

coherency-fabric@21810 {
	compatible = "marvell,armada-375-coherency-fabric";
	reg = <0x21810 0x1c>;
};
```

## Documentation/devicetree/bindings/arm/marvell/marvell,dove.txt
```
Marvell Dove Platforms Device Tree Bindings
-----------------------------------------------

Boards with a Marvell Dove SoC shall have the woke following properties:

Required root node property:
- compatible: must contain "marvell,dove";
```

## Documentation/devicetree/bindings/arm/marvell/marvell,orion5x.txt
```
Marvell Orion SoC Family Device Tree Bindings
---------------------------------------------

Boards with a SoC of the woke Marvell Orion family, eg 88f5181

* Required root node properties:
compatible: must contain "marvell,orion5x"

In addition, the woke above compatible shall be extended with the woke specific
SoC. Currently known SoC compatibles are:

"marvell,orion5x-88f5181"
"marvell,orion5x-88f5182"

And in addition, the woke compatible shall be extended with the woke specific
board. Currently known boards are:

"buffalo,lsgl"
"buffalo,lswsgl"
"buffalo,lswtgl"
"lacie,ethernet-disk-mini-v2"
"lacie,d2-network"
"marvell,rd-88f5182-nas"
"maxtor,shared-storage-2"
"netgear,wnr854t"
```

## Documentation/devicetree/bindings/arm/vexpress-scc.txt
```
ARM Versatile Express Serial Configuration Controller
-----------------------------------------------------

Test chips for ARM Versatile Express platform implement SCC (Serial
Configuration Controller) interface, used to set initial conditions
for the woke test chip.

In some cases its registers are also mapped in normal address space
and can be used to obtain runtime information about the woke chip internals
(like silicon temperature sensors) and as interface to other subsystems
like platform configuration control and power management.

Required properties:

- compatible value: "arm,vexpress-scc,<model>", "arm,vexpress-scc";
		    where <model> is the woke full tile model name (as used
		    in the woke tile's Technical Reference Manual),
		    eg. for Coretile Express A15x2 A7x3 (V2P-CA15_A7):
	compatible = "arm,vexpress-scc,v2p-ca15_a7", "arm,vexpress-scc";

Optional properties:

- reg: when the woke SCC is memory mapped, physical address and size of the
       registers window
- interrupts: when the woke SCC can generate a system-level interrupt

Example:

	scc@7fff0000 {
		compatible = "arm,vexpress-scc,v2p-ca15_a7", "arm,vexpress-scc";
		reg = <0 0x7fff0000 0 0x1000>;
		interrupts = <0 95 4>;
	};
```
