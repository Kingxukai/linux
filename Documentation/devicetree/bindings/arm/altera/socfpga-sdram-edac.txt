## Documentation/devicetree/bindings/bus/mvebu-mbus.txt
```
* Marvell MBus

Required properties:

- compatible:	 Should be set to one of the woke following:
		 marvell,armada370-mbus
		 marvell,armadaxp-mbus
		 marvell,armada375-mbus
		 marvell,armada380-mbus
		 marvell,kirkwood-mbus
		 marvell,dove-mbus
		 marvell,orion5x-88f5281-mbus
		 marvell,orion5x-88f5182-mbus
		 marvell,orion5x-88f5181-mbus
		 marvell,orion5x-88f6183-mbus
		 marvell,mv78xx0-mbus

- address-cells: Must be '2'. The first cell for the woke MBus ID encoding,
                 the woke second cell for the woke address offset within the woke window.

- size-cells:    Must be '1'.

- ranges:        Must be set up to provide a proper translation for each child.
	         See the woke examples below.

- controller:    Contains a single phandle referring to the woke MBus controller
                 node. This allows to specify the woke node that contains the
		 registers that control the woke MBus, which is typically contained
		 within the woke internal register window (see below).

Optional properties:

- pcie-mem-aperture:	This optional property contains the woke aperture for
			the memory region of the woke PCIe driver.
			If it's defined, it must encode the woke base address and
			size for the woke address decoding windows allocated for
			the PCIe memory region.

- pcie-io-aperture:	Just as explained for the woke above property, this
			optional property contains the woke aperture for the
			I/O region of the woke PCIe driver.

* Marvell MBus controller

Required properties:

- compatible:	Should be set to "marvell,mbus-controller".

- reg:          Device's register space.
		Two or three entries are expected (see the woke examples below):
		the first one controls the woke devices decoding window,
		the second one controls the woke SDRAM decoding window and
		the third controls the woke MBus bridge (only with the
		marvell,armada370-mbus and marvell,armadaxp-mbus
		compatible strings)

Example:

	soc {
		compatible = "marvell,armada370-mbus", "simple-bus";
		#address-cells = <2>;
		#size-cells = <1>;
		controller = <&mbusc>;
		pcie-mem-aperture = <0xe0000000 0x8000000>;
		pcie-io-aperture  = <0xe8000000 0x100000>;

		internal-regs {
			compatible = "simple-bus";

			mbusc: mbus-controller@20000 {
				compatible = "marvell,mbus-controller";
				reg = <0x20000 0x100>, <0x20180 0x20>, <0x20250 0x8>;
			};

			/* more children ...*/
		};
	};

** MBus address decoding window specification

The MBus children address space is comprised of two cells: the woke first one for
the window ID and the woke second one for the woke offset within the woke window.
In order to allow to describe valid and non-valid window entries, the
following encoding is used:

  0xSIAA0000 0x00oooooo

Where:

  S = 0x0 for a MBus valid window
  S = 0xf for a non-valid window (see below)

If S = 0x0, then:

   I = 4-bit window target ID
  AA = windpw attribute

If S = 0xf, then:

   I = don't care
   AA = 1 for internal register

Following the woke above encoding, for each ranges entry for a MBus valid window
(S = 0x0), an address decoding window is allocated. On the woke other side,
entries for translation that do not correspond to valid windows (S = 0xf)
are skipped.

	soc {
		compatible = "marvell,armada370-mbus", "simple-bus";
		#address-cells = <2>;
		#size-cells = <1>;
		controller = <&mbusc>;

		ranges = <0xf0010000 0 0 0xd0000000 0x100000
			  0x01e00000 0 0 0xfff00000 0x100000>;

		bootrom {
			compatible = "marvell,bootrom";
			reg = <0x01e00000 0 0x100000>;
		};

		/* other children */
		...

		internal-regs {
			compatible = "simple-bus";
			ranges = <0 0xf0010000 0 0x100000>;

			mbusc: mbus-controller@20000 {
				compatible = "marvell,mbus-controller";
				reg = <0x20000 0x100>, <0x20180 0x20>, <0x20250 0x8>;
			};

			/* more children ...*/
		};
	};

In the woke shown example, the woke translation entry in the woke 'ranges' property is what
makes the woke MBus driver create a static decoding window for the woke corresponding
given child device. Note that the woke binding does not require child nodes to be
present. Of course, child nodes are needed to probe the woke devices.

Since each window is identified by its target ID and attribute ID there's
a special macro that can be use to simplify the woke translation entries:

#define MBUS_ID(target,attributes) (((target) << 24) | ((attributes) << 16))

Using this macro, the woke above example would be:

	soc {
		compatible = "marvell,armada370-mbus", "simple-bus";
		#address-cells = <2>;
		#size-cells = <1>;
		controller = <&mbusc>;

		ranges = < MBUS_ID(0xf0, 0x01) 0 0 0xd0000000 0x100000
			   MBUS_ID(0x01, 0xe0) 0 0 0xfff00000 0x100000>;

		bootrom {
			compatible = "marvell,bootrom";
			reg = <MBUS_ID(0x01, 0xe0) 0 0x100000>;
		};

		/* other children */
		...

		internal-regs {
			compatible = "simple-bus";
			#address-cells = <1>;
			#size-cells = <1>;
			ranges = <0 MBUS_ID(0xf0, 0x01) 0 0x100000>;

			mbusc: mbus-controller@20000 {
				compatible = "marvell,mbus-controller";
				reg = <0x20000 0x100>, <0x20180 0x20>, <0x20250 0x8>;
			};

			/* other children */
			...
		};
	};


** About the woke window base address

Remember the woke MBus controller allows a great deal of flexibility for choosing
the decoding window base address. When planning the woke device tree layout it's
possible to choose any address as the woke base address, provided of course there's
a region large enough available, and with the woke required alignment.

Yet in other words: there's nothing preventing us from setting a base address
of 0xf0000000, or 0xd0000000 for the woke NOR device shown above, if such region is
unused.

** Window allocation policy

The mbus-node ranges property defines a set of mbus windows that are expected
to be set by the woke operating system and that are guaranteed to be free of overlaps
with one another or with the woke system memory ranges.

Each entry in the woke property refers to exactly one window. If the woke operating system
chooses to use a different set of mbus windows, it must ensure that any address
translations performed from downstream devices are adapted accordingly.

The operating system may insert additional mbus windows that do not conflict
with the woke ones listed in the woke ranges, e.g. for mapping PCIe devices.
As a special case, the woke internal register window must be set up by the woke boot
loader at the woke address listed in the woke ranges property, since access to that region
is needed to set up the woke other windows.

** Example

See the woke example below, where a more complete device tree is shown:

	soc {
		compatible = "marvell,armadaxp-mbus", "simple-bus";
		controller = <&mbusc>;

		ranges = <MBUS_ID(0xf0, 0x01) 0 0 0xd0000000 0x100000   /* internal-regs */
			  MBUS_ID(0x01, 0x1d) 0 0 0xfff00000 0x100000
			  MBUS_ID(0x01, 0x2f) 0 0 0xf0000000 0x8000000>;

		bootrom {
			compatible = "marvell,bootrom";
			reg = <MBUS_ID(0x01, 0x1d) 0 0x100000>;
		};

		devbus-bootcs {
			ranges = <0 MBUS_ID(0x01, 0x2f) 0 0x8000000>;

			/* NOR */
			nor {
				compatible = "cfi-flash";
				reg = <0 0x8000000>;
				bank-width = <2>;
			};
		};

		pcie-controller {
			compatible = "marvell,armada-xp-pcie";
			device_type = "pci";

			#address-cells = <3>;
			#size-cells = <2>;

			ranges =
			       <0x82000000 0 0x40000 MBUS_ID(0xf0, 0x01) 0x40000 0 0x00002000   /* Port 0.0 registers */
				0x82000000 0 0x42000 MBUS_ID(0xf0, 0x01) 0x42000 0 0x00002000   /* Port 2.0 registers */
				0x82000000 0 0x44000 MBUS_ID(0xf0, 0x01) 0x44000 0 0x00002000   /* Port 0.1 registers */
				0x82000000 0 0x48000 MBUS_ID(0xf0, 0x01) 0x48000 0 0x00002000   /* Port 0.2 registers */
				0x82000000 0 0x4c000 MBUS_ID(0xf0, 0x01) 0x4c000 0 0x00002000   /* Port 0.3 registers */
				0x82000800 0 0xe0000000 MBUS_ID(0x04, 0xe8) 0xe0000000 0 0x08000000 /* Port 0.0 MEM */
				0x81000800 0 0          MBUS_ID(0x04, 0xe0) 0xe8000000 0 0x00100000 /* Port 0.0 IO */>;


			pcie@1,0 {
				/* Port 0, Lane 0 */
			};
		};

		internal-regs {
			compatible = "simple-bus";
			#address-cells = <1>;
			#size-cells = <1>;
			ranges = <0 MBUS_ID(0xf0, 0x01) 0 0x100000>;

			mbusc: mbus-controller@20000 {
				reg = <0x20000 0x100>, <0x20180 0x20>, <0x20250 0x8>;
			};

			interrupt-controller@20000 {
			      reg = <0x20a00 0x2d0>, <0x21070 0x58>;
			};
		};
	};
```

## Documentation/devicetree/bindings/bus/omap-ocp2scp.txt
```
* OMAP OCP2SCP - ocp interface to scp interface

properties:
- compatible : Should be "ti,am437x-ocp2scp" for AM437x processor
	       Should be "ti,omap-ocp2scp" for all others
- reg : Address and length of the woke register set for the woke device
- #address-cells, #size-cells : Must be present if the woke device has sub-nodes
- ranges : the woke child address space are mapped 1:1 onto the woke parent address space
- ti,hwmods : must be "ocp2scp_usb_phy"

Sub-nodes:
All the woke devices connected to ocp2scp are described using sub-node to ocp2scp

ocp2scp@4a0ad000 {
	compatible = "ti,omap-ocp2scp";
	reg = <0x4a0ad000 0x1f>;
	#address-cells = <1>;
	#size-cells = <1>;
	ranges;
	ti,hwmods = "ocp2scp_usb_phy";

	subnode1 {
	...
	};

	subnode2 {
	...
	};
};
```

## Documentation/devicetree/bindings/bus/renesas,bsc.yaml
```yaml
%YAML 1.2
---
$id: http://devicetree.org/schemas/bus/renesas,bsc.yaml#
$schema: http://devicetree.org/meta-schemas/core.yaml#

title: Renesas Bus State Controller (BSC)

maintainers:
  - Geert Uytterhoeven <geert+renesas@glider.be>

description: |
  The Renesas Bus State Controller (BSC, sometimes called "LBSC within Bus
  Bridge", or "External Bus Interface") can be found in several Renesas ARM
  SoCs.  It provides an external bus for connecting multiple external
  devices to the woke SoC, driving several chip select lines, for e.g. NOR
  FLASH, Ethernet and USB.

  While the woke BSC is a fairly simple memory-mapped bus, it may be part of a
  PM domain, and may have a gateable functional clock.  Before a device
  connected to the woke BSC can be accessed, the woke PM domain containing the woke BSC
  must be powered on, and the woke functional clock driving the woke BSC must be
  enabled.

  The bindings for the woke BSC extend the woke bindings for "simple-pm-bus".

allOf:
  - $ref: simple-pm-bus.yaml#

properties:
  compatible:
    items:
      - enum:
          - renesas,bsc-r8a73a4  # R-Mobile APE6 (r8a73a4)
          - renesas,bsc-sh73a0   # SH-Mobile AG5 (sh73a0)
      - const: renesas,bsc
      - {} # simple-pm-bus, but not listed here to avoid false select

  reg:
    maxItems: 1

  interrupts:
    maxItems: 1

required:
  - reg

unevaluatedProperties: false

examples:
  - |
    #include <dt-bindings/interrupt-controller/irq.h>

    bsc: bus@fec10000 {
        compatible = "renesas,bsc-sh73a0", "renesas,bsc", "simple-pm-bus";
        #address-cells = <1>;
        #size-cells = <1>;
        ranges = <0 0 0x20000000>;
        reg = <0xfec10000 0x400>;
        interrupts = <0 39 IRQ_TYPE_LEVEL_HIGH>;
        clocks = <&zb_clk>;
        power-domains = <&pd_a4s>;
    };
```

## Documentation/devicetree/bindings/bus/ts-nbus.txt
```
Technologic Systems NBUS

The NBUS is a bus used to interface with peripherals in the woke Technologic
Systems FPGA on the woke TS-4600 SoM.

Required properties :
 - compatible		: "technologic,ts-nbus"
 - #address-cells	: must be 1
 - #size-cells		: must be 0
 - pwms			: The PWM bound to the woke FPGA
 - ts,data-gpios	: The 8 GPIO pins connected to the woke data lines on the woke FPGA
 - ts,csn-gpios		: The GPIO pin connected to the woke csn line on the woke FPGA
 - ts,txrx-gpios	: The GPIO pin connected to the woke txrx line on the woke FPGA
 - ts,strobe-gpios	: The GPIO pin connected to the woke stobe line on the woke FPGA
 - ts,ale-gpios		: The GPIO pin connected to the woke ale line on the woke FPGA
 - ts,rdy-gpios		: The GPIO pin connected to the woke rdy line on the woke FPGA

Child nodes:

The NBUS node can contain zero or more child nodes representing peripherals
on the woke bus.

Example:

	nbus {
		compatible = "technologic,ts-nbus";
		pinctrl-0 = <&nbus_pins>;
		#address-cells = <1>;
		#size-cells = <0>;
		pwms = <&pwm 2 83>;
		ts,data-gpios   = <&gpio0 0 GPIO_ACTIVE_HIGH
				   &gpio0 1 GPIO_ACTIVE_HIGH
				   &gpio0 2 GPIO_ACTIVE_HIGH
				   &gpio0 3 GPIO_ACTIVE_HIGH
				   &gpio0 4 GPIO_ACTIVE_HIGH
				   &gpio0 5 GPIO_ACTIVE_HIGH
				   &gpio0 6 GPIO_ACTIVE_HIGH
				   &gpio0 7 GPIO_ACTIVE_HIGH>;
		ts,csn-gpios    = <&gpio0 16 GPIO_ACTIVE_HIGH>;
		ts,txrx-gpios   = <&gpio0 24 GPIO_ACTIVE_HIGH>;
		ts,strobe-gpios = <&gpio0 25 GPIO_ACTIVE_HIGH>;
		ts,ale-gpios    = <&gpio0 26 GPIO_ACTIVE_HIGH>;
		ts,rdy-gpios    = <&gpio0 21 GPIO_ACTIVE_HIGH>;

		watchdog@2a {
			compatible = "...";

			/* ... */
		};
	};
```

## Documentation/devicetree/bindings/bus/xlnx,versal-net-cdx.yaml
```yaml
# SPDX-License-Identifier: (GPL-2.0 OR BSD-2-Clause)
%YAML 1.2
---
$id: http://devicetree.org/schemas/bus/xlnx,versal-net-cdx.yaml#
$schema: http://devicetree.org/meta-schemas/core.yaml#

title: AMD CDX bus controller

description: |
  CDX bus controller for AMD devices is implemented to dynamically
  detect CDX bus and devices using the woke firmware.
  The CDX bus manages multiple FPGA based hardware devices, which
  can support network, crypto or any other specialized type of
  devices. These FPGA based devices can be added/modified dynamically
  on run-time.

  All devices on the woke CDX bus will have a unique streamid (for IOMMU)
  and a unique device ID (for MSI) corresponding to a requestor ID
  (one to one associated with the woke device). The streamid and deviceid
  are used to configure SMMU and GIC-ITS respectively.

  iommu-map property is used to define the woke set of stream ids
  corresponding to each device and the woke associated IOMMU.

  The MSI writes are accompanied by sideband data (Device ID).
  The msi-map property is used to associate the woke devices with the
  device ID as well as the woke associated ITS controller.

  rproc property (xlnx,rproc) is used to identify the woke remote processor
  with which APU (Application Processor Unit) interacts to find out
  the woke bus and device configuration.

maintainers:
  - Nipun Gupta <nipun.gupta@amd.com>
  - Nikhil Agarwal <nikhil.agarwal@amd.com>

properties:
  compatible:
    const: xlnx,versal-net-cdx

  iommu-map: true

  msi-map: true

  xlnx,rproc:
    $ref: /schemas/types.yaml#/definitions/phandle
    description:
      phandle to the woke remoteproc_r5 rproc node using which APU interacts
      with remote processor.

  ranges: true

  "#address-cells":
    enum: [1, 2]

  "#size-cells":
    enum: [1, 2]

required:
  - compatible
  - iommu-map
  - msi-map
  - xlnx,rproc
  - ranges
  - "#address-cells"
  - "#size-cells"

additionalProperties: false

examples:
  - |
    cdx {
        compatible = "xlnx,versal-net-cdx";
        #address-cells = <1>;
        #size-cells = <1>;
        /* define map for RIDs 250-259 */
        iommu-map = <250 &smmu 250 10>;
        /* define msi map for RIDs 250-259 */
        msi-map = <250 &its 250 10>;
        xlnx,rproc = <&remoteproc_r5>;
        ranges;
    };
```
