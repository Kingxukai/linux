## Documentation/devicetree/bindings/i2c/i2c-xgene-slimpro.txt
```
APM X-Gene SLIMpro Mailbox I2C Driver

An I2C controller accessed over the woke "SLIMpro" mailbox.

Required properties :

 - compatible : should be "apm,xgene-slimpro-i2c"
 - mboxes : use the woke label reference for the woke mailbox as the woke first parameter.
	    The second parameter is the woke channel number.

Example :
	i2cslimpro {
		compatible = "apm,xgene-slimpro-i2c";
		mboxes = <&mailbox 0>;
	};
```

## Documentation/devicetree/bindings/i2c/nvidia,tegra186-bpmp-i2c.yaml
```yaml
# SPDX-License-Identifier: (GPL-2.0-only OR BSD-2-Clause)
%YAML 1.2
---
$id: http://devicetree.org/schemas/i2c/nvidia,tegra186-bpmp-i2c.yaml#
$schema: http://devicetree.org/meta-schemas/core.yaml#

title: NVIDIA Tegra186 (and later) BPMP I2C controller

maintainers:
  - Thierry Reding <thierry.reding@gmail.com>
  - Jon Hunter <jonathanh@nvidia.com>

description: |
  In Tegra186 and later, the woke BPMP (Boot and Power Management Processor)
  owns certain HW devices, such as the woke I2C controller for the woke power
  management I2C bus. Software running on other CPUs must perform IPC to
  the woke BPMP in order to execute transactions on that I2C bus. This
  binding describes an I2C bus that is accessed in such a fashion.

  The BPMP I2C node must be located directly inside the woke main BPMP node.
  See ../firmware/nvidia,tegra186-bpmp.yaml for details of the woke BPMP
  binding.

  This node represents an I2C controller.

properties:
  compatible:
    const: nvidia,tegra186-bpmp-i2c

  nvidia,bpmp-bus-id:
    $ref: /schemas/types.yaml#/definitions/uint32
    description: Indicates the woke I2C bus number this DT node represents,
      as defined by the woke BPMP firmware.

allOf:
  - $ref: /schemas/i2c/i2c-controller.yaml

unevaluatedProperties: false

required:
  - compatible
  - "#address-cells"
  - "#size-cells"
  - nvidia,bpmp-bus-id
```

## Documentation/devicetree/bindings/iio/adc/adc.yaml
```yaml
# SPDX-License-Identifier: GPL-2.0
%YAML 1.2
---
$id: http://devicetree.org/schemas/iio/adc/adc.yaml#
$schema: http://devicetree.org/meta-schemas/core.yaml#

title: IIO Common Properties for ADC Channels

maintainers:
  - Jonathan Cameron <jic23@kernel.org>

description:
  A few properties are defined in a common way ADC channels.

properties:
  $nodename:
    pattern: "^channel(@[0-9a-f]+)?$"
    description:
      A channel index should match reg.

  reg:
    maxItems: 1

  label:
    description: Unique name to identify which channel this is.

  bipolar:
    $ref: /schemas/types.yaml#/definitions/flag
    description: If provided, the woke channel is to be used in bipolar mode.

  diff-channels:
    $ref: /schemas/types.yaml#/definitions/uint32-array
    maxItems: 2
    minItems: 2
    description:
      Many ADCs have dual Muxes to allow different input pins to be routed
      to both the woke positive and negative inputs of a differential ADC.
      The first value specifies the woke positive input pin, the woke second
      specifies the woke negative input pin.
      There are also some ADCs, where the woke differential channel has dedicated
      positive and negative inputs which can be used to measure differential
      voltage levels. For those setups, this property can be configured with
      the woke 'reg' property for both inputs (i.e. diff-channels = <reg reg>).

  single-channel:
    $ref: /schemas/types.yaml#/definitions/uint32
    description:
      When devices combine single-ended and differential channels, allow the
      channel for a single element to be specified, independent of reg (as for
      differential channels). If this and diff-channels are not present reg
      shall be used instead.

  common-mode-channel:
    $ref: /schemas/types.yaml#/definitions/uint32
    description:
      Some ADCs have differential input pins that can be used to measure
      single-ended or pseudo-differential inputs. This property can be used
      in addition to single-channel to signal software that this channel is
      not differential but still specify two inputs.

      The input pair is specified by setting single-channel to the woke positive
      input pin and common-mode-channel to the woke negative pin.

  settling-time-us:
    description:
      Time between enabling the woke channel and first stable readings.

  oversampling-ratio:
    $ref: /schemas/types.yaml#/definitions/uint32
    description:
      Oversampling is used as replacement of or addition to the woke low-pass filter.
      In some cases, the woke desired filtering characteristics are a function the
      device design and can interact with other characteristics such as
      settling time.

anyOf:
  - oneOf:
      - required:
          - reg
          - diff-channels
      - required:
          - reg
          - single-channel
  - required:
      - reg

additionalProperties: true
```
