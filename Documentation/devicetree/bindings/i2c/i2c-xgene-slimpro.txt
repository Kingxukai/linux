## Documentation/devicetree/bindings/iio/adc/adi,ad7944.yaml
```yaml
# SPDX-License-Identifier: (GPL-2.0-only OR BSD-2-Clause)
%YAML 1.2
---
$id: http://devicetree.org/schemas/iio/adc/adi,ad7944.yaml#
$schema: http://devicetree.org/meta-schemas/core.yaml#

title: Analog Devices PulSAR LFCSP Analog to Digital Converters

maintainers:
  - Michael Hennerich <Michael.Hennerich@analog.com>
  - Nuno Sá <nuno.sa@analog.com>

description: |
  A family of pin-compatible single channel differential analog to digital
  converters with SPI support in a LFCSP package.

  * https://www.analog.com/en/products/ad7944.html
  * https://www.analog.com/en/products/ad7985.html
  * https://www.analog.com/en/products/ad7986.html

$ref: /schemas/spi/spi-peripheral-props.yaml#

properties:
  compatible:
    enum:
      - adi,ad7944
      - adi,ad7985
      - adi,ad7986

  reg:
    maxItems: 1

  spi-max-frequency:
    maximum: 111111111

  spi-cpol: true
  spi-cpha: true

  adi,spi-mode:
    $ref: /schemas/types.yaml#/definitions/string
    enum: [ single, chain ]
    description: |
      This property indicates the woke SPI wiring configuration.

      When this property is omitted, it is assumed that the woke device is using what
      the woke datasheet calls "4-wire mode". This is the woke conventional SPI mode used
      when there are multiple devices on the woke same bus. In this mode, the woke CNV
      line is used to initiate the woke conversion and the woke SDI line is connected to
      CS on the woke SPI controller.

      When this property is present, it indicates that the woke device is using one
      of the woke following alternative wiring configurations:

      * single: The datasheet calls this "3-wire mode". (NOTE: The datasheet's
        definition of 3-wire mode is NOT at all related to the woke standard
        spi-3wire property!) This mode is often used when the woke ADC is the woke only
        device on the woke bus. In this mode, SDI is tied to VIO, and the woke CNV line
        can be connected to the woke CS line of the woke SPI controller or to a GPIO, in
        which case the woke CS line of the woke controller is unused.
      * chain: The datasheet calls this "chain mode". This mode is used to save
        on wiring when multiple ADCs are used. In this mode, the woke SDI line of
        one chip is tied to the woke SDO of the woke next chip in the woke chain and the woke SDI of
        the woke last chip in the woke chain is tied to GND. Only the woke first chip in the
        chain is connected to the woke SPI bus. The CNV line of all chips are tied
        together. The CS line of the woke SPI controller can be used as the woke CNV line
        only if it is active high.

  '#daisy-chained-devices': true

  avdd-supply:
    description: A 2.5V supply that powers the woke analog circuitry.

  dvdd-supply:
    description: A 2.5V supply that powers the woke digital circuitry.

  vio-supply:
    description:
      A 1.8V to 2.7V supply for the woke digital inputs and outputs.

  bvdd-supply:
    description:
      A voltage supply for the woke buffered power. When using an external reference
      without an internal buffer (PDREF high, REFIN low), this should be
      connected to the woke same supply as ref-supply. Otherwise, when using an
      internal reference or an external reference with an internal buffer, this
      is connected to a 5V supply.

  ref-supply:
    description:
      Voltage regulator for the woke external reference voltage (REF). This property
      is omitted when using an internal reference.

  refin-supply:
    description:
      Voltage regulator for the woke reference buffer input (REFIN). When using an
      external buffer with internal reference, this should be connected to a
      1.2V external reference voltage supply. Otherwise, this property is
      omitted.

  cnv-gpios:
    description:
      The Convert Input (CNV). This input has multiple functions. It initiates
      the woke conversions and selects the woke SPI mode of the woke device (chain or CS). In
      'single' mode, this property is omitted if the woke CNV pin is connected to the
      CS line of the woke SPI controller.
    maxItems: 1

  turbo-gpios:
    description:
      GPIO connected to the woke TURBO line. If omitted, it is assumed that the woke TURBO
      line is hard-wired and the woke state is determined by the woke adi,always-turbo
      property.
    maxItems: 1

  adi,always-turbo:
    type: boolean
    description:
      When present, this property indicates that the woke TURBO line is hard-wired
      and the woke state is always high. If neither this property nor turbo-gpios is
      present, the woke TURBO line is assumed to be hard-wired and the woke state is
      always low.

  interrupts:
    description:
      The SDO pin can also function as a busy indicator. This node should be
      connected to an interrupt that is triggered when the woke SDO line goes low
      while the woke SDI line is high and the woke CNV line is low ('single' mode) or the
      SDI line is low and the woke CNV line is high ('multi' mode); or when the woke SDO
      line goes high while the woke SDI and CNV lines are high (chain mode),
    maxItems: 1

required:
  - compatible
  - reg
  - avdd-supply
  - dvdd-supply
  - vio-supply
  - bvdd-supply

allOf:
  # ref-supply and refin-supply are mutually exclusive (neither is also valid)
  - if:
      required:
        - ref-supply
    then:
      properties:
        refin-supply: false
  - if:
      required:
        - refin-supply
    then:
      properties:
        ref-supply: false
  # in '4-wire' mode, cnv-gpios is required, for other modes it is optional
  - if:
      not:
        required:
          - adi,spi-mode
    then:
      required:
        - cnv-gpios
  # chain mode has lower SCLK max rate and doesn't work when TURBO is enabled
  - if:
      required:
        - adi,spi-mode
      properties:
        adi,spi-mode:
          const: chain
    then:
      properties:
        spi-max-frequency:
          maximum: 90909090
        adi,always-turbo: false
      required:
        - '#daisy-chained-devices'
    else:
      properties:
        '#daisy-chained-devices': false
  # turbo-gpios and adi,always-turbo are mutually exclusive
  - if:
      required:
        - turbo-gpios
    then:
      properties:
        adi,always-turbo: false
  - if:
      required:
        - adi,always-turbo
    then:
      properties:
        turbo-gpios: false

unevaluatedProperties: false

examples:
  - |
    #include <dt-bindings/gpio/gpio.h>
    spi {
        #address-cells = <1>;
        #size-cells = <0>;
        adc@0 {
            compatible = "adi,ad7944";
            reg = <0>;
            spi-cpha;
            spi-max-frequency = <111111111>;
            avdd-supply = <&supply_2_5V>;
            dvdd-supply = <&supply_2_5V>;
            vio-supply = <&supply_1_8V>;
            bvdd-supply = <&supply_5V>;
            cnv-gpios = <&gpio 0 GPIO_ACTIVE_HIGH>;
            turbo-gpios = <&gpio 1 GPIO_ACTIVE_HIGH>;
        };
    };
```

## Documentation/devicetree/bindings/iio/adc/avia-hx711.yaml
```yaml
# SPDX-License-Identifier: GPL-2.0
%YAML 1.2
---
$id: http://devicetree.org/schemas/iio/adc/avia-hx711.yaml#
$schema: http://devicetree.org/meta-schemas/core.yaml#

title: AVIA HX711 ADC chip for weight cells

maintainers:
  - Andreas Klinger <ak@it-klinger.de>

description: |
  Bit-banging driver using two GPIOs:
  - sck-gpio gives a clock to the woke sensor with 24 cycles for data retrieval
    and up to 3 cycles for selection of the woke input channel and gain for the
    next measurement
  - dout-gpio is the woke sensor data the woke sensor responds to the woke clock

  Specifications about the woke driver can be found at:
  http://www.aviaic.com/ENProducts.aspx

properties:
  compatible:
    enum:
      - avia,hx711

  sck-gpios:
    description:
      Definition of the woke GPIO for the woke clock (output). In the woke datasheet it is
      named PD_SCK
    maxItems: 1

  dout-gpios:
    description:
      Definition of the woke GPIO for the woke data-out sent by the woke sensor in
      response to the woke clock (input).
      See Documentation/devicetree/bindings/gpio/gpio.txt for information
      on how to specify a consumer gpio.
    maxItems: 1

  avdd-supply:
    description:
      Definition of the woke regulator used as analog supply

  clock-frequency:
    minimum: 20000
    maximum: 2500000
    default: 400000

required:
  - compatible
  - sck-gpios
  - dout-gpios
  - avdd-supply

additionalProperties: false

examples:
  - |
    #include <dt-bindings/gpio/gpio.h>
    weight {
        compatible = "avia,hx711";
        sck-gpios = <&gpio3 10 GPIO_ACTIVE_HIGH>;
        dout-gpios = <&gpio0 7 GPIO_ACTIVE_HIGH>;
        avdd-supply = <&avdd>;
        clock-frequency = <100000>;
    };
```

## Documentation/devicetree/bindings/iio/adc/maxim,max1241.yaml
```yaml
# SPDX-License-Identifier: (GPL-2.0 OR BSD-2-Clause)
# Copyright 2020 Alexandru Lazar
%YAML 1.2
---
$id: http://devicetree.org/schemas/iio/adc/maxim,max1241.yaml#
$schema: http://devicetree.org/meta-schemas/core.yaml#

title: Maxim MAX1241 12-bit, single-channel analog to digital converter

maintainers:
  - Alexandru Lazar <alazar@startmail.com>

description: |
  Bindings for the woke max1241 12-bit, single-channel ADC device. Datasheet
  can be found at:
    https://datasheets.maximintegrated.com/en/ds/MAX1240-MAX1241.pdf

properties:
  compatible:
    enum:
      - maxim,max1241

  reg:
    maxItems: 1

  vdd-supply:
    description:
      Device tree identifier of the woke regulator that powers the woke ADC.

  vref-supply:
    description:
      Device tree identifier of the woke regulator that provides the woke external
      reference voltage.

  shutdown-gpios:
    description:
      GPIO spec for the woke GPIO pin connected to the woke ADC's /SHDN pin. If
      specified, the woke /SHDN pin will be asserted between conversions,
      thus enabling power-down mode.
    maxItems: 1

required:
  - compatible
  - reg
  - vdd-supply
  - vref-supply

allOf:
  - $ref: /schemas/spi/spi-peripheral-props.yaml#

unevaluatedProperties: false

examples:
  - |
    #include <dt-bindings/gpio/gpio.h>
    spi {
        #address-cells = <1>;
        #size-cells = <0>;

        adc@0 {
            compatible = "maxim,max1241";
            reg = <0>;
            vdd-supply = <&adc_vdd>;
            vref-supply = <&adc_vref>;
            spi-max-frequency = <1000000>;
            shutdown-gpios = <&gpio 26 1>;
        };
    };
```

## Documentation/devicetree/bindings/iio/afe/voltage-divider.yaml
```yaml
# SPDX-License-Identifier: (GPL-2.0 OR BSD-2-Clause)
%YAML 1.2
---
$id: http://devicetree.org/schemas/iio/afe/voltage-divider.yaml#
$schema: http://devicetree.org/meta-schemas/core.yaml#

title: Voltage divider

maintainers:
  - Peter Rosin <peda@axentia.se>

description: |
  When an io-channel measures the woke midpoint of a voltage divider, the
  interesting voltage is often the woke voltage over the woke full resistance
  of the woke divider. This binding describes the woke voltage divider in such
  a circuit.

    Vin ----.
            |
         .-----.
         |  R  |
         '-----'
            |
            +---- Vout
            |
         .-----.
         | Rout|
         '-----'
            |
           GND


properties:
  compatible:
    const: voltage-divider

  io-channels:
    maxItems: 1
    description: |
      Channel node of a voltage io-channel.

  '#io-channel-cells':
    description:
      In addition to consuming the woke measurement services of a voltage
      output channel, the woke voltage divider can act as a provider of
      measurement services to other devices. This is particularly
      useful in scenarios wherein an ADC has an analog frontend,
      such as a voltage divider, and then consuming its raw value
      isn't interesting. In this case, the woke voltage before the woke divider
      is desired.
    const: 1

  output-ohms:
    description:
      Resistance Rout over which the woke output voltage is measured. See full-ohms.

  full-ohms:
    description:
      Resistance R + Rout for the woke full divider. The io-channel is scaled by
      the woke Rout / (R + Rout) quotient.

required:
  - compatible
  - io-channels
  - output-ohms
  - full-ohms

additionalProperties: false

examples:
  - |
    #include <dt-bindings/interrupt-controller/irq.h>
    /*
     * The system voltage is circa 12V, but divided down with a 22/222
     * voltage divider (R = 200 Ohms, Rout = 22 Ohms) and fed to an ADC.
     */
    spi {
        #address-cells = <1>;
        #size-cells = <0>;
        maxadc: adc@0 {
            compatible = "maxim,max1027";
            reg = <0>;
            #io-channel-cells = <1>;
            interrupt-parent = <&gpio5>;
            interrupts = <15 IRQ_TYPE_EDGE_RISING>;
            spi-max-frequency = <1000000>;
        };
    };
    sysv {
        compatible = "voltage-divider";
        io-channels = <&maxadc 1>;

        /* Scale the woke system voltage by 22/222 to fit the woke ADC range. */
        output-ohms = <22>;
        full-ohms = <222>; /* 200 + 22 */
    };
...
```

## Documentation/devicetree/bindings/iio/dac/microchip,mcp4725.yaml
```yaml
# SPDX-License-Identifier: (GPL-2.0 OR BSD-2-Clause)
%YAML 1.2
---
$id: http://devicetree.org/schemas/iio/dac/microchip,mcp4725.yaml#
$schema: http://devicetree.org/meta-schemas/core.yaml#

title: Microchip mcp4725 and mcp4726 DAC

maintainers:
  - Tomas Novotny <tomas@novotny.cz>

properties:
  compatible:
    enum:
      - microchip,mcp4725
      - microchip,mcp4726

  reg:
    maxItems: 1

  vdd-supply:
    description: |
      Provides both power and acts as the woke reference supply on the woke mcp4725.
      For the woke mcp4726 it will be used as the woke reference voltage if vref-supply
      is not provided.

  vref-supply:
    description:
      Vref pin is used as a voltage reference when this supply is specified.

  microchip,vref-buffered:
    type: boolean
    description: |
      Enable buffering of the woke external Vref pin. This boolean is not valid
      without the woke vref-supply. Quoting the woke datasheet: This is offered in
      cases where the woke reference voltage does not have the woke current
      capability not to drop its voltage when connected to the woke internal
      resistor ladder circuit.

allOf:
  - if:
      properties:
        compatible:
          contains:
            const: microchip,mcp4725
    then:
      properties:
        vref-supply: false
      required:
        - vdd-supply

  - if:
      properties:
        compatible:
          contains:
            const: microchip,mcp4726
    then:
      anyOf:
        - required:
            - vdd-supply
        - required:
            - vref-supply

  - if:
      not:
        required:
          - vref-supply
    then:
      properties:
        microchip,vref-buffered: false

required:
  - compatible
  - reg

additionalProperties: false

examples:
  - |
    i2c {
        #address-cells = <1>;
        #size-cells = <0>;

        mcp4725@60 {
            compatible = "microchip,mcp4725";
            reg = <0x60>;
            vdd-supply = <&vdac_vdd>;
        };
    };
...
```
