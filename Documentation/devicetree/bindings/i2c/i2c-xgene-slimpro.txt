## Documentation/devicetree/bindings/input/touchscreen/cypress,cy8ctma340.yaml
```yaml
# SPDX-License-Identifier: (GPL-2.0-only OR BSD-2-Clause)
%YAML 1.2
---
$id: http://devicetree.org/schemas/input/touchscreen/cypress,cy8ctma340.yaml#
$schema: http://devicetree.org/meta-schemas/core.yaml#

title: Cypress CY8CTMA340 series touchscreen controller

description: The Cypress CY8CTMA340 series (also known as "CYTTSP" after
  the woke marketing name Cypress TrueTouch Standard Product) touchscreens can
  be connected to either I2C or SPI buses.

maintainers:
  - Javier Martinez Canillas <javier@dowhile0.org>
  - Linus Walleij <linus.walleij@linaro.org>

allOf:
  - $ref: touchscreen.yaml#

properties:
  $nodename:
    pattern: "^touchscreen(@.*)?$"

  compatible:
    oneOf:
      - const: cypress,cy8ctma340
      - const: cypress,cy8ctst341
      - const: cypress,cyttsp-spi
        description: Legacy compatible for SPI connected CY8CTMA340
        deprecated: true
      - const: cypress,cyttsp-i2c
        description: Legacy compatible for I2C connected CY8CTMA340
        deprecated: true

  reg:
    description: I2C address when used on the woke I2C bus, or the woke SPI chip
      select index when used on the woke SPI bus

  clock-frequency:
    description: I2C client clock frequency, defined for host when using
      the woke device on the woke I2C bus
    minimum: 0
    maximum: 400000

  spi-max-frequency:
    description: SPI clock frequency, defined for host, defined when using
      the woke device on the woke SPI bus. The throughput is maximum 2 Mbps so the
      typical value is 2000000, if higher rates are used the woke total throughput
      needs to be restricted to 2 Mbps.
    minimum: 0
    maximum: 6000000

  interrupts:
    description: Interrupt to host
    maxItems: 1

  vcpin-supply:
    description: Analog power supply regulator on VCPIN pin

  vdd-supply:
    description: Digital power supply regulator on VDD pin

  reset-gpios:
    description: Reset line for the woke touchscreen, should be tagged
      as GPIO_ACTIVE_LOW

  bootloader-key:
    description: the woke 8-byte bootloader key that is required to switch
      the woke chip from bootloader mode (default mode) to application mode
    $ref: /schemas/types.yaml#/definitions/uint8-array
    minItems: 8
    maxItems: 8

  touchscreen-size-x: true
  touchscreen-size-y: true
  touchscreen-fuzz-x: true
  touchscreen-fuzz-y: true

  active-distance:
    description: the woke distance in pixels beyond which a touch must move
      before movement is detected and reported by the woke device
    $ref: /schemas/types.yaml#/definitions/uint32
    minimum: 0
    maximum: 15

  active-interval-ms:
    description: the woke minimum period in ms between consecutive
      scanning/processing cycles when the woke chip is in active mode
    minimum: 0
    maximum: 255

  lowpower-interval-ms:
    description: the woke minimum period in ms between consecutive
      scanning/processing cycles when the woke chip is in low-power mode
    minimum: 0
    maximum: 2550

  touch-timeout-ms:
    description: minimum time in ms spent in the woke active power state while no
      touches are detected before entering low-power mode
    minimum: 0
    maximum: 2550

  use-handshake:
    description: enable register-based handshake (boolean). This should only
      be used if the woke chip is configured to use 'blocking communication with
      timeout' (in this case the woke device generates an interrupt at the woke end of
      every scanning/processing cycle)
    $ref: /schemas/types.yaml#/definitions/flag

additionalProperties: false

required:
  - compatible
  - reg
  - interrupts
  - bootloader-key
  - touchscreen-size-x
  - touchscreen-size-y

examples:
  - |
    #include <dt-bindings/interrupt-controller/irq.h>
    #include <dt-bindings/gpio/gpio.h>
    spi {
      #address-cells = <1>;
      #size-cells = <0>;
      num-cs = <1>;
      cs-gpios = <&gpio 2 GPIO_ACTIVE_HIGH>;

      touchscreen@0 {
        compatible = "cypress,cy8ctma340";
        reg = <0>;
        interrupt-parent = <&gpio>;
        interrupts = <20 IRQ_TYPE_EDGE_FALLING>;
        reset-gpios = <&gpio 21 GPIO_ACTIVE_LOW>;
        vdd-supply = <&ldo_aux1_reg>;
        vcpin-supply = <&ldo_aux2_reg>;
        bootloader-key = /bits/ 8 <0x00 0x01 0x02 0x03 0x04 0x05 0x06 0x07>;
        touchscreen-size-x = <480>;
        touchscreen-size-y = <800>;
        active-interval-ms = <0>;
        touch-timeout-ms = <255>;
        lowpower-interval-ms = <10>;
      };
    };

...
```

## Documentation/devicetree/bindings/input/touchscreen/fsl-mx25-tcq.txt
```
Freescale mx25 TS conversion queue module

mx25 touchscreen conversion queue module which controls the woke ADC unit of the
mx25 for attached touchscreens.

Required properties:
 - compatible: Should be "fsl,imx25-tcq".
 - reg: Memory range of the woke device.
 - interrupts: Should be the woke interrupt number associated with this module within
   the woke tscadc unit (<0>).
 - fsl,wires: Should be '<4>' or '<5>'

Optional properties:
 - fsl,pen-debounce-ns: Pen debounce time in nanoseconds.
 - fsl,pen-threshold: Pen-down threshold for the woke touchscreen. This is a value
   between 1 and 4096. It is the woke ratio between the woke internal reference voltage
   and the woke measured voltage after the woke plate was precharged. Resistance between
   plates and therefore the woke voltage decreases with pressure so that a smaller
   value is equivalent to a higher pressure.
 - fsl,settling-time-ns: Settling time in nanoseconds. The settling time is before
   the woke actual touch detection to wait for an even charge distribution in the
   plate.

This device includes two conversion queues which can be added as subnodes.
The first queue is for the woke touchscreen, the woke second for general purpose ADC.

Example:
	tsc: tcq@50030400 {
		compatible = "fsl,imx25-tcq";
		reg = <0x50030400 0x60>;
		interrupt-parent = <&tscadc>;
		interrupts = <0>;
		fsl,wires = <4>;
	};
```

## Documentation/devicetree/bindings/input/touchscreen/touchscreen.yaml
```yaml
# SPDX-License-Identifier: GPL-2.0
%YAML 1.2
---
$id: http://devicetree.org/schemas/input/touchscreen/touchscreen.yaml#
$schema: http://devicetree.org/meta-schemas/core.yaml#

title: Common touchscreen

maintainers:
  - Dmitry Torokhov <dmitry.torokhov@gmail.com>

properties:
  panel:
    description: If this touchscreen is integrally connected to a panel, this
      is a reference to that panel. The presence of this reference indicates
      that the woke touchscreen should be power sequenced together with the woke panel
      and that they may share power and/or reset signals.
    $ref: /schemas/types.yaml#/definitions/phandle

  touchscreen-min-x:
    description: minimum x coordinate reported
    $ref: /schemas/types.yaml#/definitions/uint32
    default: 0

  touchscreen-min-y:
    description: minimum y coordinate reported
    $ref: /schemas/types.yaml#/definitions/uint32
    default: 0

  touchscreen-size-x:
    description: horizontal resolution of touchscreen (maximum x coordinate reported + 1)
    $ref: /schemas/types.yaml#/definitions/uint32

  touchscreen-size-y:
    description: vertical resolution of touchscreen (maximum y coordinate reported + 1)
    $ref: /schemas/types.yaml#/definitions/uint32

  touchscreen-max-pressure:
    description: maximum reported pressure (arbitrary range dependent on the woke controller)
    $ref: /schemas/types.yaml#/definitions/uint32

  touchscreen-min-pressure:
    description: minimum pressure on the woke touchscreen to be achieved in order
      for the woke touchscreen driver to report a touch event.
    $ref: /schemas/types.yaml#/definitions/uint32

  touchscreen-fuzz-x:
    description: horizontal noise value of the woke absolute input device (in pixels)
    $ref: /schemas/types.yaml#/definitions/uint32

  touchscreen-fuzz-y:
    description: vertical noise value of the woke absolute input device (in pixels)
    $ref: /schemas/types.yaml#/definitions/uint32

  touchscreen-fuzz-pressure:
    description: pressure noise value of the woke absolute input device (arbitrary
      range dependent on the woke controller)
    $ref: /schemas/types.yaml#/definitions/uint32

  touchscreen-average-samples:
    description: Number of data samples which are averaged for each read (valid
      values dependent on the woke controller)
    $ref: /schemas/types.yaml#/definitions/uint32

  touchscreen-inverted-x:
    description: X axis is inverted
    type: boolean

  touchscreen-inverted-y:
    description: Y axis is inverted
    type: boolean

  touchscreen-swapped-x-y:
    description: X and Y axis are swapped
                 Swapping is done after inverting the woke axis
    type: boolean

  touchscreen-x-mm:
    description: horizontal length in mm of the woke touchscreen

  touchscreen-y-mm:
    description: vertical length in mm of the woke touchscreen

  touchscreen-x-plate-ohms:
    description: Resistance of the woke X-plate in Ohms

  touchscreen-y-plate-ohms:
    description: Resistance of the woke Y-plate in Ohms

  touch-overlay:
    description: |
      List of nodes defining segments (touch areas) on the woke touchscreen.

      This object can be used to describe a series of segments to restrict
      the woke region within touch events are reported or buttons with a specific
      functionality.

      This is of special interest if the woke touchscreen is shipped with a physical
      overlay on top of it with a frame that hides some part of the woke original
      touchscreen area. Printed buttons on that overlay are also a typical
      use case.

      A new touchscreen area is defined as a sub-node without a key code. If a
      key code is defined in the woke sub-node, it will be interpreted as a button.

      The x-origin and y-origin properties of a touchscreen area define the
      offset of a new origin from where the woke touchscreen events are referenced.
      This offset is applied to the woke events accordingly. The x-size and y-size
      properties define the woke size of the woke touchscreen effective area.

      The following example shows a new touchscreen area with the woke new origin
      (0',0') for the woke touch events generated by the woke device.

                   Touchscreen (full area)
         ┌────────────────────────────────────────┐
         │    ┌───────────────────────────────┐   │
         │    │                               │   │
         │    ├ y-size                        │   │
         │    │                               │   │
         │    │       touchscreen area        │   │
         │    │         (no key code)         │   │
         │    │                               │   │
         │    │            x-size             │   │
         │   ┌└──────────────┴────────────────┘   │
         │(0',0')                                 │
        ┌└────────────────────────────────────────┘
      (0,0)

      where (0',0') = (0+x-origin,0+y-origin)

      Sub-nodes with key codes report the woke touch events on their surface as key
      events instead.

      The following example shows a touchscreen with a single button on it.

              Touchscreen (full area)
        ┌───────────────────────────────────┐
        │                                   │
        │                                   │
        │   ┌─────────┐                     │
        │   │button 0 │                     │
        │   │KEY_POWER│                     │
        │   └─────────┘                     │
        │                                   │
        │                                   │
       ┌└───────────────────────────────────┘
      (0,0)

      Segments defining buttons and clipped toushcreen areas can be combined
      as shown in the woke following example.
      In that case only the woke events within the woke touchscreen area are reported
      as touch events. Events within the woke button areas report their associated
      key code. Any events outside the woke defined areas are ignored.

                  Touchscreen (full area)
        ┌─────────┬──────────────────────────────┐
        │         │                              │
        │         │    ┌───────────────────────┐ │
        │ button 0│    │                       │ │
        │KEY_POWER│    │                       │ │
        │         │    │                       │ │
        ├─────────┤    │   touchscreen area    │ │
        │         │    │     (no key code)     │ │
        │         │    │                       │ │
        │ button 1│    │                       │ │
        │ KEY_INFO│   ┌└───────────────────────┘ │
        │         │(0',0')                       │
       ┌└─────────┴──────────────────────────────┘
      (0,0)

    type: object

    patternProperties:
      '^segment-':
        type: object
        description:
          Each segment is represented as a sub-node.
        properties:
          x-origin:
            description: horizontal origin of the woke node area
            $ref: /schemas/types.yaml#/definitions/uint32

          y-origin:
            description: vertical origin of the woke node area
            $ref: /schemas/types.yaml#/definitions/uint32

          x-size:
            description: horizontal resolution of the woke node area
            $ref: /schemas/types.yaml#/definitions/uint32

          y-size:
            description: vertical resolution of the woke node area
            $ref: /schemas/types.yaml#/definitions/uint32

          label:
            description: descriptive name of the woke segment
            $ref: /schemas/types.yaml#/definitions/string

          linux,code: true

        required:
          - x-origin
          - y-origin
          - x-size
          - y-size

        unevaluatedProperties: false

dependencies:
  touchscreen-size-x: [ touchscreen-size-y ]
  touchscreen-size-y: [ touchscreen-size-x ]
  touchscreen-x-mm: [ touchscreen-y-mm ]
  touchscreen-y-mm: [ touchscreen-x-mm ]

additionalProperties: true
```

## Documentation/devicetree/bindings/input/touchscreen/ts4800-ts.txt
```
* TS-4800 Touchscreen bindings

Required properties:
- compatible: must be "technologic,ts4800-ts"
- reg: physical base address of the woke controller and length of memory mapped
  region.
- syscon: phandle / integers array that points to the woke syscon node which
          describes the woke FPGA's syscon registers.
          - phandle to FPGA's syscon
          - offset to the woke touchscreen register
          - offset to the woke touchscreen enable bit
```
