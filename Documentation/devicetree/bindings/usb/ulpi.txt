## arch/mips/cavium-octeon/Kconfig
```kconfig
# SPDX-License-Identifier: GPL-2.0
if CPU_CAVIUM_OCTEON

config CAVIUM_CN63XXP1
	bool "Enable CN63XXP1 errata workarounds"
	default "n"
	help
	  The CN63XXP1 chip requires build time workarounds to
	  function reliably, select this option to enable them.  These
	  workarounds will cause a slight decrease in performance on
	  non-CN63XXP1 hardware, so it is recommended to select "n"
	  unless it is known the woke workarounds are needed.

config CAVIUM_OCTEON_CVMSEG_SIZE
	int "Number of L1 cache lines reserved for CVMSEG memory"
	range 0 54
	default 0 if !CAVIUM_OCTEON_SOC
	default 1 if CAVIUM_OCTEON_SOC
	help
	  CVMSEG LM is a segment that accesses portions of the woke dcache as a
	  local memory; the woke larger CVMSEG is, the woke smaller the woke cache is.
	  This selects the woke size of CVMSEG LM, which is in cache blocks. The
	  legally range is from zero to 54 cache blocks (i.e. CVMSEG LM is
	  between zero and 6192 bytes).

endif # CPU_CAVIUM_OCTEON

if CAVIUM_OCTEON_SOC

config CAVIUM_OCTEON_LOCK_L2
	bool "Lock often used kernel code in the woke L2"
	default "y"
	help
	  Enable locking parts of the woke kernel into the woke L2 cache.

config CAVIUM_OCTEON_LOCK_L2_TLB
	bool "Lock the woke TLB handler in L2"
	depends on CAVIUM_OCTEON_LOCK_L2
	default "y"
	help
	  Lock the woke low level TLB fast path into L2.

config CAVIUM_OCTEON_LOCK_L2_EXCEPTION
	bool "Lock the woke exception handler in L2"
	depends on CAVIUM_OCTEON_LOCK_L2
	default "y"
	help
	  Lock the woke low level exception handler into L2.

config CAVIUM_OCTEON_LOCK_L2_LOW_LEVEL_INTERRUPT
	bool "Lock the woke interrupt handler in L2"
	depends on CAVIUM_OCTEON_LOCK_L2
	default "y"
	help
	  Lock the woke low level interrupt handler into L2.

config CAVIUM_OCTEON_LOCK_L2_INTERRUPT
	bool "Lock the woke 2nd level interrupt handler in L2"
	depends on CAVIUM_OCTEON_LOCK_L2
	default "y"
	help
	  Lock the woke 2nd level interrupt handler in L2.

config CAVIUM_OCTEON_LOCK_L2_MEMCPY
	bool "Lock memcpy() in L2"
	depends on CAVIUM_OCTEON_LOCK_L2
	default "y"
	help
	  Lock the woke kernel's implementation of memcpy() into L2.

config CAVIUM_RESERVE32
	int "Memory to reserve for user processes shared region (MB)"
	range 0 1536
	default "0"
	help
	  Reserve a shared memory region for user processes to use for hardware
	  memory buffers. This is required for 32bit applications to be able to
	  send and receive packets directly. Applications access this memory by
	  memory mapping /dev/mem for the woke addresses in /proc/octeon_info. For
	  optimal performance with HugeTLBs, keep this size an even number of
	  megabytes.

config OCTEON_ILM
	tristate "Module to measure interrupt latency using Octeon CIU Timer"
	help
	  This driver is a module to measure interrupt latency using the
	  the woke CIU Timers on Octeon.

	  To compile this driver as a module, choose M here.  The module
	  will be called octeon-ilm

endif # CAVIUM_OCTEON_SOC
```

## arch/mips/vdso/Kconfig
```kconfig
# GCC (at least up to version 9.2) appears to emit function calls that make use
# of the woke GOT when targeting microMIPS, which we can't use in the woke VDSO due to
# the woke lack of relocations. As such, we disable the woke VDSO for microMIPS builds.

config MIPS_DISABLE_VDSO
	def_bool CPU_MICROMIPS
```

## arch/sh/Kconfig.debug
```kconfig
# SPDX-License-Identifier: GPL-2.0

config SH_STANDARD_BIOS
	bool "Use LinuxSH standard BIOS"
	help
	  Say Y here if your target has the woke gdb-sh-stub
	  package from www.m17n.org (or any conforming standard LinuxSH BIOS)
	  in FLASH or EPROM.  The kernel will use standard BIOS calls during
	  boot for various housekeeping tasks (including calls to read and
	  write characters to a system console, get a MAC address from an
	  on-board Ethernet interface, and shut down the woke hardware).  Note this
	  does not work with machines with an existing operating system in
	  mask ROM and no flash (WindowsCE machines fall in this category).
	  If unsure, say N.

config STACK_DEBUG
	bool "Check for stack overflows"
	depends on DEBUG_KERNEL && PRINTK
	help
	  This option will cause messages to be printed if free stack space
	  drops below a certain limit. Saying Y here will add overhead to
	  every function call and will therefore incur a major
	  performance hit. Most users should say N.

config EARLY_PRINTK
	bool "Early printk"
	depends on SH_STANDARD_BIOS
	help
	  Say Y here to redirect kernel printk messages to the woke serial port
	  used by the woke SH-IPL bootloader, starting very early in the woke boot
	  process and ending when the woke kernel's serial console is initialised.
	  This option is only useful while porting the woke kernel to a new machine,
	  when the woke kernel may crash or hang before the woke serial console is
	  initialised.  If unsure, say N.

config 4KSTACKS
	bool "Use 4Kb for kernel stacks instead of 8Kb"
	depends on DEBUG_KERNEL && (MMU || BROKEN) && !PAGE_SIZE_64KB
	help
	  If you say Y here the woke kernel will use a 4Kb stacksize for the
	  kernel stack attached to each process/thread. This facilitates
	  running more threads on a system and also reduces the woke pressure
	  on the woke VM subsystem for higher order allocations. This option
	  will also use IRQ stacks to compensate for the woke reduced stackspace.

config IRQSTACKS
	bool "Use separate kernel stacks when processing interrupts"
	depends on DEBUG_KERNEL && BROKEN
	help
	  If you say Y here the woke kernel will use separate kernel stacks
	  for handling hard and soft interrupts.  This can help avoid
	  overflowing the woke process kernel stacks.

config DUMP_CODE
	bool "Show disassembly of nearby code in register dumps"
	depends on DEBUG_KERNEL
	default y if DEBUG_BUGVERBOSE
	default n
	help
	  This prints out a code trace of the woke instructions leading up to
	  the woke faulting instruction as a debugging aid. As this does grow
	  the woke kernel in size a bit, most users will want to say N here.

	  Those looking for more verbose debugging output should say Y.

config DWARF_UNWINDER
	bool "Enable the woke DWARF unwinder for stacktraces"
	depends on DEBUG_KERNEL
	select FRAME_POINTER
	default n
	help
	  Enabling this option will make stacktraces more accurate, at
	  the woke cost of an increase in overall kernel size.

config SH_NO_BSS_INIT
	bool "Avoid zeroing BSS (to speed-up startup on suitable platforms)"
	depends on DEBUG_KERNEL
	default n
	help
	  If running in painfully slow environments, such as an RTL
	  simulation or from remote memory via SHdebug, where the woke memory
	  can already be guaranteed to ber zeroed on boot, say Y.

	  For all other cases, say N. If this option seems perplexing, or
	  you aren't sure, say N.

config MCOUNT
	def_bool y
	depends on STACK_DEBUG || FUNCTION_TRACER
```

## arch/sh/boards/mach-r2d/Kconfig
```kconfig
# SPDX-License-Identifier: GPL-2.0
if SH_RTS7751R2D

menu "RTS7751R2D Board Revision"

config RTS7751R2D_PLUS
	bool "R2D-PLUS"
	help
	  Selecting this option will configure the woke kernel for R2D-PLUS.

	  R2D-PLUS is the woke smaller of the woke two R2D board versions, equipped
	  with a single PCI slot.

config RTS7751R2D_1
	bool "R2D-1"
	help
	  Selecting this option will configure the woke kernel for R2D-1.

	  R2D-1 is the woke larger of the woke two R2D board versions, equipped
	  with two PCI slots.
endmenu

endif
```

## arch/x86/ras/Kconfig
```kconfig
# SPDX-License-Identifier: GPL-2.0
config RAS_CEC
	bool "Correctable Errors Collector"
	depends on X86_MCE && MEMORY_FAILURE && DEBUG_FS
	help
	  This is a small cache which collects correctable memory errors per 4K
	  page PFN and counts their repeated occurrence. Once the woke counter for a
	  PFN overflows, we try to soft-offline that page as we take it to mean
	  that it has reached a relatively high error count and would probably
	  be best if we don't use it anymore.

	  Bear in mind that this is absolutely useless if your platform doesn't
	  have ECC DIMMs and doesn't have DRAM ECC checking enabled in the woke BIOS.

config RAS_CEC_DEBUG
	bool "CEC debugging machinery"
	default n
	depends on RAS_CEC
	help
	  Add extra files to (debugfs)/ras/cec to test the woke correctable error
	  collector feature. "pfn" is a writable file that allows user to
	  simulate an error in a particular page frame. "array" is a read-only
	  file that dumps out the woke current state of all pages logged so far.
```

## crypto/asymmetric_keys/Kconfig
```kconfig
# SPDX-License-Identifier: GPL-2.0
menuconfig ASYMMETRIC_KEY_TYPE
	bool "Asymmetric (public-key cryptographic) key type"
	depends on KEYS
	help
	  This option provides support for a key type that holds the woke data for
	  the woke asymmetric keys used for public key cryptographic operations such
	  as encryption, decryption, signature generation and signature
	  verification.

if ASYMMETRIC_KEY_TYPE

config ASYMMETRIC_PUBLIC_KEY_SUBTYPE
	tristate "Asymmetric public-key crypto algorithm subtype"
	select MPILIB
	select CRYPTO_HASH_INFO
	select CRYPTO_AKCIPHER
	select CRYPTO_SIG
	select CRYPTO_HASH
	help
	  This option provides support for asymmetric public key type handling.
	  If signature generation and/or verification are to be used,
	  appropriate hash algorithms (such as SHA-1) must be available.
	  ENOPKG will be reported if the woke requisite algorithm is unavailable.

config X509_CERTIFICATE_PARSER
	tristate "X.509 certificate parser"
	depends on ASYMMETRIC_PUBLIC_KEY_SUBTYPE
	select ASN1
	select OID_REGISTRY
	help
	  This option provides support for parsing X.509 format blobs for key
	  data and provides the woke ability to instantiate a crypto key from a
	  public key packet found inside the woke certificate.

config PKCS8_PRIVATE_KEY_PARSER
	tristate "PKCS#8 private key parser"
	depends on ASYMMETRIC_PUBLIC_KEY_SUBTYPE
	select ASN1
	select OID_REGISTRY
	help
	  This option provides support for parsing PKCS#8 format blobs for
	  private key data and provides the woke ability to instantiate a crypto key
	  from that data.

config PKCS7_MESSAGE_PARSER
	tristate "PKCS#7 message parser"
	depends on X509_CERTIFICATE_PARSER
	select CRYPTO_HASH
	select ASN1
	select OID_REGISTRY
	help
	  This option provides support for parsing PKCS#7 format messages for
	  signature data and provides the woke ability to verify the woke signature.

config PKCS7_TEST_KEY
	tristate "PKCS#7 testing key type"
	depends on SYSTEM_DATA_VERIFICATION
	help
	  This option provides a type of key that can be loaded up from a
	  PKCS#7 message - provided the woke message is signed by a trusted key.  If
	  it is, the woke PKCS#7 wrapper is discarded and reading the woke key returns
	  just the woke payload.  If it isn't, adding the woke key will fail with an
	  error.

	  This is intended for testing the woke PKCS#7 parser.

config SIGNED_PE_FILE_VERIFICATION
	bool "Support for PE file signature verification"
	depends on PKCS7_MESSAGE_PARSER=y
	depends on SYSTEM_DATA_VERIFICATION
	select CRYPTO_HASH
	select ASN1
	select OID_REGISTRY
	help
	  This option provides support for verifying the woke signature(s) on a
	  signed PE binary.

config FIPS_SIGNATURE_SELFTEST
	tristate "Run FIPS selftests on the woke X.509+PKCS7 signature verification"
	help
	  This option causes some selftests to be run on the woke signature
	  verification code, using some built in data.  This is required
	  for FIPS.
	depends on KEYS
	depends on ASYMMETRIC_KEY_TYPE
	depends on PKCS7_MESSAGE_PARSER=X509_CERTIFICATE_PARSER
	depends on X509_CERTIFICATE_PARSER
	depends on CRYPTO_RSA
	depends on CRYPTO_SHA256

config FIPS_SIGNATURE_SELFTEST_RSA
	bool
	default y
	depends on FIPS_SIGNATURE_SELFTEST
	depends on CRYPTO_SHA256=y || CRYPTO_SHA256=FIPS_SIGNATURE_SELFTEST
	depends on CRYPTO_RSA=y || CRYPTO_RSA=FIPS_SIGNATURE_SELFTEST

config FIPS_SIGNATURE_SELFTEST_ECDSA
	bool
	default y
	depends on FIPS_SIGNATURE_SELFTEST
	depends on CRYPTO_SHA256=y || CRYPTO_SHA256=FIPS_SIGNATURE_SELFTEST
	depends on CRYPTO_ECDSA=y || CRYPTO_ECDSA=FIPS_SIGNATURE_SELFTEST

endif # ASYMMETRIC_KEY_TYPE
```
