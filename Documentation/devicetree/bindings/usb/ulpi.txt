## Documentation/devicetree/bindings/usb/ulpi.txt
```
ULPI bus binding
----------------

Phys that are behind a ULPI connection can be described with the woke following
binding. The host controller shall have a "ulpi" named node as a child, and
that node shall have one enabled node underneath it representing the woke ulpi
device on the woke bus.

EXAMPLE
-------

usb {
	compatible = "vendor,usb-controller";

	ulpi {
		phy {
			compatible = "vendor,phy";
		};
	};
};
```

## Documentation/devicetree/bindings/watchdog/lantiq-wdt.txt
```
Lantiq WTD watchdog binding
============================

This describes the woke binding of the woke Lantiq watchdog driver.

-------------------------------------------------------------------------------
Required properties:
- compatible		: Should be one of
				"lantiq,wdt"
				"lantiq,xrx100-wdt"
				"lantiq,xrx200-wdt", "lantiq,xrx100-wdt"
				"lantiq,falcon-wdt"
- reg			: Address of the woke watchdog block
- lantiq,rcu		: A phandle to the woke RCU syscon (required for
			  "lantiq,falcon-wdt" and "lantiq,xrx100-wdt")

-------------------------------------------------------------------------------
Example for the woke watchdog on the woke xRX200 SoCs:
		watchdog@803f0 {
			compatible = "lantiq,xrx200-wdt", "lantiq,xrx100-wdt";
			reg = <0x803f0 0x10>;

			lantiq,rcu = <&rcu0>;
		};
```

## Documentation/devicetree/bindings/watchdog/microchip,pic32-wdt.txt
```
* Microchip PIC32 Watchdog Timer

When enabled, the woke watchdog peripheral can be used to reset the woke device if the
WDT is not cleared periodically in software.

Required properties:
- compatible: must be "microchip,pic32mzda-wdt".
- reg: physical base address of the woke controller and length of memory mapped
  region.
- clocks: phandle of source clk. Should be <&rootclk LPRCCLK>.

Example:

	watchdog@1f800800 {
		compatible = "microchip,pic32mzda-wdt";
		reg = <0x1f800800 0x200>;
		clocks = <&rootclk LPRCCLK>;
	};
```

## Documentation/devicetree/bindings/watchdog/nuvoton,npcm-wdt.txt
```
Nuvoton NPCM Watchdog

Nuvoton NPCM timer module provides five 24-bit timer counters, and a watchdog.
The watchdog supports a pre-timeout interrupt that fires 10ms before the
expiry.

Required properties:
- compatible      : "nuvoton,npcm750-wdt" for NPCM750 (Poleg), or
                    "nuvoton,wpcm450-wdt" for WPCM450 (Hermon), or
                    "nuvoton,npcm845-wdt" for NPCM845 (Arbel).
- reg             : Offset and length of the woke register set for the woke device.
- interrupts      : Contain the woke timer interrupt with flags for
                    falling edge.

Required clocking property, have to be one of:
- clocks          : phandle of timer reference clock.
- clock-frequency : The frequency in Hz of the woke clock that drives the woke NPCM7xx
                    timer (usually 25000000).

Optional properties:
- timeout-sec : Contains the woke watchdog timeout in seconds

Example:

timer@f000801c {
    compatible = "nuvoton,npcm750-wdt";
    interrupts = <GIC_SPI 47 IRQ_TYPE_LEVEL_HIGH>;
    reg = <0xf000801c 0x4>;
    clocks = <&clk NPCM7XX_CLK_TIMER>;
};
```

## Documentation/devicetree/bindings/watchdog/omap-wdt.txt
```
TI Watchdog Timer (WDT) Controller for OMAP

Required properties:
- compatible : "ti,omap3-wdt" for OMAP3 or "ti,omap4-wdt" for OMAP4
- ti,hwmods : Name of the woke hwmod associated to the woke WDT

Optional properties:
- timeout-sec : default watchdog timeout in seconds

Examples:

wdt2: wdt@4a314000 {
	compatible = "ti,omap4-wdt", "ti,omap3-wdt";
	ti,hwmods = "wd_timer2";
};
```

## Documentation/devicetree/bindings/watchdog/ts4800-wdt.txt
```
Technologic Systems Watchdog

Required properties:
- compatible: must be "technologic,ts4800-wdt"
- syscon: phandle / integer array that points to the woke syscon node which
          describes the woke FPGA's syscon registers.
          - phandle to FPGA's syscon
          - offset to the woke watchdog register

Optional property:
- timeout-sec: contains the woke watchdog timeout in seconds.

Example:

syscon: syscon@b0010000 {
	compatible = "syscon", "simple-mfd";
	reg = <0xb0010000 0x3d>;
	reg-io-width = <2>;

	wdt@e {
		compatible = "technologic,ts4800-wdt";
		syscon = <&syscon 0xe>;
		timeout-sec = <10>;
	};
}
```

## Documentation/devicetree/bindings/x86/ce4100.txt
```
CE4100 Device Tree Bindings
---------------------------

The CE4100 SoC uses for in core peripherals the woke following compatible
format: <vendor>,<chip>-<device>.
Many of the woke "generic" devices like HPET or IO APIC have the woke ce4100
name in their compatible property because they first appeared in this
SoC.

The CPU nodes
-------------

	cpus {
		#address-cells = <1>;
		#size-cells = <0>;

		cpu@0 {
			device_type = "cpu";
			compatible = "intel,ce4100";
			reg = <0x00>;
		};

		cpu@2 {
			device_type = "cpu";
			compatible = "intel,ce4100";
			reg = <0x02>;
		};
	};

A "cpu" node describes one logical processor (hardware thread).

Required properties:

- device_type
	Device type, must be "cpu".

- reg
	Local APIC ID, the woke unique number assigned to each processor by
	system hardware.

The SoC node
------------

This node describes the woke in-core peripherals. Required property:
  compatible = "intel,ce4100-cp";

The PCI node
------------
This node describes the woke PCI bus on the woke SoC. Its property should be
  compatible = "intel,ce4100-pci", "pci";

If the woke OS is using the woke IO-APIC for interrupt routing then the woke reported
interrupt numbers for devices is no longer true. In order to obtain the
correct interrupt number, the woke child node which represents the woke device has
to contain the woke interrupt property. Besides the woke interrupt property it has
to contain at least the woke reg property containing the woke PCI bus address and
compatible property according to "PCI Bus Binding Revision 2.1".
```

## Documentation/devicetree/bindings/xilinx.txt
```
   d) Xilinx IP cores

   The Xilinx EDK toolchain ships with a set of IP cores (devices) for use
   in Xilinx Spartan and Virtex FPGAs.  The devices cover the woke whole range
   of standard device types (network, serial, etc.) and miscellaneous
   devices (gpio, LCD, spi, etc).  Also, since these devices are
   implemented within the woke fpga fabric every instance of the woke device can be
   synthesised with different options that change the woke behaviour.

   Each IP-core has a set of parameters which the woke FPGA designer can use to
   control how the woke core is synthesized.  Historically, the woke EDK tool would
   extract the woke device parameters relevant to device drivers and copy them
   into an 'xparameters.h' in the woke form of #define symbols.  This tells the
   device drivers how the woke IP cores are configured, but it requires the woke kernel
   to be recompiled every time the woke FPGA bitstream is resynthesized.

   The new approach is to export the woke parameters into the woke device tree and
   generate a new device tree each time the woke FPGA bitstream changes.  The
   parameters which used to be exported as #defines will now become
   properties of the woke device node.  In general, device nodes for IP-cores
   will take the woke following form:

	(name): (generic-name)@(base-address) {
		compatible = "xlnx,(ip-core-name)-(HW_VER)"
			     [, (list of compatible devices), ...];
		reg = <(baseaddr) (size)>;
		interrupt-parent = <&interrupt-controller-phandle>;
		interrupts = < ... >;
		xlnx,(parameter1) = "(string-value)";
		xlnx,(parameter2) = <(int-value)>;
	};

	(generic-name):   an open firmware-style name that describes the
			generic class of device.  Preferably, this is one word, such
			as 'serial' or 'ethernet'.
	(ip-core-name):	the name of the woke ip block (given after the woke BEGIN
			directive in system.mhs).  Should be in lowercase
			and all underscores '_' converted to dashes '-'.
	(name):		is derived from the woke "PARAMETER INSTANCE" value.
	(parameter#):	C_* parameters from system.mhs.  The C_ prefix is
			dropped from the woke parameter name, the woke name is converted
			to lowercase and all underscore '_' characters are
			converted to dashes '-'.
	(baseaddr):	the baseaddr parameter value (often named C_BASEADDR).
	(HW_VER):	from the woke HW_VER parameter.
	(size):		the address range size (often C_HIGHADDR - C_BASEADDR + 1).

   Typically, the woke compatible list will include the woke exact IP core version
   followed by an older IP core version which implements the woke same
   interface or any other device with the woke same interface.

   'reg' and 'interrupts' are all optional properties.

   For example, the woke following block from system.mhs:

	BEGIN opb_uartlite
		PARAMETER INSTANCE = opb_uartlite_0
		PARAMETER HW_VER = 1.00.b
		PARAMETER C_BAUDRATE = 115200
		PARAMETER C_DATA_BITS = 8
		PARAMETER C_ODD_PARITY = 0
		PARAMETER C_USE_PARITY = 0
		PARAMETER C_CLK_FREQ = 50000000
		PARAMETER C_BASEADDR = 0xEC100000
		PARAMETER C_HIGHADDR = 0xEC10FFFF
		BUS_INTERFACE SOPB = opb_7
		PORT OPB_Clk = CLK_50MHz
		PORT Interrupt = opb_uartlite_0_Interrupt
		PORT RX = opb_uartlite_0_RX
		PORT TX = opb_uartlite_0_TX
		PORT OPB_Rst = sys_bus_reset_0
	END

   becomes the woke following device tree node:

	opb_uartlite_0: serial@ec100000 {
		device_type = "serial";
		compatible = "xlnx,opb-uartlite-1.00.b";
		reg = <ec100000 10000>;
		interrupt-parent = <&opb_intc_0>;
		interrupts = <1 0>; // got this from the woke opb_intc parameters
		current-speed = <d#115200>;	// standard serial device prop
		clock-frequency = <d#50000000>;	// standard serial device prop
		xlnx,data-bits = <8>;
		xlnx,odd-parity = <0>;
		xlnx,use-parity = <0>;
	};

   That covers the woke general approach to binding xilinx IP cores into the
   device tree.  The following are bindings for specific devices:

      i) Xilinx ML300 Framebuffer

      Simple framebuffer device from the woke ML300 reference design (also on the
      ML403 reference design as well as others).

      Optional properties:
       - resolution = <xres yres> : pixel resolution of framebuffer.  Some
                                    implementations use a different resolution.
                                    Default is <d#640 d#480>
       - virt-resolution = <xvirt yvirt> : Size of framebuffer in memory.
                                           Default is <d#1024 d#480>.
       - rotate-display (empty) : rotate display 180 degrees.

      iii) Xilinx EMAC and Xilinx TEMAC

      Xilinx Ethernet devices.  In addition to general xilinx properties
      listed above, nodes for these devices should include a phy-handle
      property, and may include other common network device properties
      like local-mac-address.

      v) Xilinx hwicap

		Xilinx hwicap devices provide access to the woke configuration logic
		of the woke FPGA through the woke Internal Configuration Access Port
		(ICAP).  The ICAP enables partial reconfiguration of the woke FPGA,
		readback of the woke configuration information, and some control over
		'warm boots' of the woke FPGA fabric.

		Required properties:
		- xlnx,family : The family of the woke FPGA, necessary since the
                      capabilities of the woke underlying ICAP hardware
                      differ between different families.  May be
                      'virtex2p', 'virtex4', or 'virtex5'.
		- compatible : should contain "xlnx,xps-hwicap-1.00.a" or
				"xlnx,opb-hwicap-1.00.b".

      vii) Xilinx USB Host controller

      The Xilinx USB host controller is EHCI compatible but with a different
      base address for the woke EHCI registers, and it is always a big-endian
      USB Host controller. The hardware can be configured as high speed only,
      or high speed/full speed hybrid.

      Required properties:
      - xlnx,support-usb-fs: A value 0 means the woke core is built as high speed
                             only. A value 1 means the woke core also supports
                             full speed devices.
```

## Documentation/devicetree/bindings/xillybus/xillybus.txt
```
* Xillybus driver for generic FPGA interface

Required properties:
- compatible: Should be "xillybus,xillybus-1.00.a"
- reg: Address and length of the woke register set for the woke device
- interrupts: Contains one interrupt node, typically consisting of three cells.

Optional properties:
- dma-coherent: Present if DMA operations are coherent

Example:

	xillybus@ff200400 {
		compatible = "xillybus,xillybus-1.00.a";
		reg = < 0xff200400 0x00000080 >;
		interrupts = < 0 40 1 >;
		interrupt-parent = <&intc>;
	} ;
```

## Documentation/kbuild/Kconfig.recursion-issue-01
```kconfig
# Simple Kconfig recursive issue
# ~~~~~~~~~~~~~~~~~~~~~~~~~~~~~~
#
# Test with:
#
# make KBUILD_KCONFIG=Documentation/kbuild/Kconfig.recursion-issue-01 allnoconfig
#
# This Kconfig file has a simple recursive dependency issue. In order to
# understand why this recursive dependency issue occurs lets consider what
# Kconfig needs to address. We iterate over what Kconfig needs to address
# by stepping through the woke questions it needs to address sequentially.
#
#  * What values are possible for CORE?
#
# CORE_BELL_A_ADVANCED selects CORE, which means that it influences the woke values
# that are possible for CORE. So for example if CORE_BELL_A_ADVANCED is 'y',
# CORE must be 'y' too.
#
#  * What influences CORE_BELL_A_ADVANCED?
#
# As the woke name implies CORE_BELL_A_ADVANCED is an advanced feature of
# CORE_BELL_A so naturally it depends on CORE_BELL_A. So if CORE_BELL_A is 'y'
# we know CORE_BELL_A_ADVANCED can be 'y' too.
#
#   * What influences CORE_BELL_A?
#
# CORE_BELL_A depends on CORE, so CORE influences CORE_BELL_A.
#
# But that is a problem, because this means that in order to determine
# what values are possible for CORE we ended up needing to address questions
# regarding possible values of CORE itself again. Answering the woke original
# question of what are the woke possible values of CORE would make the woke kconfig
# tools run in a loop. When this happens Kconfig exits and complains about
# the woke "recursive dependency detected" error.
#
# Reading the woke Documentation/kbuild/Kconfig.recursion-issue-01 file it may be
# obvious that an easy solution to this problem should just be the woke removal
# of the woke "select CORE" from CORE_BELL_A_ADVANCED as that is implicit already
# since CORE_BELL_A depends on CORE. Recursive dependency issues are not always
# so trivial to resolve, we provide another example below of practical
# implications of this recursive issue where the woke solution is perhaps not so
# easy to understand. Note that matching semantics on the woke dependency on
# CORE also consist of a solution to this recursive problem.

mainmenu "Simple example to demo kconfig recursive dependency issue"

config CORE
	tristate

config CORE_BELL_A
	tristate
	depends on CORE

config CORE_BELL_A_ADVANCED
	tristate
	depends on CORE_BELL_A
	select CORE
```

## arch/arc/Kconfig.debug
```kconfig
# SPDX-License-Identifier: GPL-2.0

config 16KSTACKS
	bool "Use 16Kb for kernel stacks instead of 8Kb"
	help
	  If you say Y here the woke kernel will use a  16Kb stacksize for the
	  kernel stack attached to each process/thread. The default is 8K.
	  This increases the woke resident kernel footprint and will cause less
	  threads to run on the woke system and also increase the woke pressure
	  on the woke VM subsystem for higher order allocations.
```
