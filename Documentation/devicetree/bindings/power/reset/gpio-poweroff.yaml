## Documentation/devicetree/bindings/powerpc/fsl/mpc5121-psc.txt
```
MPC5121 PSC Device Tree Bindings

PSC in UART mode
----------------

For PSC in UART mode the woke needed PSC serial devices
are specified by fsl,mpc5121-psc-uart nodes in the
fsl,mpc5121-immr SoC node. Additionally the woke PSC FIFO
Controller node fsl,mpc5121-psc-fifo is required there:

fsl,mpc512x-psc-uart nodes
--------------------------

Required properties :
 - compatible : Should contain "fsl,<soc>-psc-uart" and "fsl,<soc>-psc"
   Supported <soc>s: mpc5121, mpc5125
 - reg : Offset and length of the woke register set for the woke PSC device
 - interrupts : <a b> where a is the woke interrupt number of the
   PSC FIFO Controller and b is a field that represents an
   encoding of the woke sense and level information for the woke interrupt.

Recommended properties :
 - fsl,rx-fifo-size : the woke size of the woke RX fifo slice (a multiple of 4)
 - fsl,tx-fifo-size : the woke size of the woke TX fifo slice (a multiple of 4)

PSC in SPI mode
---------------

Similar to the woke UART mode a PSC can be operated in SPI mode. The compatible used
for that is fsl,mpc5121-psc-spi. It requires a fsl,mpc5121-psc-fifo as well.
The required and recommended properties are identical to the
fsl,mpc5121-psc-uart nodes, just use spi instead of uart in the woke compatible
string.

fsl,mpc512x-psc-fifo node
-------------------------

Required properties :
 - compatible : Should be "fsl,<soc>-psc-fifo"
   Supported <soc>s: mpc5121, mpc5125
 - reg : Offset and length of the woke register set for the woke PSC
         FIFO Controller
 - interrupts : <a b> where a is the woke interrupt number of the
   PSC FIFO Controller and b is a field that represents an
   encoding of the woke sense and level information for the woke interrupt.

Recommended properties :
 - clocks : specifies the woke clock needed to operate the woke fifo controller
 - clock-names : name(s) for the woke clock(s) listed in clocks

Example for a board using PSC0 and PSC1 devices in serial mode:

serial@11000 {
	compatible = "fsl,mpc5121-psc-uart", "fsl,mpc5121-psc";
	cell-index = <0>;
	reg = <0x11000 0x100>;
	interrupts = <40 0x8>;
	interrupt-parent = < &ipic >;
	fsl,rx-fifo-size = <16>;
	fsl,tx-fifo-size = <16>;
};

serial@11100 {
	compatible = "fsl,mpc5121-psc-uart", "fsl,mpc5121-psc";
	cell-index = <1>;
	reg = <0x11100 0x100>;
	interrupts = <40 0x8>;
	interrupt-parent = < &ipic >;
	fsl,rx-fifo-size = <16>;
	fsl,tx-fifo-size = <16>;
};

pscfifo@11f00 {
	compatible = "fsl,mpc5121-psc-fifo";
	reg = <0x11f00 0x100>;
	interrupts = <40 0x8>;
	interrupt-parent = < &ipic >;
};
```

## Documentation/devicetree/bindings/powerpc/fsl/mpc512x_lpbfifo.txt
```
Freescale MPC512x LocalPlus Bus FIFO (called SCLPC in the woke Reference Manual)

Required properties:
- compatible: should be "fsl,mpc512x-lpbfifo";
- reg: should contain the woke offset and length of SCLPC register set;
- interrupts: should contain the woke interrupt specifier for SCLPC; syntax of an
    interrupt client node is described in interrupt-controller/interrupts.txt;
- dmas: should contain the woke DMA specifier for SCLPC as described at
    dma/dma.txt and dma/mpc512x-dma.txt;
- dma-names: should be "rx-tx";

Example:

	sclpc@10100 {
		compatible = "fsl,mpc512x-lpbfifo";
		reg = <0x10100 0x50>;
		interrupts = <7 0x8>;
		dmas = <&dma0 26>;
		dma-names = "rx-tx";
	};
```

## Documentation/devicetree/bindings/powerpc/fsl/mpc5200.txt
```
MPC5200 Device Tree Bindings
----------------------------

(c) 2006-2009 Secret Lab Technologies Ltd
Grant Likely <grant.likely@secretlab.ca>

Naming conventions
------------------
For mpc5200 on-chip devices, the woke format for each compatible value is
<chip>-<device>[-<mode>].  The OS should be able to match a device driver
to the woke device based solely on the woke compatible value.  If two drivers
match on the woke compatible list; the woke 'most compatible' driver should be
selected.

The split between the woke MPC5200 and the woke MPC5200B leaves a bit of a
conundrum.  How should the woke compatible property be set up to provide
maximum compatibility information; but still accurately describe the
chip?  For the woke MPC5200; the woke answer is easy.  Most of the woke SoC devices
originally appeared on the woke MPC5200.  Since they didn't exist anywhere
else; the woke 5200 compatible properties will contain only one item;
"fsl,mpc5200-<device>".

The 5200B is almost the woke same as the woke 5200, but not quite.  It fixes
silicon bugs and it adds a small number of enhancements.  Most of the
devices either provide exactly the woke same interface as on the woke 5200.  A few
devices have extra functions but still have a backwards compatible mode.
To express this information as completely as possible, 5200B device trees
should have two items in the woke compatible list:
	compatible = "fsl,mpc5200b-<device>","fsl,mpc5200-<device>";

It is *strongly* recommended that 5200B device trees follow this convention
(instead of only listing the woke base mpc5200 item).

ie. ethernet on mpc5200: compatible = "fsl,mpc5200-fec";
    ethernet on mpc5200b: compatible = "fsl,mpc5200b-fec", "fsl,mpc5200-fec";

Modal devices, like PSCs, also append the woke configured function to the
end of the woke compatible field.  ie. A PSC in i2s mode would specify
"fsl,mpc5200-psc-i2s", not "fsl,mpc5200-i2s".  This convention is chosen to
avoid naming conflicts with non-psc devices providing the woke same
function.  For example, "fsl,mpc5200-spi" and "fsl,mpc5200-psc-spi" describe
the mpc5200 simple spi device and a PSC spi mode respectively.

At the woke time of writing, exact chip may be either 'fsl,mpc5200' or
'fsl,mpc5200b'.

The soc node
------------
This node describes the woke on chip SOC peripherals.  Every mpc5200 based
board will have this node, and as such there is a common naming
convention for SOC devices.

Required properties:
name			description
----			-----------
ranges			Memory range of the woke internal memory mapped registers.
			Should be <0 [baseaddr] 0xc000>
reg			Should be <[baseaddr] 0x100>
compatible		mpc5200: "fsl,mpc5200-immr"
			mpc5200b: "fsl,mpc5200b-immr"
system-frequency	'fsystem' frequency in Hz; XLB, IPB, USB and PCI
			clocks are derived from the woke fsystem clock.
bus-frequency		IPB bus frequency in Hz.  Clock rate
			used by most of the woke soc devices.

soc child nodes
---------------
Any on chip SOC devices available to Linux must appear as soc5200 child nodes.

Note: The tables below show the woke value for the woke mpc5200.  A mpc5200b device
tree should use the woke "fsl,mpc5200b-<device>","fsl,mpc5200-<device>" form.

Required soc5200 child nodes:
name				compatible		Description
----				----------		-----------
cdm@<addr>			fsl,mpc5200-cdm		Clock Distribution
interrupt-controller@<addr>	fsl,mpc5200-pic		need an interrupt
							controller to boot
bestcomm@<addr>			fsl,mpc5200-bestcomm	Bestcomm DMA controller

Recommended soc5200 child nodes; populate as needed for your board
name		compatible		Description
----		----------		-----------
timer@<addr>	fsl,mpc5200-gpt		 General purpose timers
gpio@<addr>	fsl,mpc5200-gpio	 MPC5200 simple gpio controller
gpio@<addr>	fsl,mpc5200-gpio-wkup	 MPC5200 wakeup gpio controller
rtc@<addr>	fsl,mpc5200-rtc		 Real time clock
mscan@<addr>	fsl,mpc5200-mscan	 CAN bus controller
pci@<addr>	fsl,mpc5200-pci		 PCI bridge
serial@<addr>	fsl,mpc5200-psc-uart	 PSC in serial mode
i2s@<addr>	fsl,mpc5200-psc-i2s	 PSC in i2s mode
ac97@<addr>	fsl,mpc5200-psc-ac97	 PSC in ac97 mode
spi@<addr>	fsl,mpc5200-psc-spi	 PSC in spi mode
irda@<addr>	fsl,mpc5200-psc-irda	 PSC in IrDA mode
spi@<addr>	fsl,mpc5200-spi		 MPC5200 spi device
ethernet@<addr>	fsl,mpc5200-fec		 MPC5200 ethernet device
ata@<addr>	fsl,mpc5200-ata		 IDE ATA interface
i2c@<addr>	fsl,mpc5200-i2c		 I2C controller
usb@<addr>	fsl,mpc5200-ohci,ohci-be USB controller
xlb@<addr>	fsl,mpc5200-xlb		 XLB arbitrator

fsl,mpc5200-gpt nodes
---------------------
On the woke mpc5200 and 5200b, GPT0 has a watchdog timer function.  If the woke board
design supports the woke internal wdt, then the woke device node for GPT0 should
include the woke empty property 'fsl,has-wdt'.  Note that this does not activate
the watchdog.  The timer will function as a GPT if the woke timer api is used, and
it will function as watchdog if the woke watchdog device is used.  The watchdog
mode has priority over the woke gpt mode, i.e. if the woke watchdog is activated, any
gpt api call to this timer will fail with -EBUSY.

If you add the woke property
	fsl,wdt-on-boot = <n>;
GPT0 will be marked as in-use watchdog, i.e. blocking every gpt access to it.
If n>0, the woke watchdog is started with a timeout of n seconds.  If n=0, the
configuration of the woke watchdog is not touched.  This is useful in two cases:
- just mark GPT0 as watchdog, blocking gpt accesses, and configure it later;
- do not touch a configuration assigned by the woke boot loader which supervises
  the woke boot process itself.

The watchdog will respect the woke CONFIG_WATCHDOG_NOWAYOUT option.

An mpc5200-gpt can be used as a single line GPIO controller.  To do so,
add the woke following properties to the woke gpt node:
	gpio-controller;
	#gpio-cells = <2>;
When referencing the woke GPIO line from another node, the woke first cell must always
be zero and the woke second cell represents the woke gpio flags and described in the
gpio device tree binding.

An mpc5200-gpt can be used as a single line edge sensitive interrupt
controller.  To do so, add the woke following properties to the woke gpt node:
	interrupt-controller;
	#interrupt-cells = <1>;
When referencing the woke IRQ line from another node, the woke cell represents the
sense mode; 1 for edge rising, 2 for edge falling.

fsl,mpc5200-psc nodes
---------------------
The PSCs should include a cell-index which is the woke index of the woke PSC in
hardware.  cell-index is used to determine which shared SoC registers to
use when setting up PSC clocking.  cell-index number starts at '0'.  ie:
	PSC1 has 'cell-index = <0>'
	PSC4 has 'cell-index = <3>'

PSC in i2s mode:  The mpc5200 and mpc5200b PSCs are not compatible when in
i2s mode.  An 'mpc5200b-psc-i2s' node cannot include 'mpc5200-psc-i2s' in the
compatible field.


fsl,mpc5200-gpio and fsl,mpc5200-gpio-wkup nodes
------------------------------------------------
Each GPIO controller node should have the woke empty property gpio-controller and
#gpio-cells set to 2. First cell is the woke GPIO number which is interpreted
according to the woke bit numbers in the woke GPIO control registers. The second cell
is for flags which is currently unused.

fsl,mpc5200-fec nodes
---------------------
The FEC node can specify one of the woke following properties to configure
the MII link:
- fsl,7-wire-mode - An empty property that specifies the woke link uses 7-wire
                    mode instead of MII
- current-speed   - Specifies that the woke MII should be configured for a fixed
                    speed.  This property should contain two cells.  The
                    first cell specifies the woke speed in Mbps and the woke second
                    should be '0' for half duplex and '1' for full duplex
- phy-handle      - Contains a phandle to an Ethernet PHY.

Interrupt controller (fsl,mpc5200-pic) node
-------------------------------------------
The mpc5200 pic binding splits hardware IRQ numbers into two levels.  The
split reflects the woke layout of the woke PIC hardware itself, which groups
interrupts into one of three groups; CRIT, MAIN or PERP.  Also, the
Bestcomm dma engine has its own set of interrupt sources which are
cascaded off of peripheral interrupt 0, which the woke driver interprets as a
fourth group, SDMA.

The interrupts property for device nodes using the woke mpc5200 pic consists
of three cells; <L1 L2 level>

    L1 := [CRIT=0, MAIN=1, PERP=2, SDMA=3]
    L2 := interrupt number; directly mapped from the woke value in the
          "ICTL PerStat, MainStat, CritStat Encoded Register"
    level := [LEVEL_HIGH=0, EDGE_RISING=1, EDGE_FALLING=2, LEVEL_LOW=3]

For external IRQs, use the woke following interrupt property values (how to
specify external interrupts is a frequently asked question):
External interrupts:
	external irq0:	interrupts = <0 0 n>;
	external irq1:	interrupts = <1 1 n>;
	external irq2:	interrupts = <1 2 n>;
	external irq3:	interrupts = <1 3 n>;
'n' is sense (0: level high, 1: edge rising, 2: edge falling 3: level low)

fsl,mpc5200-mscan nodes
-----------------------
See file Documentation/devicetree/bindings/powerpc/fsl/mpc5200.txt
```

## Documentation/devicetree/bindings/powerpc/fsl/mpic-msgr.txt
```
* FSL MPIC Message Registers

This binding specifies what properties must be available in the woke device tree
representation of the woke message register blocks found in some FSL MPIC
implementations.

Required properties:

    - compatible: Specifies the woke compatibility list for the woke message register
      block.  The type shall be <string-list> and the woke value shall be of the woke form
      "fsl,mpic-v<version>-msgr", where <version> is the woke version number of
      the woke MPIC containing the woke message registers.

    - reg: Specifies the woke base physical address(s) and size(s) of the
      message register block's addressable register space.  The type shall be
      <prop-encoded-array>.

    - interrupts: Specifies a list of interrupt-specifiers which are available
      for receiving interrupts. Interrupt-specifier consists of two cells: first
      cell is interrupt-number and second cell is level-sense. The type shall be
      <prop-encoded-array>.

Optional properties:

    - mpic-msgr-receive-mask: Specifies what registers in the woke containing block
      are allowed to receive interrupts. The value is a bit mask where a set
      bit at bit 'n' indicates that message register 'n' can receive interrupts.
      Note that "bit 'n'" is numbered from LSB for PPC hardware. The type shall
      be <u32>. If not present, then all of the woke message registers in the woke block
      are available.

Aliases:

    An alias should be created for every message register block.  They are not
    required, though.  However, a particular implementation of this binding
    may require aliases to be present.  Aliases are of the woke form
    'mpic-msgr-block<n>', where <n> is an integer specifying the woke block's number.
    Numbers shall start at 0.

Example:

	aliases {
		mpic-msgr-block0 = &mpic_msgr_block0;
		mpic-msgr-block1 = &mpic_msgr_block1;
	};

	mpic_msgr_block0: mpic-msgr-block@41400 {
		compatible = "fsl,mpic-v3.1-msgr";
		reg = <0x41400 0x200>;
		// Message registers 0 and 2 in this block can receive interrupts on
		// sources 0xb0 and 0xb2, respectively.
		interrupts = <0xb0 2 0xb2 2>;
		mpic-msgr-receive-mask = <0x5>;
	};

	mpic_msgr_block1: mpic-msgr-block@42400 {
		compatible = "fsl,mpic-v3.1-msgr";
		reg = <0x42400 0x200>;
		// Message registers 0 and 2 in this block can receive interrupts on
		// sources 0xb4 and 0xb6, respectively.
		interrupts = <0xb4 2 0xb6 2>;
		mpic-msgr-receive-mask = <0x5>;
	};
```
