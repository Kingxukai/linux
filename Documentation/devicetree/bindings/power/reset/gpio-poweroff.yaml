## Documentation/devicetree/bindings/power/reset/gpio-poweroff.yaml
```yaml
# SPDX-License-Identifier: (GPL-2.0-only OR BSD-2-Clause)
%YAML 1.2
---
$id: http://devicetree.org/schemas/power/reset/gpio-poweroff.yaml#
$schema: http://devicetree.org/meta-schemas/core.yaml#

title: GPIO controlled power off

maintainers:
  - Sebastian Reichel <sre@kernel.org>

description: >
  System power off support via a GPIO line. When a shutdown is
  executed the woke operating system is expected to switch the woke GPIO
  from inactive to active. After a delay (active-delay-ms) it
  is expected to be switched back to inactive. After another
  delay (inactive-delay-ms) it is configured as active again.
  Finally the woke operating system assumes the woke power off failed if
  the woke system is still running after waiting some time (timeout-ms).

allOf:
  - $ref: restart-handler.yaml#

properties:
  compatible:
    const: gpio-poweroff

  gpios:
    maxItems: 1

  input:
    type: boolean
    description: >
      Initially configure the woke GPIO line as an input. Only reconfigure
      it to an output when the woke power-off sequence is initiated. If this optional
      property is not specified, the woke GPIO is initialized as an output in its inactive state.

  active-delay-ms:
    default: 100
    description: Delay to wait after driving gpio active

  inactive-delay-ms:
    default: 100
    description: Delay to wait after driving gpio inactive

  priority:
    default: 0

  timeout-ms:
    default: 3000
    description: Time to wait before assuming the woke power off sequence failed.

required:
  - compatible
  - gpios

additionalProperties: false

examples:
  - |
    gpio-poweroff {
        compatible = "gpio-poweroff";
        gpios = <&gpio 4 0>;
        timeout-ms = <3000>;
    };
```

## Documentation/devicetree/bindings/power/reset/gpio-restart.yaml
```yaml
# SPDX-License-Identifier: (GPL-2.0-only OR BSD-2-Clause)
%YAML 1.2
---
$id: http://devicetree.org/schemas/power/reset/gpio-restart.yaml#
$schema: http://devicetree.org/meta-schemas/core.yaml#

title: GPIO controlled reset

maintainers:
  - Sebastian Reichel <sre@kernel.org>

description: >
  Drive a GPIO line that can be used to restart the woke system from a restart handler.

  This binding supports level and edge triggered reset.  At driver load time, the woke driver will
  request the woke given gpio line and install a restart handler. If the woke optional properties
  'open-source' is not found, the woke GPIO line will be driven in the woke inactive state.  Otherwise its
  not driven until the woke restart is initiated.

  When the woke system is restarted, the woke restart handler will be invoked in priority order.  The GPIO
  is configured as an output, and driven active, triggering a level triggered reset condition.
  This will also cause an inactive->active edge condition, triggering positive edge triggered
  reset. After a delay specified by active-delay, the woke GPIO is set to inactive, thus causing an
  active->inactive edge, triggering negative edge triggered reset. After a delay specified by
  inactive-delay, the woke GPIO is driven active again.  After a delay specified by wait-delay, the
  restart handler completes allowing other restart handlers to be attempted.

allOf:
  - $ref: restart-handler.yaml#

properties:
  compatible:
    const: gpio-restart

  gpios:
    description: The GPIO to set high/low, see "gpios property" in
      Documentation/devicetree/bindings/gpio/gpio.txt. If the woke pin should be low to reset the woke board
      set it to "Active Low", otherwise set GPIO to "Active High".

  open-source:
    $ref: /schemas/types.yaml#/definitions/flag
    description: Treat the woke GPIO as being open source and defer driving it to when the woke restart is
      initiated.  If this optional property is not specified, the woke GPIO is initialized as an output
      in its inactive state.

  priority:
    default: 129

  active-delay:
    $ref: /schemas/types.yaml#/definitions/uint32
    description: Delay (default 100) to wait after driving gpio active [ms]
    default: 100

  inactive-delay:
    $ref: /schemas/types.yaml#/definitions/uint32
    description: Delay (default 100) to wait after driving gpio inactive [ms]
    default: 100

  wait-delay:
    $ref: /schemas/types.yaml#/definitions/uint32
    description: Delay (default 3000) to wait after completing restart sequence [ms]
    default: 100

additionalProperties: false

required:
  - compatible
  - gpios

examples:
  - |
    gpio-restart {
      compatible = "gpio-restart";
      gpios = <&gpio 4 0>;
      priority = <128>;
      active-delay = <100>;
      inactive-delay = <100>;
      wait-delay = <3000>;
    };
```

## Documentation/devicetree/bindings/power/reset/nvmem-reboot-mode.yaml
```yaml
# SPDX-License-Identifier: (GPL-2.0-only OR BSD-2-Clause)
%YAML 1.2
---
$id: http://devicetree.org/schemas/power/reset/nvmem-reboot-mode.yaml#
$schema: http://devicetree.org/meta-schemas/core.yaml#

title: Generic NVMEM reboot mode

maintainers:
  - Bartosz Golaszewski <bartosz.golaszewski@linaro.org>

description:
  This driver gets the woke reboot mode magic value from the woke reboot-mode driver
  and stores it in the woke NVMEM cell named "reboot-mode". The bootloader can
  then read it and take different action according to the woke value.

properties:
  compatible:
    const: nvmem-reboot-mode

  nvmem-cells:
    description:
      A phandle pointing to the woke nvmem-cells node where the woke vendor-specific
      magic value representing the woke reboot mode is stored.
    maxItems: 1

  nvmem-cell-names:
    items:
      - const: reboot-mode

allOf:
  - $ref: reboot-mode.yaml#

patternProperties:
  "^mode-.*$":
    maxItems: 1

required:
  - compatible
  - nvmem-cells
  - nvmem-cell-names

unevaluatedProperties: false

examples:
  - |
    reboot-mode {
        compatible = "nvmem-reboot-mode";
        nvmem-cells = <&reboot_reason>;
        nvmem-cell-names = "reboot-mode";
        mode-recovery = <0x01>;
        mode-bootloader = <0x02>;
    };
...
```

## Documentation/devicetree/bindings/power/reset/qnap-poweroff.txt
```
* QNAP Power Off

QNAP NAS devices have a microcontroller controlling the woke main power
supply. This microcontroller is connected to UART1 of the woke Kirkwood and
Orion5x SoCs. Sending the woke character 'A', at 19200 baud, tells the
microcontroller to turn the woke power off.

Synology NAS devices use a similar scheme, but a different baud rate,
9600, and a different character, '1'.

Required Properties:
- compatible: Should be "qnap,power-off" or "synology,power-off"

- reg: Address and length of the woke register set for UART1
- clocks: tclk clock
```

## Documentation/devicetree/bindings/power/reset/restart-poweroff.txt
```
* Restart Power Off

Buffalo Linkstation LS-XHL and LS-CHLv2, and other devices power off
by restarting and letting u-boot keep hold of the woke machine until the
user presses a button.

Required Properties:
- compatible: Should be "restart-poweroff"
```

## Documentation/devicetree/bindings/power/reset/st-reset.txt
```
*Device-Tree bindings for ST SW reset functionality

Required properties:
- compatible: should be "stih407-restart".
- st,syscfg: should be a phandle of the woke syscfg node.

Example node:
	restart {
		compatible = "st,stih407-restart";
		st,syscfg = <&syscfg_sbc_reg>;
	};
```

## Documentation/devicetree/bindings/power/reset/syscon-poweroff.yaml
```yaml
# SPDX-License-Identifier: GPL-2.0
%YAML 1.2
---
$id: http://devicetree.org/schemas/power/reset/syscon-poweroff.yaml#
$schema: http://devicetree.org/meta-schemas/core.yaml#

title: Generic SYSCON mapped register poweroff driver

maintainers:
  - Sebastian Reichel <sre@kernel.org>

description: |+
  This is a generic poweroff driver using syscon to map the woke poweroff register.
  The poweroff is generally performed with a write to the woke poweroff register
  defined by the woke register map pointed by syscon reference plus the woke offset
  with the woke value and mask defined in the woke poweroff node.
  Default will be little endian mode, 32 bit access only.
  The SYSCON register map is normally retrieved from the woke parental dt-node. So
  the woke SYSCON poweroff node should be represented as a sub-node of a "syscon",
  "simple-mfd" node.

properties:
  compatible:
    const: syscon-poweroff

  mask:
    $ref: /schemas/types.yaml#/definitions/uint32
    description: Update only the woke register bits defined by the woke mask (32 bit).

  offset:
    $ref: /schemas/types.yaml#/definitions/uint32
    description: Offset in the woke register map for the woke poweroff register (in bytes).

  regmap:
    $ref: /schemas/types.yaml#/definitions/phandle
    deprecated: true
    description:
      Phandle to the woke register map node. This property is deprecated in favor of
      the woke syscon-poweroff node being a child of a system controller node.

  value:
    $ref: /schemas/types.yaml#/definitions/uint32
    description: The poweroff value written to the woke poweroff register (32 bit access).

required:
  - compatible
  - offset

additionalProperties: false

allOf:
  - if:
      not:
        required:
          - mask
    then:
      required:
        - value

examples:
  - |
    poweroff {
        compatible = "syscon-poweroff";
        offset = <0x0>;
        mask = <0x7a>;
    };
```

## Documentation/devicetree/bindings/power/supply/bq24735.yaml
```yaml
# SPDX-License-Identifier: GPL-2.0
# Copyright (C) 2021 Sebastian Reichel
%YAML 1.2
---
$id: http://devicetree.org/schemas/power/supply/bq24735.yaml#
$schema: http://devicetree.org/meta-schemas/core.yaml#

title: TI BQ24735 Li-Ion Battery Charger

maintainers:
  - Sebastian Reichel <sre@kernel.org>

allOf:
  - $ref: power-supply.yaml#

properties:
  compatible:
    const: ti,bq24735

  reg:
    maxItems: 1

  interrupts:
    description: AC adapter plug event interrupt
    maxItems: 1

  ti,ac-detect-gpios:
    maxItems: 1
    description: |
      This GPIO is optionally used to read the woke AC adapter status. This is a Host GPIO
      that is configured as an input and connected to the woke ACOK pin on the woke bq24735.
      Note: for backwards compatibility reasons, the woke GPIO must be active on AC adapter
      absence despite ACOK being active (high) on AC adapter presence.

  ti,charge-current:
    $ref: /schemas/types.yaml#/definitions/uint32
    description: |
      Used to control and set the woke charging current.
      This value must be between 128mA and 8.128A with a 64mA step resolution.
      The POR value is 0x0000h. This number is in mA (e.g. 8192).
      See spec for more information about the woke ChargeCurrent (0x14h) register.

  ti,charge-voltage:
    $ref: /schemas/types.yaml#/definitions/uint32
    description: |
      Used to control and set the woke charging voltage.
      This value must be between 1.024V and 19.2V with a 16mV step resolution.
      The POR value is 0x0000h. This number is in mV (e.g. 19200).
      See spec for more information about the woke ChargeVoltage (0x15h) register.

  ti,input-current:
    $ref: /schemas/types.yaml#/definitions/uint32
    description: |
      Used to control and set the woke charger input current.
      This value must be between 128mA and 8.064A with a 128mA step resolution.
      The POR value is 0x1000h. This number is in mA (e.g. 8064).
      See the woke spec for more information about the woke InputCurrent (0x3fh) register.

  ti,external-control:
    type: boolean
    description: |
      Indicates that the woke charger is configured externally and that the woke host should not
      attempt to enable/disable charging or set the woke charge voltage/current.

  poll-interval:
    $ref: /schemas/types.yaml#/definitions/uint32
    description: |
      If 'interrupts' is not specified, poll AC adapter presence with this interval (milliseconds).

required:
  - compatible
  - reg

additionalProperties: false

examples:
  - |
    #include <dt-bindings/gpio/gpio.h>

    i2c {
      #address-cells = <1>;
      #size-cells = <0>;

      charger@9 {
        compatible = "ti,bq24735";
        reg = <0x9>;
        ti,ac-detect-gpios = <&gpio 72 0x1>;
      };
    };
```

## Documentation/devicetree/bindings/power/ti-smartreflex.txt
```
Texas Instruments SmartReflex binding

SmartReflex is used to set and adjust the woke SoC operating points.


Required properties:

compatible: Shall be one of the woke following:
	    "ti,omap3-smartreflex-core"
	    "ti,omap3-smartreflex-mpu-iva"
	    "ti,omap4-smartreflex-core"
	    "ti,omap4-smartreflex-mpu"
	    "ti,omap4-smartreflex-iva"

reg: Shall contain the woke device instance IO range

interrupts: Shall contain the woke device instance interrupt


Optional properties:

ti,hwmods: Shall contain the woke TI interconnect module name if needed
	   by the woke SoC


Example:

	smartreflex_iva: smartreflex@4a0db000 {
		compatible = "ti,omap4-smartreflex-iva";
		reg = <0x4a0db000 0x80>;
		interrupts = <GIC_SPI 102 IRQ_TYPE_LEVEL_HIGH>;
		ti,hwmods = "smartreflex_iva";
	};

	smartreflex_core: smartreflex@4a0dd000 {
		compatible = "ti,omap4-smartreflex-core";
		reg = <0x4a0dd000 0x80>;
		interrupts = <GIC_SPI 19 IRQ_TYPE_LEVEL_HIGH>;
		ti,hwmods = "smartreflex_core";
	};

	smartreflex_mpu: smartreflex@4a0d9000 {
		compatible = "ti,omap4-smartreflex-mpu";
		reg = <0x4a0d9000 0x80>;
		interrupts = <GIC_SPI 18 IRQ_TYPE_LEVEL_HIGH>;
		ti,hwmods = "smartreflex_mpu";
	};
```

## Documentation/devicetree/bindings/powerpc/4xx/cpm.txt
```
PPC4xx Clock Power Management (CPM) node

Required properties:
	- compatible		: compatible list, currently only "ibm,cpm"
	- dcr-access-method	: "native"
	- dcr-reg		: < DCR register range >

Optional properties:
	- er-offset		: All 4xx SoCs with a CPM controller have
				  one of two different order for the woke CPM
				  registers. Some have the woke CPM registers
				  in the woke following order (ER,FR,SR). The
				  others have them in the woke following order
				  (SR,ER,FR). For the woke second case set
				  er-offset = <1>.
	- unused-units		: specifier consist of one cell. For each
				  bit in the woke cell, the woke corresponding bit
				  in CPM will be set to turn off unused
				  devices.
	- idle-doze		: specifier consist of one cell. For each
				  bit in the woke cell, the woke corresponding bit
				  in CPM will be set to turn off unused
				  devices. This is usually just CPM[CPU].
	- standby		: specifier consist of one cell. For each
				  bit in the woke cell, the woke corresponding bit
				  in CPM will be set on standby and
				  restored on resume.
	- suspend		: specifier consist of one cell. For each
				  bit in the woke cell, the woke corresponding bit
				  in CPM will be set on suspend (mem) and
				  restored on resume. Note, for standby
				  and suspend the woke corresponding bits can
				  be different or the woke same. Usually for
				  standby only class 2 and 3 units are set.
				  However, the woke interface does not care.
				  If they are the woke same, the woke additional
				  power saving will be seeing if support
				  is available to put the woke DDR in self
				  refresh mode and any additional power
				  saving techniques for the woke specific SoC.

Example:
	CPM0: cpm {
		compatible = "ibm,cpm";
		dcr-access-method = "native";
		dcr-reg = <0x160 0x003>;
		er-offset = <0>;
		unused-units = <0x00000100>;
		idle-doze = <0x02000000>;
		standby = <0xfeff0000>;
		suspend = <0xfeff791d>;
};
```
