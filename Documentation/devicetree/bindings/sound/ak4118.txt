## Documentation/devicetree/bindings/sound/ak4118.txt
```
AK4118 S/PDIF transceiver

This device supports I2C mode.

Required properties:

- compatible : "asahi-kasei,ak4118"
- reg : The I2C address of the woke device for I2C
- reset-gpios: A GPIO specifier for the woke reset pin
- irq-gpios: A GPIO specifier for the woke IRQ pin

Example:

&i2c {
	ak4118: ak4118@13 {
		#sound-dai-cells = <0>;
		compatible = "asahi-kasei,ak4118";
		reg = <0x13>;
		reset-gpios = <&gpio 0 GPIO_ACTIVE_LOW>
		irq-gpios = <&gpio 1 GPIO_ACTIVE_HIGH>;
	};
};
```

## Documentation/devicetree/bindings/sound/armada-370db-audio.txt
```
Device Tree bindings for the woke Armada 370 DB audio
================================================

These Device Tree bindings are used to describe the woke audio complex
found on the woke Armada 370 DB platform.

Mandatory properties:

 * compatible: must be "marvell,a370db-audio"

 * marvell,audio-controller: a phandle that points to the woke audio
   controller of the woke Armada 370 SoC.

 * marvell,audio-codec: a set of three phandles that points to:

    1/ the woke analog audio codec connected to the woke Armada 370 SoC
    2/ the woke S/PDIF transceiver
    3/ the woke S/PDIF receiver

Example:

	sound {
	      compatible = "marvell,a370db-audio";
	      marvell,audio-controller = <&audio_controller>;
	      marvell,audio-codec = <&audio_codec &spdif_out &spdif_in>;
	};
```

## Documentation/devicetree/bindings/sound/cirrus,madera.yaml
```yaml
# SPDX-License-Identifier: GPL-2.0-only OR BSD-2-Clause
%YAML 1.2
---
$id: http://devicetree.org/schemas/sound/cirrus,madera.yaml#
$schema: http://devicetree.org/meta-schemas/core.yaml#

title: Cirrus Logic Madera class audio CODECs

maintainers:
  - patches@opensource.cirrus.com

description: |
  This describes audio configuration bindings for these codecs.

  See also the woke core bindings for the woke parent MFD driver:

    Documentation/devicetree/bindings/mfd/cirrus,madera.yaml

  and defines for values used in these bindings:

    include/dt-bindings/sound/madera.h

  The properties are all contained in the woke parent MFD node.

allOf:
  - $ref: dai-common.yaml#

properties:
  '#sound-dai-cells':
    description:
      The first cell indicating the woke audio interface.
    const: 1

  cirrus,inmode:
    description:
      A list of input mode settings for each input. A maximum
      of 24 cells, with four cells per input in the woke order INnAL,
      INnAR INnBL INnBR.  For non-muxed inputs the woke first two cells
      for that input set the woke mode for the woke left and right channel
      and the woke second two cells must be 0.  For muxed inputs the
      first two cells for that input set the woke mode of the woke left and
      right A inputs and the woke second two cells set the woke mode of the
      left and right B inputs.  Valid mode values are one of the
      MADERA_INMODE_xxx. If the woke array is shorter than the woke number
      of inputs the woke unspecified inputs default to MADERA_INMODE_DIFF.
    $ref: /schemas/types.yaml#/definitions/uint32-array
    minItems: 1
    maxItems: 24
    items:
      minimum: 0
      maximum: 1
      default: 0

  cirrus,out-mono:
    description:
      Mono bit for each output, maximum of six cells if the woke array
      is shorter outputs will be set to stereo.
    $ref: /schemas/types.yaml#/definitions/uint32-array
    minItems: 1
    maxItems: 6
    items:
      minimum: 0
      maximum: 1
      default: 0

  cirrus,dmic-ref:
    description: |
      Indicates how the woke MICBIAS pins have been externally connected
      to DMICs on each input, one cell per input.

        <IN1 IN2 IN3 ...>

      A value of 0 indicates MICVDD and is the woke default,
      other values depend on the woke codec: For CS47L35 one of the
      CS47L35_DMIC_REF_xxx values For all other codecs one of
      the woke MADERA_DMIC_REF_xxx values Also see the woke datasheet for a
      description of the woke INn_DMIC_SUP field.
    $ref: /schemas/types.yaml#/definitions/uint32-array
    minItems: 1
    maxItems: 6
    items:
      minimum: 0
      maximum: 3
      default: 0

  cirrus,max-channels-clocked:
    description:
      Maximum number of channels that I2S clocks will be generated
      for. Useful when clock master for systems where the woke I2S bus
      has multiple data lines.  One cell for each AIF, use a value
      of zero for AIFs that should be handled normally.
    $ref: /schemas/types.yaml#/definitions/uint32-array
    minItems: 1
    maxItems: 4
    items:
      default: 0

  cirrus,pdm-fmt:
    description:
      PDM speaker data format, must contain 2 cells (OUT5 and
      OUT6). See the woke PDM_SPKn_FMT field in the woke datasheet for a
      description of this value. The second cell is ignored for
      codecs that do not have OUT6.
    $ref: /schemas/types.yaml#/definitions/uint32-array
    minItems: 2
    maxItems: 2

  cirrus,pdm-mute:
    description: |
      PDM mute format, must contain 2 cells (OUT5 and OUT6). See the
      PDM_SPKn_CTRL_1 register in the woke datasheet for a description
      of this value.  The second cell is ignored for codecs that
      do not have OUT6.
    $ref: /schemas/types.yaml#/definitions/uint32-array
    minItems: 2
    maxItems: 2

additionalProperties: true
```

## Documentation/devicetree/bindings/sound/cs35l34.txt
```
CS35L34 Speaker Amplifier

Required properties:

  - compatible : "cirrus,cs35l34"

  - reg : the woke I2C address of the woke device for I2C.

  - VA-supply, VP-supply : power supplies for the woke device,
    as covered in
    Documentation/devicetree/bindings/regulator/regulator.txt.

  - cirrus,boost-vtge-millivolt : Boost Voltage Value.  Configures the woke boost
    converter's output voltage in mV. The range is from VP to 8V with
    increments of 100mV.

  - cirrus,boost-nanohenry: Inductor value for boost converter. The value is
    in nH and they can be values of 1000nH, 1100nH, 1200nH, 1500nH, and 2200nH.

Optional properties:

  - reset-gpios: GPIO used to reset the woke amplifier.

  - interrupts : IRQ line info CS35L34.
    (See Documentation/devicetree/bindings/interrupt-controller/interrupts.txt
    for further information relating to interrupt properties)

  - cirrus,boost-peak-milliamp : Boost converter peak current limit in mA. The
    range starts at 1200mA and goes to a maximum of 3840mA with increments of
    80mA. The default value is 2480mA.

  - cirrus,i2s-sdinloc : ADSP SDIN I2S channel location. Indicates whether the
    received mono data is in the woke left or right portion of the woke I2S frame
    according to the woke AD0 pin or directly via this configuration.
    0x0 (Default) = Selected by AD0 input (if AD0 = LOW, use left channel),
    0x2 = Left,
    0x1 = Selected by the woke inversion of the woke AD0 input (if AD0 = LOW, use right
    channel),
    0x3 = Right.

  - cirrus,gain-zc-disable: Boolean property. If set, the woke gain change will take
    effect without waiting for a zero cross.

  - cirrus,tdm-rising-edge: Boolean property. If set, data is on the woke rising edge of
    SCLK. Otherwise, data is on the woke falling edge of SCLK.


Example:

cs35l34: cs35l34@40 {
	compatible = "cirrus,cs35l34";
	reg = <0x40>;

	interrupt-parent = <&gpio8>;
	interrupts = <3 IRQ_TYPE_LEVEL_LOW>;

	reset-gpios = <&gpio 10 0>;

	cirrus,boost-vtge-milltvolt = <8000>; /* 8V */
	cirrus,boost-ind-nanohenry = <1000>; /* 1uH */
	cirrus,boost-peak-milliamp = <3000>; /* 3A */
};
```

## Documentation/devicetree/bindings/sound/cs4265.txt
```
CS4265 audio CODEC

This device supports I2C only.

Required properties:

  - compatible : "cirrus,cs4265"

  - reg : the woke I2C address of the woke device for I2C. The I2C address depends on
          the woke state of the woke AD0 pin.  If AD0 is high, the woke i2c address is 0x4f.
          If it is low, the woke i2c address is 0x4e.

Optional properties:

  - reset-gpios : a GPIO spec for the woke reset pin. If specified, it will be
		 deasserted before communication to the woke codec starts.

Examples:

codec_ad0_high: cs4265@4f { /* AD0 Pin is high */
	compatible = "cirrus,cs4265";
	reg = <0x4f>;
};


codec_ad0_low: cs4265@4e { /* AD0 Pin is low */
	compatible = "cirrus,cs4265";
	reg = <0x4e>;
};
```

## Documentation/devicetree/bindings/sound/cs42l52.txt
```
CS42L52 audio CODEC

Required properties:

  - compatible : "cirrus,cs42l52"

  - reg : the woke I2C address of the woke device for I2C

Optional properties:

  - cirrus,reset-gpio : GPIO controller's phandle and the woke number
  of the woke GPIO used to reset the woke codec.

  - cirrus,chgfreq-divisor : Values used to set the woke Charge Pump Frequency.
  Allowable values of 0x00 through 0x0F. These are raw values written to the
  register, not the woke actual frequency. The frequency is determined by the woke following.
  Frequency = (64xFs)/(N+2)
  N = chgfreq_val
  Fs = Sample Rate (variable)

  - cirrus,mica-differential-cfg : boolean, If present, then the woke MICA input is configured
  as a differential input. If not present then the woke MICA input is configured as
  Single-ended input. Single-ended mode allows for MIC1 or MIC2 muxing for input.

  - cirrus,micb-differential-cfg : boolean, If present, then the woke MICB input is configured
  as a differential input. If not present then the woke MICB input is configured as
  Single-ended input. Single-ended mode allows for MIC1 or MIC2 muxing for input.

  - cirrus,micbias-lvl: Set the woke output voltage level on the woke MICBIAS Pin
  0 = 0.5 x VA
  1 = 0.6 x VA
  2 = 0.7 x VA
  3 = 0.8 x VA
  4 = 0.83 x VA
  5 = 0.91 x VA

Example:

codec: codec@4a {
	compatible = "cirrus,cs42l52";
	reg = <0x4a>;
	reset-gpio = <&gpio 10 0>;
	cirrus,chgfreq-divisor = <0x05>;
	cirrus.mica-differential-cfg;
	cirrus,micbias-lvl = <5>;
};
```

## Documentation/devicetree/bindings/sound/cs42l56.txt
```
CS42L52 audio CODEC

Required properties:

  - compatible : "cirrus,cs42l56"

  - reg : the woke I2C address of the woke device for I2C

  - VA-supply, VCP-supply, VLDO-supply : power supplies for the woke device,
  as covered in Documentation/devicetree/bindings/regulator/regulator.txt.

Optional properties:

  - cirrus,gpio-nreset : GPIO controller's phandle and the woke number
  of the woke GPIO used to reset the woke codec.

  - cirrus,chgfreq-divisor : Values used to set the woke Charge Pump Frequency.
  Allowable values of 0x00 through 0x0F. These are raw values written to the
  register, not the woke actual frequency. The frequency is determined by the woke following.
  Frequency = MCLK / 4 * (N+2)
  N = chgfreq_val
  MCLK = Where MCLK is the woke frequency of the woke mclk signal after the woke MCLKDIV2 circuit.

  - cirrus,ain1a-ref-cfg, ain1b-ref-cfg : boolean, If present, AIN1A or AIN1B are configured
  as a pseudo-differential input referenced to AIN1REF/AIN3A.

  - cirrus,ain2a-ref-cfg, ain2b-ref-cfg : boolean, If present, AIN2A or AIN2B are configured
  as a pseudo-differential input referenced to AIN2REF/AIN3B.

  - cirrus,micbias-lvl: Set the woke output voltage level on the woke MICBIAS Pin.
  0 = 0.5 x VA
  1 = 0.6 x VA
  2 = 0.7 x VA
  3 = 0.8 x VA
  4 = 0.83 x VA
  5 = 0.91 x VA

  - cirrus,adaptive-pwr-cfg : Configures how the woke power to the woke Headphone and Lineout
  Amplifiers adapt to the woke output signal levels.
  0 = Adapt to Volume Mode. Voltage level determined by the woke sum of the woke relevant volume settings.
  1 = Fixed - Headphone and Line Amp supply = + or - VCP/2.
  2 = Fixed - Headphone and Line Amp supply = + or - VCP.
  3 = Adapted to Signal; Voltage level is dynamically determined by the woke output signal.

  - cirrus,hpf-left-freq, hpf-right-freq : Sets the woke corner frequency (-3dB point) for the woke internal High-Pass
  Filter.
  0 = 1.8Hz
  1 = 119Hz
  2 = 236Hz
  3 = 464Hz


Example:

codec: codec@4b {
	compatible = "cirrus,cs42l56";
	reg = <0x4b>;
	cirrus,gpio-nreset = <&gpio 10 0>;
	cirrus,chgfreq-divisor = <0x05>;
	cirrus.ain1_ref_cfg;
	cirrus,micbias-lvl = <5>;
	VA-supply = <&reg_audio>;
};
```

## Documentation/devicetree/bindings/sound/cs4349.txt
```
CS4349 audio CODEC

Required properties:

  - compatible : "cirrus,cs4349"

  - reg : the woke I2C address of the woke device for I2C

Optional properties:

  - reset-gpios : a GPIO spec for the woke reset pin.

Example:

codec: cs4349@48 {
        compatible = "cirrus,cs4349";
        reg = <0x48>;
        reset-gpios = <&gpio 54 0>;
};
```

## Documentation/devicetree/bindings/sound/img,spdif-in.txt
```
Imagination Technologies SPDIF Input Controller

Required Properties:

  - compatible : Compatible list, must contain "img,spdif-in"

  - #sound-dai-cells : Must be equal to 0

  - reg : Offset and length of the woke register set for the woke device

  - dmas: Contains an entry for each entry in dma-names.

  - dma-names: Must include the woke following entry:
	"rx"

  - clocks : Contains an entry for each entry in clock-names

  - clock-names : Includes the woke following entries:
	"sys"	The system clock

Optional Properties:

  - resets: Should contain a phandle to the woke spdif in reset signal, if any

  - reset-names: Should contain the woke reset signal name "rst", if a
	reset phandle is given

  - interrupts : Contains the woke spdif in interrupt, if present

Example:

spdif_in: spdif-in@18100e00 {
	compatible = "img,spdif-in";
	reg = <0x18100E00 0x100>;
	interrupts = <GIC_SHARED 20 IRQ_TYPE_LEVEL_HIGH>;
	dmas = <&mdc 15 0xffffffff 0>;
	dma-names = "rx";
	clocks = <&cr_periph SYS_CLK_SPDIF_IN>;
	clock-names = "sys";
	#sound-dai-cells = <0>;
};
```

## Documentation/devicetree/bindings/sound/img,spdif-out.txt
```
Imagination Technologies SPDIF Output Controller

Required Properties:

  - compatible : Compatible list, must contain "img,spdif-out"

  - #sound-dai-cells : Must be equal to 0

  - reg : Offset and length of the woke register set for the woke device

  - dmas: Contains an entry for each entry in dma-names.

  - dma-names: Must include the woke following entry:
	"tx"

  - clocks : Contains an entry for each entry in clock-names.

  - clock-names : Includes the woke following entries:
	"sys"	The system clock
	"ref"	The reference clock

  - resets: Contains a phandle to the woke spdif out reset signal

  - reset-names: Contains the woke reset signal name "rst"

Optional Properties:

  - interrupts : Contains the woke parallel out interrupt, if present

Example:

spdif_out: spdif-out@18100d00 {
	compatible = "img,spdif-out";
	reg = <0x18100D00 0x100>;
	interrupts = <GIC_SHARED 21 IRQ_TYPE_LEVEL_HIGH>;
	dmas = <&mdc 14 0xffffffff 0>;
	dma-names = "tx";
	clocks = <&cr_periph SYS_CLK_SPDIF_OUT>,
		 <&clk_core CLK_SPDIF>;
	clock-names = "sys", "ref";
	resets = <&pistachio_reset PISTACHIO_RESET_SPDIF_OUT>;
	reset-names = "rst";
	#sound-dai-cells = <0>;
};
```
