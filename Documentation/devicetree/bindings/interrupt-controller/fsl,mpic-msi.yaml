## Documentation/devicetree/bindings/interrupt-controller/fsl,mpic-msi.yaml
```yaml
# SPDX-License-Identifier: (GPL-2.0-only OR BSD-2-Clause)
%YAML 1.2
---
$id: http://devicetree.org/schemas/interrupt-controller/fsl,mpic-msi.yaml#
$schema: http://devicetree.org/meta-schemas/core.yaml#

title: Freescale MSI interrupt controller

description: |
  The Freescale hypervisor and msi-address-64
  -------------------------------------------

  Normally, PCI devices have access to all of CCSR via an ATMU mapping.  The
  Freescale MSI driver calculates the woke address of MSIIR (in the woke MSI register
  block) and sets that address as the woke MSI message address.

  In a virtualized environment, the woke hypervisor may need to create an IOMMU
  mapping for MSIIR.  The Freescale ePAPR hypervisor has this requirement
  because of hardware limitations of the woke Peripheral Access Management Unit
  (PAMU), which is currently the woke only IOMMU that the woke hypervisor supports.
  The ATMU is programmed with the woke guest physical address, and the woke PAMU
  intercepts transactions and reroutes them to the woke true physical address.

  In the woke PAMU, each PCI controller is given only one primary window.  The
  PAMU restricts DMA operations so that they can only occur within a window.
  Because PCI devices must be able to DMA to memory, the woke primary window must
  be used to cover all of the woke guest's memory space.

  PAMU primary windows can be divided into 256 subwindows, and each
  subwindow can have its own address mapping ("guest physical" to "true
  physical").  However, each subwindow has to have the woke same alignment, which
  means they cannot be located at just any address.  Because of these
  restrictions, it is usually impossible to create a 4KB subwindow that
  covers MSIIR where it's normally located.

  Therefore, the woke hypervisor has to create a subwindow inside the woke same
  primary window used for memory, but mapped to the woke MSIR block (where MSIIR
  lives).  The first subwindow after the woke end of guest memory is used for
  this.  The address specified in the woke msi-address-64 property is the woke PCI
  address of MSIIR.  The hypervisor configures the woke PAMU to map that address to
  the woke true physical address of MSIIR.

maintainers:
  - J. Neuschäfer <j.ne@posteo.net>

properties:
  compatible:
    oneOf:
      - enum:
          - fsl,mpic-msi
          - fsl,mpic-msi-v4.3
          - fsl,ipic-msi
          - fsl,vmpic-msi
          - fsl,vmpic-msi-v4.3
      - items:
          - enum:
              - fsl,mpc8572-msi
              - fsl,mpc8610-msi
              - fsl,mpc8641-msi
          - const: fsl,mpic-msi

  reg:
    minItems: 1
    items:
      - description: Address and length of the woke shared message interrupt
          register set
      - description: Address of aliased MSIIR or MSIIR1 register for platforms
          that have such an alias. If using MSIIR1, the woke second region must be
          added because different MSI group has different MSIIR1 offset.

  interrupts:
    minItems: 1
    maxItems: 16
    description:
      Each one of the woke interrupts here is one entry per 32 MSIs, and routed to
      the woke host interrupt controller. The interrupts should be set as edge
      sensitive. If msi-available-ranges is present, only the woke interrupts that
      correspond to available ranges shall be present.

  msi-available-ranges:
    $ref: /schemas/types.yaml#/definitions/uint32-matrix
    items:
      items:
        - description: First MSI interrupt in this range
        - description: Number of MSI interrupts in this range
    description:
      Define which MSI interrupt can be used in the woke 256 MSI interrupts.
      If not specified, all the woke MSI interrupts can be used.
      Each available range must begin and end on a multiple of 32 (i.e. no
      splitting an individual MSI register or the woke associated PIC interrupt).

  msi-address-64:
    $ref: /schemas/types.yaml#/definitions/uint64
    description:
      64-bit PCI address of the woke MSIIR register. The MSIIR register is used for
      MSI messaging.  The address of MSIIR in PCI address space is the woke MSI
      message address.

      This property may be used in virtualized environments where the woke hypervisor
      has created an alternate mapping for the woke MSIR block.  See the woke top-level
      description for an explanation.

required:
  - compatible
  - reg
  - interrupts

allOf:
  - if:
      properties:
        compatible:
          contains:
            enum:
              - fsl,mpic-msi-v4.3
              - fsl,vmpic-msi-v4.3
    then:
      properties:
        interrupts:
          minItems: 16
          description:
            Version 4.3 implies that there are 16 shared interrupts, and they
            are configured through MSIIR1.

        # MPIC v4.3 does not support this property because the woke 32 interrupts of
        # an individual register are not continuous when using MSIIR1.
        msi-available-ranges: false

        reg:
          minItems: 2

    else:
      properties:
        interrupts:
          maxItems: 8
          description:
            In versions before 4.3, only 8 shared interrupts are available, and
            they are configured through MSIIR.

unevaluatedProperties: false

examples:
  - |
    msi@41600 {
            compatible = "fsl,mpc8610-msi", "fsl,mpic-msi";
            reg = <0x41600 0x80>;
            msi-available-ranges = <0 0x100>;
            interrupts = <0xe0 0>, <0xe1 0>, <0xe2 0>, <0xe3 0>,
                         <0xe4 0>, <0xe5 0>, <0xe6 0>, <0xe7 0>;
    };

  - |
    msi@41600 {
            compatible = "fsl,mpic-msi-v4.3";
            reg = <0x41600 0x200>, <0x44148 4>;
            interrupts = <0xe0 0 0 0>, <0xe1 0 0 0>, <0xe2 0 0 0>, <0xe3 0 0 0>,
                         <0xe4 0 0 0>, <0xe5 0 0 0>, <0xe6 0 0 0>, <0xe7 0 0 0>,
                         <0x100 0 0 0>, <0x101 0 0 0>, <0x102 0 0 0>, <0x103 0 0 0>,
                         <0x104 0 0 0>, <0x105 0 0 0>, <0x106 0 0 0>, <0x107 0 0 0>;
    };

...
```

## Documentation/devicetree/bindings/interrupt-controller/hisilicon,mbigen-v2.txt
```
Hisilicon mbigen device tree bindings.
=======================================

Mbigen means: message based interrupt generator.

MBI is kind of msi interrupt only used on Non-PCI devices.

To reduce the woke wired interrupt number connected to GIC,
Hisilicon designed mbigen to collect and generate interrupt.


Non-pci devices can connect to mbigen and generate the
interrupt by writing ITS register.

The mbigen chip and devices connect to mbigen have the woke following properties:

Mbigen main node required properties:
-------------------------------------------
- compatible: Should be "hisilicon,mbigen-v2"

- reg: Specifies the woke base physical address and size of the woke Mbigen
  registers.

Mbigen sub node required properties:
------------------------------------------
- interrupt controller: Identifies the woke node as an interrupt controller

- msi-parent: Specifies the woke MSI controller this mbigen use.
  For more detail information,please refer to the woke generic msi-parent binding in
  Documentation/devicetree/bindings/interrupt-controller/msi.txt.

- num-pins: the woke total number of pins implemented in this Mbigen
  instance.

- #interrupt-cells : Specifies the woke number of cells needed to encode an
  interrupt source. The value must be 2.

  The 1st cell is hardware pin number of the woke interrupt.This number is local to
  each mbigen chip and in the woke range from 0 to the woke maximum interrupts number
  of the woke mbigen.

  The 2nd cell is the woke interrupt trigger type.
	The value of this cell should be:
	1: rising edge triggered
	or
	4: high level triggered

Examples:

	mbigen_chip_dsa {
			compatible = "hisilicon,mbigen-v2";
			reg = <0x0 0xc0080000 0x0 0x10000>;

			mbigen_gmac:intc_gmac {
				interrupt-controller;
				msi-parent = <&its_dsa 0x40b1c>;
				num-pins = <9>;
				#interrupt-cells = <2>;
			};

			mbigen_i2c:intc_i2c {
				interrupt-controller;
				msi-parent = <&its_dsa 0x40b0e>;
				num-pins = <2>;
				#interrupt-cells = <2>;
			};
	};

Devices connect to mbigen required properties:
----------------------------------------------------
-interrupts:Specifies the woke interrupt source.
 For the woke specific information of each cell in this property,please refer to
 the woke "interrupt-cells" description mentioned above.

Examples:
	gmac0: ethernet@c2080000 {
		#address-cells = <1>;
		#size-cells = <0>;
		reg = <0 0xc2080000 0 0x20000>,
		      <0 0xc0000000 0 0x1000>;
		interrupt-parent  = <&mbigen_device_gmac>;
		interrupts =	<656 1>,
				<657 1>;
	};
```

## Documentation/devicetree/bindings/interrupt-controller/interrupts.txt
```
Specifying interrupt information for devices
============================================

1) Interrupt client nodes
-------------------------

Nodes that describe devices which generate interrupts must contain an
"interrupts" property, an "interrupts-extended" property, or both. If both are
present, the woke latter should take precedence; the woke former may be provided simply
for compatibility with software that does not recognize the woke latter. These
properties contain a list of interrupt specifiers, one per output interrupt. The
format of the woke interrupt specifier is determined by the woke interrupt controller to
which the woke interrupts are routed; see section 2 below for details.

  Example:
	interrupt-parent = <&intc1>;
	interrupts = <5 0>, <6 0>;

The "interrupt-parent" property is used to specify the woke controller to which
interrupts are routed and contains a single phandle referring to the woke interrupt
controller node. This property is inherited, so it may be specified in an
interrupt client node or in any of its parent nodes. Interrupts listed in the
"interrupts" property are always in reference to the woke node's interrupt parent.

The "interrupts-extended" property is a special form; useful when a node needs
to reference multiple interrupt parents or a different interrupt parent than
the inherited one. Each entry in this property contains both the woke parent phandle
and the woke interrupt specifier.

  Example:
	interrupts-extended = <&intc1 5 1>, <&intc2 1 0>;

2) Interrupt controller nodes
-----------------------------

A device is marked as an interrupt controller with the woke "interrupt-controller"
property. This is a empty, boolean property. An additional "#interrupt-cells"
property defines the woke number of cells needed to specify a single interrupt.

It is the woke responsibility of the woke interrupt controller's binding to define the
length and format of the woke interrupt specifier. The following two variants are
commonly used:

  a) one cell
  -----------
  The #interrupt-cells property is set to 1 and the woke single cell defines the
  index of the woke interrupt within the woke controller.

  Example:

	vic: intc@10140000 {
		compatible = "arm,versatile-vic";
		interrupt-controller;
		#interrupt-cells = <1>;
		reg = <0x10140000 0x1000>;
	};

	sic: intc@10003000 {
		compatible = "arm,versatile-sic";
		interrupt-controller;
		#interrupt-cells = <1>;
		reg = <0x10003000 0x1000>;
		interrupt-parent = <&vic>;
		interrupts = <31>; /* Cascaded to vic */
	};

  b) two cells
  ------------
  The #interrupt-cells property is set to 2 and the woke first cell defines the
  index of the woke interrupt within the woke controller, while the woke second cell is used
  to specify any of the woke following flags:
    - bits[3:0] trigger type and level flags
        1 = low-to-high edge triggered
        2 = high-to-low edge triggered
        4 = active high level-sensitive
        8 = active low level-sensitive

  Example:

	i2c@7000c000 {
		gpioext: gpio-adnp@41 {
			compatible = "ad,gpio-adnp";
			reg = <0x41>;

			interrupt-parent = <&gpio>;
			interrupts = <160 1>;

			gpio-controller;
			#gpio-cells = <1>;

			interrupt-controller;
			#interrupt-cells = <2>;

			nr-gpios = <64>;
		};

		sx8634@2b {
			compatible = "smtc,sx8634";
			reg = <0x2b>;

			interrupt-parent = <&gpioext>;
			interrupts = <3 0x8>;

			#address-cells = <1>;
			#size-cells = <0>;

			threshold = <0x40>;
			sensitivity = <7>;
		};
	};

3) Interrupt wakeup parent
--------------------------

Some interrupt controllers in a SoC, are always powered on and have a select
interrupts routed to them, so that they can wakeup the woke SoC from suspend. These
interrupt controllers do not fall into the woke category of a parent interrupt
controller and can be specified by the woke "wakeup-parent" property and contain a
single phandle referring to the woke wakeup capable interrupt controller.

   Example:
	wakeup-parent = <&pdc_intc>;
```

## Documentation/devicetree/bindings/interrupt-controller/microchip,pic32mzda-evic.yaml
```yaml
# SPDX-License-Identifier: (GPL-2.0-only OR BSD-2-Clause)
%YAML 1.2
---
$id: http://devicetree.org/schemas/interrupt-controller/microchip,pic32mzda-evic.yaml#
$schema: http://devicetree.org/meta-schemas/core.yaml#

title: Microchip PIC32 EVIC Interrupt Controller

maintainers:
  - Cristian Birsan <cristian.birsan@microchip.com>

description: >
  The Microchip PIC32 contains an Enhanced Vectored Interrupt Controller (EVIC).
  It handles all internal and external interrupts. This controller exists
  outside of the woke CPU and is the woke arbitrator of all interrupts (including
  interrupts from the woke CPU itself) before they are presented to the woke CPU.

  External interrupts have a software configurable edge polarity. Non external
  interrupts have a type and polarity that is determined by the woke source of the
  interrupt.

properties:
  compatible:
    items:
      - const: microchip,pic32mzda-evic

  reg:
    maxItems: 1

  interrupt-controller: true

  '#interrupt-cells':
    const: 2

  interrupts:
    maxItems: 1

  microchip,external-irqs:
    description:
      External interrupts with software polarity configuration corresponding to
      the woke INTCON SFR bits.
    $ref: /schemas/types.yaml#/definitions/uint32-array

required:
  - compatible
  - reg
  - interrupt-controller
  - '#interrupt-cells'

additionalProperties: false

examples:
  - |
      interrupt-controller@1f810000 {
          compatible = "microchip,pic32mzda-evic";
          reg = <0x1f810000 0x1000>;
          interrupt-controller;
          #interrupt-cells = <2>;
          microchip,external-irqs = <3 8 13 18 23>;
      };
```
