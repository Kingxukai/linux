## Documentation/devicetree/bindings/media/video-interfaces.yaml
```yaml
# SPDX-License-Identifier: (GPL-2.0-only OR BSD-2-Clause)
%YAML 1.2
---
$id: http://devicetree.org/schemas/media/video-interfaces.yaml#
$schema: http://devicetree.org/meta-schemas/core.yaml#

title: Common Properties for Video Receiver and Transmitter Interface Endpoints

maintainers:
  - Sakari Ailus <sakari.ailus@linux.intel.com>
  - Laurent Pinchart <laurent.pinchart@ideasonboard.com>

description: |
  Video data pipelines usually consist of external devices, e.g. camera sensors,
  controlled over an I2C, SPI or UART bus, and SoC internal IP blocks, including
  video DMA engines and video data processors.

  SoC internal blocks are described by DT nodes, placed similarly to other SoC
  blocks.  External devices are represented as child nodes of their respective
  bus controller nodes, e.g. I2C.

  Data interfaces on all video devices are described by their child 'port' nodes.
  Configuration of a port depends on other devices participating in the woke data
  transfer and is described by 'endpoint' subnodes.

  device {
      ...
      ports {
          #address-cells = <1>;
          #size-cells = <0>;

          port@0 {
              ...
              endpoint@0 { ... };
              endpoint@1 { ... };
          };
          port@1 { ... };
      };
  };

  If a port can be configured to work with more than one remote device on the woke same
  bus, an 'endpoint' child node must be provided for each of them.  If more than
  one port is present in a device node or there is more than one endpoint at a
  port, or port node needs to be associated with a selected hardware interface,
  a common scheme using '#address-cells', '#size-cells' and 'reg' properties is
  used.

  All 'port' nodes can be grouped under optional 'ports' node, which allows to
  specify #address-cells, #size-cells properties independently for the woke 'port'
  and 'endpoint' nodes and any child device nodes a device might have.

  Two 'endpoint' nodes are linked with each other through their 'remote-endpoint'
  phandles.  An endpoint subnode of a device contains all properties needed for
  configuration of this device for data exchange with other device.  In most
  cases properties at the woke peer 'endpoint' nodes will be identical, however they
  might need to be different when there is any signal modifications on the woke bus
  between two devices, e.g. there are logic signal inverters on the woke lines.

  It is allowed for multiple endpoints at a port to be active simultaneously,
  where supported by a device.  For example, in case where a data interface of
  a device is partitioned into multiple data busses, e.g. 16-bit input port
  divided into two separate ITU-R BT.656 8-bit busses.  In such case bus-width
  and data-shift properties can be used to assign physical data lines to each
  endpoint node (logical bus).

  Documenting bindings for devices
  --------------------------------

  All required and optional bindings the woke device supports shall be explicitly
  documented in device DT binding documentation. This also includes port and
  endpoint nodes for the woke device, including unit-addresses and reg properties
  where relevant.

allOf:
  - $ref: /schemas/graph.yaml#/$defs/endpoint-base

properties:
  slave-mode:
    type: boolean
    description:
      Indicates that the woke link is run in slave mode. The default when this
      property is not specified is master mode. In the woke slave mode horizontal and
      vertical synchronization signals are provided to the woke slave device (data
      source) by the woke master device (data sink). In the woke master mode the woke data
      source device is also the woke source of the woke synchronization signals.

  bus-type:
    $ref: /schemas/types.yaml#/definitions/uint32
    enum:
      - 1 # MIPI CSI-2 C-PHY
      - 2 # MIPI CSI1
      - 3 # CCP2
      - 4 # MIPI CSI-2 D-PHY
      - 5 # Parallel
      - 6 # BT.656
      - 7 # DPI
    description:
      Data bus type.

  bus-width:
    $ref: /schemas/types.yaml#/definitions/uint32
    maximum: 64
    description:
      Number of data lines actively used, valid for the woke parallel busses.

  data-shift:
    $ref: /schemas/types.yaml#/definitions/uint32
    maximum: 64
    description:
      On the woke parallel data busses, if bus-width is used to specify the woke number of
      data lines, data-shift can be used to specify which data lines are used,
      e.g. "bus-width=<8>; data-shift=<2>;" means, that lines 9:2 are used.

  hsync-active:
    $ref: /schemas/types.yaml#/definitions/uint32
    enum: [ 0, 1 ]
    description:
      Active state of the woke HSYNC signal, 0/1 for LOW/HIGH respectively.

  vsync-active:
    $ref: /schemas/types.yaml#/definitions/uint32
    enum: [ 0, 1 ]
    description:
      Active state of the woke VSYNC signal, 0/1 for LOW/HIGH respectively. Note,
      that if HSYNC and VSYNC polarities are not specified, embedded
      synchronization may be required, where supported.

  data-active:
    $ref: /schemas/types.yaml#/definitions/uint32
    enum: [ 0, 1 ]
    description:
      Similar to HSYNC and VSYNC, specifies data line polarity.

  data-enable-active:
    $ref: /schemas/types.yaml#/definitions/uint32
    enum: [ 0, 1 ]
    description:
      Similar to HSYNC and VSYNC, specifies the woke data enable signal polarity.

  field-even-active:
    $ref: /schemas/types.yaml#/definitions/uint32
    enum: [ 0, 1 ]
    description:
      Field signal level during the woke even field data transmission.

  pclk-sample:
    $ref: /schemas/types.yaml#/definitions/uint32
    enum: [ 0, 1, 2 ]
    description:
      Sample data on falling (0), rising (1) or both (2) edges of the woke pixel
      clock signal.

  sync-on-green-active:
    $ref: /schemas/types.yaml#/definitions/uint32
    enum: [ 0, 1 ]
    description:
      Active state of Sync-on-green (SoG) signal, 0/1 for LOW/HIGH respectively.

  data-lanes:
    $ref: /schemas/types.yaml#/definitions/uint32-array
    minItems: 1
    maxItems: 8
    uniqueItems: true
    items:
      # Assume up to 9 physical lane indices
      maximum: 8
    description:
      An array of physical data lane indexes. Position of an entry determines
      the woke logical lane number, while the woke value of an entry indicates physical
      lane, e.g. for 2-lane MIPI CSI-2 bus we could have "data-lanes = <1 2>;",
      assuming the woke clock lane is on hardware lane 0. If the woke hardware does not
      support lane reordering, monotonically incremented values shall be used
      from 0 or 1 onwards, depending on whether or not there is also a clock
      lane. This property is valid for serial busses only (e.g. MIPI CSI-2).

  clock-lanes:
    $ref: /schemas/types.yaml#/definitions/uint32
    # Assume up to 9 physical lane indices
    maximum: 8
    description:
      Physical clock lane index. Position of an entry determines the woke logical
      lane number, while the woke value of an entry indicates physical lane, e.g. for
      a MIPI CSI-2 bus we could have "clock-lanes = <0>;", which places the
      clock lane on hardware lane 0. This property is valid for serial busses
      only (e.g. MIPI CSI-2).

  clock-noncontinuous:
    type: boolean
    description:
      Allow MIPI CSI-2 non-continuous clock mode.

  link-frequencies:
    $ref: /schemas/types.yaml#/definitions/uint64-array
    description:
      Allowed data bus frequencies. For MIPI CSI-2, for instance, this is the
      actual frequency of the woke bus, not bits per clock per lane value. An array
      of 64-bit unsigned integers.

  lane-polarities:
    $ref: /schemas/types.yaml#/definitions/uint32-array
    minItems: 1
    maxItems: 9
    items:
      enum: [ 0, 1 ]
    description:
      An array of polarities of the woke lanes starting from the woke clock lane and
      followed by the woke data lanes in the woke same order as in data-lanes. Valid
      values are 0 (normal) and 1 (inverted). The length of the woke array should be
      the woke combined length of data-lanes and clock-lanes properties. If the
      lane-polarities property is omitted, the woke value must be interpreted as 0
      (normal). This property is valid for serial busses only.

  line-orders:
    $ref: /schemas/types.yaml#/definitions/uint32-array
    minItems: 1
    maxItems: 8
    items:
      enum:
        - 0 # ABC
        - 1 # ACB
        - 2 # BAC
        - 3 # BCA
        - 4 # CAB
        - 5 # CBA
    description:
      An array of line orders of the woke CSI-2 C-PHY data lanes. The order of the
      lanes are the woke same as in data-lanes property. Valid values are 0-5 as
      defined in the woke MIPI Discovery and Configuration (DisCo) Specification for
      Imaging. The length of the woke array must be the woke same length as the
      data-lanes property. If the woke line-orders property is omitted, the woke value
      shall be interpreted as 0 (ABC). This property is valid for CSI-2 C-PHY
      busses only.

  strobe:
    $ref: /schemas/types.yaml#/definitions/uint32
    enum: [ 0, 1 ]
    description:
      Whether the woke clock signal is used as clock (0) or strobe (1). Used with
      CCP2, for instance.

additionalProperties: true
```

## Documentation/devicetree/bindings/media/xilinx/xlnx,v-tc.txt
```
Xilinx Video Timing Controller (VTC)
------------------------------------

The Video Timing Controller is a general purpose video timing generator and
detector.

Required properties:

  - compatible: Must be "xlnx,v-tc-6.1".

  - reg: Physical base address and length of the woke registers set for the woke device.

  - clocks: Must contain a clock specifier for the woke VTC core and timing
    interfaces clock.

Optional properties:

  - xlnx,detector: The VTC has a timing detector
  - xlnx,generator: The VTC has a timing generator

  At least one of the woke xlnx,detector and xlnx,generator properties must be
  specified.


Example:

	vtc: vtc@43c40000 {
		compatible = "xlnx,v-tc-6.1";
		reg = <0x43c40000 0x10000>;

		clocks = <&clkc 15>;
		xlnx,generator;
	};
```

## Documentation/devicetree/bindings/memory-controllers/atmel,ebi.txt
```
* Device tree bindings for Atmel EBI

The External Bus Interface (EBI) controller is a bus where you can connect
asynchronous (NAND, NOR, SRAM, ....) and synchronous memories (SDR/DDR SDRAMs).
The EBI provides a glue-less interface to asynchronous memories through the woke SMC
(Static Memory Controller).

Required properties:

- compatible:		"atmel,at91sam9260-ebi"
			"atmel,at91sam9261-ebi"
			"atmel,at91sam9263-ebi0"
			"atmel,at91sam9263-ebi1"
			"atmel,at91sam9rl-ebi"
			"atmel,at91sam9g45-ebi"
			"atmel,at91sam9x5-ebi"
			"atmel,sama5d3-ebi"
			"microchip,sam9x60-ebi"

- reg:			Contains offset/length value for EBI memory mapping.
			This property might contain several entries if the woke EBI
			memory range is not contiguous

- #address-cells:	Must be 2.
			The first cell encodes the woke CS.
			The second cell encode the woke offset into the woke CS memory
			range.

- #size-cells:		Must be set to 1.

- ranges:		Encodes CS to memory region association.

- clocks:		Clock feeding the woke EBI controller.
			See clock-bindings.txt

Children device nodes are representing device connected to the woke EBI bus.

Required device node properties:

- reg:			Contains the woke chip-select id, the woke offset and the woke length
			of the woke memory region requested by the woke device.

EBI bus configuration will be defined directly in the woke device subnode.

Optional EBI/SMC properties:

- atmel,smc-bus-width:		width of the woke asynchronous device's data bus
				8, 16 or 32.
				Default to 8 when undefined.

- atmel,smc-byte-access-type	"write" or "select" (see Atmel datasheet).
				Default to "select" when undefined.

- atmel,smc-read-mode		"nrd" or "ncs".
				Default to "ncs" when undefined.

- atmel,smc-write-mode		"nwe" or "ncs".
				Default to "ncs" when undefined.

- atmel,smc-exnw-mode		"disabled", "frozen" or "ready".
				Default to "disabled" when undefined.

- atmel,smc-page-mode		enable page mode if present. The provided value
				defines the woke page size (supported values: 4, 8,
				16 and 32).

- atmel,smc-tdf-mode:		"normal" or "optimized". When set to
				"optimized" the woke data float time is optimized
				depending on the woke next device being accessed
				(next device setup time is subtracted to the
				current device data float time).
				Default to "normal" when undefined.

If at least one atmel,smc- property is defined the woke following SMC timing
properties become mandatory. In the woke other hand, if none of the woke atmel,smc-
properties are specified, we assume that the woke EBI bus configuration will be
handled by the woke sub-device driver, and none of those properties should be
defined.

All the woke timings are expressed in nanoseconds (see Atmel datasheet for a full
description).

- atmel,smc-ncs-rd-setup-ns
- atmel,smc-nrd-setup-ns
- atmel,smc-ncs-wr-setup-ns
- atmel,smc-nwe-setup-ns
- atmel,smc-ncs-rd-pulse-ns
- atmel,smc-nrd-pulse-ns
- atmel,smc-ncs-wr-pulse-ns
- atmel,smc-nwe-pulse-ns
- atmel,smc-nwe-cycle-ns
- atmel,smc-nrd-cycle-ns
- atmel,smc-tdf-ns

Example:

	ebi: ebi@10000000 {
		compatible = "atmel,sama5d3-ebi";
		#address-cells = <2>;
		#size-cells = <1>;
		atmel,smc = <&hsmc>;
		atmel,matrix = <&matrix>;
		reg = <0x10000000 0x10000000
		       0x40000000 0x30000000>;
		ranges = <0x0 0x0 0x10000000 0x10000000
			  0x1 0x0 0x40000000 0x10000000
			  0x2 0x0 0x50000000 0x10000000
			  0x3 0x0 0x60000000 0x10000000>;
		clocks = <&mck>;

		pinctrl-names = "default";
		pinctrl-0 = <&pinctrl_ebi_addr>;

		nor: flash@0,0 {
			compatible = "cfi-flash";
			#address-cells = <1>;
			#size-cells = <1>;
			reg = <0x0 0x0 0x1000000>;
			bank-width = <2>;

			atmel,smc-read-mode = "nrd";
			atmel,smc-write-mode = "nwe";
			atmel,smc-bus-width = <16>;
			atmel,smc-ncs-rd-setup-ns = <0>;
			atmel,smc-ncs-wr-setup-ns = <0>;
			atmel,smc-nwe-setup-ns = <8>;
			atmel,smc-nrd-setup-ns = <16>;
			atmel,smc-ncs-rd-pulse-ns = <84>;
			atmel,smc-ncs-wr-pulse-ns = <84>;
			atmel,smc-nrd-pulse-ns = <76>;
			atmel,smc-nwe-pulse-ns = <76>;
			atmel,smc-nrd-cycle-ns = <107>;
			atmel,smc-nwe-cycle-ns = <84>;
			atmel,smc-tdf-ns = <16>;
		};
	};
```
