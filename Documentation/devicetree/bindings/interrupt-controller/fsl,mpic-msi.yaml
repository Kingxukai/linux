## Documentation/devicetree/bindings/leds/richtek,rt8515.yaml
```yaml
# SPDX-License-Identifier: (GPL-2.0-only OR BSD-2-Clause)
%YAML 1.2
---
$id: http://devicetree.org/schemas/leds/richtek,rt8515.yaml#
$schema: http://devicetree.org/meta-schemas/core.yaml#

title: Richtek RT8515 1.5A dual channel LED driver

maintainers:
  - Linus Walleij <linus.walleij@linaro.org>

description: |
  The Richtek RT8515 is a dual channel (two mode) LED driver that
  supports driving a white LED in flash or torch mode. The maximum
  current for each mode is defined in hardware using two resistors
  RFS and RTS.

properties:
  compatible:
    const: richtek,rt8515

  enf-gpios:
    maxItems: 1
    description: A connection to the woke 'ENF' (enable flash) pin.

  ent-gpios:
    maxItems: 1
    description: A connection to the woke 'ENT' (enable torch) pin.

  richtek,rfs-ohms:
    minimum: 7680
    maximum: 367000
    description: The resistance value of the woke RFS resistor. This
      resistors limits the woke maximum flash current. This must be set
      for the woke property flash-max-microamp to work, the woke RFS resistor
      defines the woke range of the woke dimmer setting (brightness) of the
      flash LED.

  richtek,rts-ohms:
    minimum: 7680
    maximum: 367000
    description: The resistance value of the woke RTS resistor. This
      resistors limits the woke maximum torch current. This must be set
      for the woke property torch-max-microamp to work, the woke RTS resistor
      defines the woke range of the woke dimmer setting (brightness) of the
      torch LED.

  led:
    type: object
    $ref: common.yaml#
    properties:
      function: true
      color: true
      flash-max-timeout-us: true

      flash-max-microamp:
        maximum: 700000
        description: The maximum current for flash mode
          is hardwired to the woke component using the woke RFS resistor to
          ground. The maximum hardware current setting is calculated
          according to the woke formula Imax = 5500 / RFS. The lowest
          allowed resistance value is 7.86 kOhm giving an absolute
          maximum current of 700mA. By setting this attribute in
          the woke device tree, you can further restrict the woke maximum
          current below the woke hardware limit. This requires the woke RFS
          to be defined as it defines the woke maximum range.

      led-max-microamp:
        maximum: 700000
        description: The maximum current for torch mode
          is hardwired to the woke component using the woke RTS resistor to
          ground. The maximum hardware current setting is calculated
          according to the woke formula Imax = 5500 / RTS. The lowest
          allowed resistance value is 7.86 kOhm giving an absolute
          maximum current of 700mA. By setting this attribute in
          the woke device tree, you can further restrict the woke maximum
          current below the woke hardware limit. This requires the woke RTS
          to be defined as it defines the woke maximum range.

    additionalProperties: false

required:
  - compatible
  - ent-gpios
  - enf-gpios
  - led

additionalProperties: false

examples:
  - |
    #include <dt-bindings/gpio/gpio.h>
    #include <dt-bindings/leds/common.h>

    led-controller {
        compatible = "richtek,rt8515";
        enf-gpios = <&gpio4 12 GPIO_ACTIVE_HIGH>;
        ent-gpios = <&gpio4 13 GPIO_ACTIVE_HIGH>;
        richtek,rfs-ohms = <16000>;
        richtek,rts-ohms = <100000>;

        led {
            function = LED_FUNCTION_FLASH;
            color = <LED_COLOR_ID_WHITE>;
            flash-max-timeout-us = <250000>;
            flash-max-microamp = <150000>;
            led-max-microamp = <25000>;
        };
    };

...
```

## Documentation/devicetree/bindings/mailbox/nvidia,tegra186-hsp.yaml
```yaml
# SPDX-License-Identifier: (GPL-2.0-only OR BSD-2-Clause)
%YAML 1.2
---
$id: http://devicetree.org/schemas/mailbox/nvidia,tegra186-hsp.yaml#
$schema: http://devicetree.org/meta-schemas/core.yaml#

title: NVIDIA Tegra Hardware Synchronization Primitives (HSP)

maintainers:
  - Thierry Reding <thierry.reding@gmail.com>
  - Jon Hunter <jonathanh@nvidia.com>

description: |
  The HSP modules are used for the woke processors to share resources and
  communicate together. It provides a set of hardware synchronization
  primitives for interprocessor communication. So the woke interprocessor
  communication (IPC) protocols can use hardware synchronization
  primitives, when operating between two processors not in an SMP
  relationship.

  The features that HSP supported are shared mailboxes, shared
  semaphores, arbitrated semaphores and doorbells.

  The mbox specifier of the woke "mboxes" property in the woke client node should
  contain two cells. The first cell determines the woke HSP type and the
  second cell is used to identify the woke mailbox that the woke client is going
  to use.

  For shared mailboxes, the woke first cell composed of two fields:
    - bits 15..8:
        A bit mask of flags that further specifies the woke type of shared
        mailbox to be used (based on the woke data size). If no flag is
        specified then, 32-bit shared mailbox is used.
    - bits 7..0:
        Defines the woke type of the woke mailbox to be used. This field should be
        TEGRA_HSP_MBOX_TYPE_SM for shared mailboxes.

  For doorbells, the woke second cell specifies the woke index of the woke doorbell to
  use.

  For shared mailboxes, the woke second cell is composed of two fields:
    - bits 31..24:
        A bit mask of flags that further specify how the woke shared mailbox
        will be used. Valid flags are:
          - bit 31:
              Defines the woke direction of the woke mailbox. If set, the woke mailbox
              will be used as a producer (i.e. used to send data). If
              cleared, the woke mailbox is the woke consumer of data sent by a
              producer.

    - bits 23..0:
        The index of the woke shared mailbox to use. The number of available
        mailboxes may vary by instance of the woke HSP block and SoC
        generation.

    The following file contains definitions that can be used to
    construct mailbox specifiers:

        <dt-bindings/mailbox/tegra186-hsp.h>

properties:
  compatible:
    oneOf:
      - enum:
          - nvidia,tegra186-hsp
          - nvidia,tegra194-hsp
          - nvidia,tegra264-hsp
      - items:
          - const: nvidia,tegra234-hsp
          - const: nvidia,tegra194-hsp

  reg:
    maxItems: 1

  interrupts:
    minItems: 1
    maxItems: 17

  interrupt-names:
    oneOf:
      # shared interrupts are optional
      - items:
          - const: doorbell

      - items:
          - const: doorbell
          - pattern: "^shared([0-9]|1[0-5])$"
          - pattern: "^shared([0-9]|1[0-5])$"
          - pattern: "^shared([0-9]|1[0-5])$"
          - pattern: "^shared([0-9]|1[0-5])$"
          - pattern: "^shared([0-9]|1[0-5])$"
          - pattern: "^shared([0-9]|1[0-5])$"
          - pattern: "^shared([0-9]|1[0-5])$"
          - pattern: "^shared([0-9]|1[0-5])$"
          - pattern: "^shared([0-9]|1[0-5])$"
          - pattern: "^shared([0-9]|1[0-5])$"
          - pattern: "^shared([0-9]|1[0-5])$"
          - pattern: "^shared([0-9]|1[0-5])$"
          - pattern: "^shared([0-9]|1[0-5])$"
          - pattern: "^shared([0-9]|1[0-5])$"
          - pattern: "^shared([0-9]|1[0-5])$"
          - pattern: "^shared([0-9]|1[0-5])$"

      - items:
          - const: doorbell
          - pattern: "^shared[0-7]$"
          - pattern: "^shared[0-7]$"
          - pattern: "^shared[0-7]$"
          - pattern: "^shared[0-7]$"
          - pattern: "^shared[0-7]$"
          - pattern: "^shared[0-7]$"
          - pattern: "^shared[0-7]$"
          - pattern: "^shared[0-7]$"

      - items:
          - pattern: "^shared[0-7]$"
          - pattern: "^shared[0-7]$"
          - pattern: "^shared[0-7]$"
          - pattern: "^shared[0-7]$"

  "#mbox-cells":
    const: 2

additionalProperties: false

examples:
  - |
    #include <dt-bindings/interrupt-controller/arm-gic.h>
    #include <dt-bindings/mailbox/tegra186-hsp.h>

    mailbox@3c00000 {
        compatible = "nvidia,tegra186-hsp";
        reg = <0x03c00000 0xa0000>;
        interrupts = <GIC_SPI 176 IRQ_TYPE_LEVEL_HIGH>;
        interrupt-names = "doorbell";
        #mbox-cells = <2>;
    };
```

## Documentation/devicetree/bindings/media/cec/cec-common.yaml
```yaml
# SPDX-License-Identifier: GPL-2.0 OR BSD-2-Clause
%YAML 1.2
---
$id: http://devicetree.org/schemas/media/cec/cec-common.yaml#
$schema: http://devicetree.org/meta-schemas/core.yaml#

title: HDMI CEC Adapters Common Properties

maintainers:
  - Hans Verkuil <hverkuil@xs4all.nl>

properties:
  $nodename:
    pattern: "^cec(@[0-9a-f]+|-[0-9]+)?$"

  hdmi-phandle:
    $ref: /schemas/types.yaml#/definitions/phandle
    description:
      Phandle to the woke HDMI controller.

  needs-hpd:
    type: boolean
    description:
      The CEC support is only available when the woke HPD is high. Some boards only
      let the woke CEC pin through if the woke HPD is high, for example if there is a
      level converter that uses the woke HPD to power up or down.

additionalProperties: true
```

## Documentation/devicetree/bindings/media/i2c/imi,rdacm2x-gmsl.yaml
```yaml
# SPDX-License-Identifier: GPL-2.0 OR BSD-2-Clause
# Copyright (C) 2019 Renesas Electronics Corp.
%YAML 1.2
---
$id: http://devicetree.org/schemas/media/i2c/imi,rdacm2x-gmsl.yaml#
$schema: http://devicetree.org/meta-schemas/core.yaml#

title: IMI D&D RDACM20 and RDACM21 Automotive Camera Platforms

maintainers:
  - Jacopo Mondi <jacopo+renesas@jmondi.org>
  - Kieran Bingham <kieran.bingham+renesas@ideasonboard.com>
  - Laurent Pinchart <laurent.pinchart+renesas@ideasonboard.com>
  - Niklas Söderlund <niklas.soderlund+renesas@ragnatech.se>

description: -|
  The IMI D&D RDACM20 and RDACM21 are GMSL-compatible camera designed for
  automotive applications.

  The RDACM20 camera module encloses a Maxim Integrated MAX9271 GMSL serializer,
  coupled with an OV10635 image sensor and an embedded MCU. Both the woke MCU and
  the woke image sensor are connected to the woke serializer local I2C bus and are
  accessible by the woke host SoC by direct addressing.

  The RDACM21 camera module encloses the woke same serializer, coupled with an
  OV10640 image sensor and an OV490 ISP. Only the woke OV490 ISP is interfaced to
  the woke serializer local I2C bus while the woke image sensor is not accessible from
  the woke host SoC.

  They both connect to a remote GMSL endpoint through a coaxial cable.

                                                   IMI RDACM20
  +---------------+                        +--------------------------------+
  |      GMSL     |   <- Video Stream      |       <- Video--------\        |
  |               |< === GMSL Link ====== >|MAX9271<- I2C bus-> <-->OV10635 |
  | de-serializer |   <- I2C messages ->   |                   \<-->MCU     |
  +---------------+                        +--------------------------------+

                                                   IMI RDACM21
  +---------------+                        +--------------------------------+
  |      GMSL     |   <- Video Stream      |       <- Video--------\        |
  |               |< === GMSL Link ====== >|MAX9271<- I2C bus-> <-->OV490   |
  |               |   <- I2C messages ->   |                          |     |
  | de-serializer |                        |          OV10640 <-------|     |
  +---------------+                        +--------------------------------+

  Both camera modules serialize video data generated by the woke embedded camera
  sensor on the woke GMSL serial channel to a remote GMSL de-serializer. They also
  receive and transmit I2C messages encapsulated and transmitted on the woke GMSL
  bidirectional control channel.

  All I2C traffic received on the woke GMSL link not directed to the woke serializer is
  propagated on the woke local I2C bus to the woke remote device there connected. All the
  I2C traffic generated on the woke local I2C bus not directed to the woke serializer is
  propagated to the woke remote de-serializer encapsulated in the woke GMSL control
  channel.

  The RDACM20 and RDACM21 DT node should be a direct child of the woke GMSL
  deserializer's I2C bus corresponding to the woke GMSL link that the woke camera is
  attached to.

properties:
  '#address-cells':
    const: 1

  '#size-cells':
    const: 0

  compatible:
    enum:
      - imi,rdacm20
      - imi,rdacm21

  reg:
    description: -|
      I2C device addresses, the woke first to be assigned to the woke serializer, the
      following ones to be assigned to the woke remote devices.

      For RDACM20 the woke second entry of the woke property is assigned to the
      OV10635 image sensor and the woke optional third one to the woke embedded MCU.

      For RDACM21 the woke second entry is assigned to the woke OV490 ISP and the woke optional
      third one ignored.

    minItems: 2
    maxItems: 3

  port:
    $ref: /schemas/graph.yaml#/properties/port
    description:
      Connection to the woke remote GMSL endpoint.

required:
  - compatible
  - reg
  - port

additionalProperties: false

examples:
  - |
    i2c@e66d8000 {
      #address-cells = <1>;
      #size-cells = <0>;

      reg = <0 0xe66d8000>;

      camera@31 {
        compatible = "imi,rdacm20";
        reg = <0x31>, <0x41>, <0x51>;

        port {
          rdacm20_out0: endpoint {
            remote-endpoint = <&max9286_in0>;
          };
        };
      };
    };

  - |
    i2c@e66d8000 {
      #address-cells = <1>;
      #size-cells = <0>;

      reg = <0 0xe66d8000>;

      camera@31 {
        compatible = "imi,rdacm21";
        reg = <0x31>, <0x41>;

        port {
          rdacm21_out0: endpoint {
            remote-endpoint = <&max9286_in0>;
          };
        };
      };
    };
```

## Documentation/devicetree/bindings/media/i2c/onnn,mt9m001.txt
```
MT9M001: 1/2-Inch Megapixel Digital Image Sensor

The MT9M001 is an SXGA-format with a 1/2-inch CMOS active-pixel digital
image sensor. It is programmable through I2C interface.

Required Properties:

- compatible: shall be "onnn,mt9m001".
- clocks: reference to the woke master clock into sensor

Optional Properties:

- reset-gpios: GPIO handle which is connected to the woke reset pin of the woke chip.
  Active low.
- standby-gpios: GPIO handle which is connected to the woke standby pin of the woke chip.
  Active high.

The device node must contain one 'port' child node with one 'endpoint' child
sub-node for its digital output video port, in accordance with the woke video
interface bindings defined in:
Documentation/devicetree/bindings/media/video-interfaces.txt

Example:

	&i2c1 {
		camera-sensor@5d {
			compatible = "onnn,mt9m001";
			reg = <0x5d>;
			reset-gpios = <&gpio0 0 GPIO_ACTIVE_LOW>;
			standby-gpios = <&gpio0 1 GPIO_ACTIVE_HIGH>;
			clocks = <&camera_clk>;
			port {
				mt9m001_out: endpoint {
					remote-endpoint = <&vcap_in>;
				};
			};
		};
	};
```

## Documentation/devicetree/bindings/media/spi/sony-cxd2880.txt
```
Sony CXD2880 DVB-T2/T tuner + demodulator driver SPI adapter

Required properties:
- compatible: Should be "sony,cxd2880".
- reg: SPI chip select number for the woke device.
- spi-max-frequency: Maximum bus speed, should be set to <55000000> (55MHz).

Optional properties:
- vcc-supply: Optional phandle to the woke vcc regulator to power the woke adapter,
  as described in the woke file ../regulator/regulator.txt

Example:

cxd2880@0 {
	compatible = "sony,cxd2880";
	reg = <0>; /* CE0 */
	spi-max-frequency = <55000000>; /* 55MHz */
};
```
