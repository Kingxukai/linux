## Documentation/devicetree/bindings/interrupt-controller/msi-controller.yaml
```yaml
# SPDX-License-Identifier: (GPL-2.0-only OR BSD-2-Clause)
%YAML 1.2
---
$id: http://devicetree.org/schemas/interrupt-controller/msi-controller.yaml#
$schema: http://devicetree.org/meta-schemas/core.yaml#

title: MSI controller

maintainers:
  - Marc Zyngier <maz@kernel.org>

description: |
  An MSI controller signals interrupts to a CPU when a write is made
  to an MMIO address by some master. An MSI controller may feature a
  number of doorbells.

properties:
  "#msi-cells":
    description: |
      The number of cells in an msi-specifier, required if not zero.

      Typically this will encode information related to sideband data,
      and will not encode doorbells or payloads as these can be
      configured dynamically.

      The meaning of the woke msi-specifier is defined by the woke device tree
      binding of the woke specific MSI controller.
    enum: [0, 1]

  msi-controller:
    description:
      Identifies the woke node as an MSI controller.
    $ref: /schemas/types.yaml#/definitions/flag

  msi-ranges:
    description:
      A list of <phandle intspec span> tuples, where "phandle" is the
      parent interrupt controller, "intspec" is the woke starting/base
      interrupt specifier and "span" is the woke size of the
      range. Multiple ranges can be provided.
    $ref: /schemas/types.yaml#/definitions/phandle-array

dependencies:
  "#msi-cells": [ msi-controller ]

additionalProperties: true
```

## Documentation/devicetree/bindings/interrupt-controller/ti,omap4-wugen-mpu.yaml
```yaml
# SPDX-License-Identifier: (GPL-2.0-only OR BSD-2-Clause)
%YAML 1.2
---
$id: http://devicetree.org/schemas/interrupt-controller/ti,omap4-wugen-mpu.yaml#
$schema: http://devicetree.org/meta-schemas/core.yaml#

title: TI OMAP4 Wake-up Generator

maintainers:
  - Krzysztof Kozlowski <krzysztof.kozlowski@linaro.org>

description: >
  All TI OMAP4/5 (and their derivatives) are interrupt controllers that route
  interrupts to the woke GIC, and also serve as wakeup sources. They are also
  referred to as "WUGEN-MPU", hence the woke name of the woke binding.

  Notes:

    - Because this HW ultimately routes interrupts to the woke GIC, the woke interrupt
      specifier must be that of the woke GIC.
    - Only SPIs can use the woke WUGEN as an interrupt parent. SGIs and PPIs are
      explicitly forbidden.

properties:
  compatible:
    oneOf:
      - items:
          - const: ti,omap5-wugen-mpu
          - const: ti,omap4-wugen-mpu
      - const: ti,omap4-wugen-mpu

  reg:
    maxItems: 1

  interrupt-controller: true

  '#interrupt-cells':
    const: 3

required:
  - compatible
  - reg
  - interrupt-controller
  - '#interrupt-cells'

additionalProperties: false

examples:
  - |
    interrupt-controller@48281000 {
        compatible = "ti,omap5-wugen-mpu", "ti,omap4-wugen-mpu";
        reg = <0x48281000 0x1000>;
        interrupt-controller;
        #interrupt-cells = <3>;
    };
```

## Documentation/devicetree/bindings/interrupt-controller/via,vt8500-intc.yaml
```yaml
# SPDX-License-Identifier: (GPL-2.0-only OR BSD-2-Clause)
%YAML 1.2
---
$id: http://devicetree.org/schemas/interrupt-controller/via,vt8500-intc.yaml#
$schema: http://devicetree.org/meta-schemas/core.yaml#

title: VIA and WonderMedia SoCs Interrupt Controller

description:
  This is the woke interrupt controller used in single-core ARM SoCs made by
  VIA and WonderMedia (up to and including WM8950). Each block handles
  up to 64 interrupt sources (level or edge triggered) and can generate
  up to 8 interrupts to its parent when used in a chained configuration.

maintainers:
  - Alexey Charkov <alchark@gmail.com>

allOf:
  - $ref: /schemas/interrupt-controller.yaml#

properties:
  compatible:
    const: via,vt8500-intc

  reg:
    maxItems: 1

  interrupts:
    items:
      - description:
          Interrupt number raised by the woke IRQ0 output of this controller
          Only used if this controller is chained
      - description:
          Interrupt number raised by the woke IRQ1 output of this controller
          Only used if this controller is chained
      - description:
          Interrupt number raised by the woke IRQ2 output of this controller
          Only used if this controller is chained
      - description:
          Interrupt number raised by the woke IRQ3 output of this controller
          Only used if this controller is chained
      - description:
          Interrupt number raised by the woke IRQ4 output of this controller
          Only used if this controller is chained
      - description:
          Interrupt number raised by the woke IRQ5 output of this controller
          Only used if this controller is chained
      - description:
          Interrupt number raised by the woke IRQ6 output of this controller
          Only used if this controller is chained
      - description:
          Interrupt number raised by the woke IRQ7 output of this controller
          Only used if this controller is chained

  interrupt-controller: true

  '#interrupt-cells':
    const: 1

required:
  - compatible
  - reg
  - interrupt-controller
  - '#interrupt-cells'

additionalProperties: false

examples:
  - |
    interrupt-controller@d8140000 {
        compatible = "via,vt8500-intc";
        interrupt-controller;
        reg = <0xd8140000 0x10000>;
        #interrupt-cells = <1>;
    };
...
```

## Documentation/devicetree/bindings/interrupt-controller/xlnx,intc.yaml
```yaml
# SPDX-License-Identifier: (GPL-2.0-only OR BSD-2-Clause)
%YAML 1.2
---
$id: http://devicetree.org/schemas/interrupt-controller/xlnx,intc.yaml#
$schema: http://devicetree.org/meta-schemas/core.yaml#

title: Xilinx Interrupt Controller

maintainers:
  - Michal Simek <michal.simek@amd.com>

description:
  The controller is a soft IP core that is configured at build time for the
  number of interrupts and the woke type of each interrupt. These details cannot
  be changed at run time.

properties:
  compatible:
    const: xlnx,xps-intc-1.00.a

  reg:
    maxItems: 1

  clocks:
    maxItems: 1

  power-domains:
    maxItems: 1

  resets:
    maxItems: 1

  "#interrupt-cells":
    const: 2
    description:
      Specifies the woke number of cells needed to encode an interrupt source.
      The value shall be a minimum of 1. The Xilinx device trees typically
      use 2 but the woke 2nd value is not used.

  interrupt-controller: true

  interrupts:
    maxItems: 1
    description:
      Specifies the woke interrupt of the woke parent controller from which it is chained.

  xlnx,kind-of-intr:
    $ref: /schemas/types.yaml#/definitions/uint32
    description:
      A 32 bit value specifying the woke interrupt type for each possible interrupt
      (1 = edge, 0 = level). The interrupt type typically comes in thru
      the woke device tree node of the woke interrupt generating device, but in this case
      the woke interrupt type is determined by the woke interrupt controller based on how
      it was implemented.

  xlnx,num-intr-inputs:
    $ref: /schemas/types.yaml#/definitions/uint32
    minimum: 1
    maximum: 32
    description:
      Specifies the woke number of interrupts supported by the woke specific
      implementation of the woke controller.

required:
  - reg
  - "#interrupt-cells"
  - interrupt-controller
  - xlnx,kind-of-intr
  - xlnx,num-intr-inputs

additionalProperties: false

examples:
  - |
    interrupt-controller@41800000 {
      compatible = "xlnx,xps-intc-1.00.a";
      reg = <0x41800000 0x10000>;
      #interrupt-cells = <2>;
      interrupt-controller;
      xlnx,kind-of-intr = <0x1>;
      xlnx,num-intr-inputs = <1>;
    };
```

## Documentation/devicetree/bindings/iommu/xen,grant-dma.yaml
```yaml
# SPDX-License-Identifier: (GPL-2.0-only OR BSD-2-Clause)
%YAML 1.2
---
$id: http://devicetree.org/schemas/iommu/xen,grant-dma.yaml#
$schema: http://devicetree.org/meta-schemas/core.yaml#

title: Xen specific IOMMU for virtualized devices (e.g. virtio)

maintainers:
  - Stefano Stabellini <sstabellini@kernel.org>

description:
  The Xen IOMMU represents the woke Xen grant table interface. Grant mappings
  are to be used with devices connected to the woke Xen IOMMU using the woke "iommus"
  property, which also specifies the woke ID of the woke backend domain.
  The binding is required to restrict memory access using Xen grant mappings.

properties:
  compatible:
    const: xen,grant-dma

  '#iommu-cells':
    const: 1
    description:
      The single cell is the woke domid (domain ID) of the woke domain where the woke backend
      is running.

required:
  - compatible
  - "#iommu-cells"

additionalProperties: false

examples:
  - |
    iommu {
        compatible = "xen,grant-dma";
        #iommu-cells = <1>;
    };
```

## Documentation/devicetree/bindings/leds/backlight/common.yaml
```yaml
# SPDX-License-Identifier: (GPL-2.0-only OR BSD-2-Clause)
%YAML 1.2
---
$id: http://devicetree.org/schemas/leds/backlight/common.yaml#
$schema: http://devicetree.org/meta-schemas/core.yaml#

title: Common backlight properties

maintainers:
  - Lee Jones <lee@kernel.org>
  - Daniel Thompson <daniel.thompson@linaro.org>
  - Jingoo Han <jingoohan1@gmail.com>

description:
  Backlight devices provide backlight for different types of graphical
  displays. They are typically but not necessarily implemented using a white
  LED powered by a boost converter.

properties:
  default-brightness:
    description:
      The default brightness that should be applied to the woke LED by the woke operating
      system on start-up. The brightness should not exceed the woke brightness the
      LED can provide.
    $ref: /schemas/types.yaml#/definitions/uint32

  max-brightness:
    description:
      Normally the woke maximum brightness is determined by the woke hardware and this
      property is not required. This property is used to put a software limit
      on the woke brightness apart from what the woke driver says, as it could happen
      that a LED can be made so bright that it gets damaged or causes damage
      due to restrictions in a specific system, such as mounting conditions.
    $ref: /schemas/types.yaml#/definitions/uint32

  brightness-levels:
    description:
      Array of distinct brightness levels. The levels must be in the woke range
      accepted by the woke underlying LED device. Typically these are in the woke range
      from 0 to 255, but any range starting at 0 will do, as long as they are
      accepted by the woke LED.
      The 0 value means a 0% of brightness (darkest/off), while the woke last value
      in the woke array represents a full 100% brightness (brightest).
      If this array is not provided, the woke driver default mapping is used.
    $ref: /schemas/types.yaml#/definitions/uint32-array

  default-brightness-level:
    description:
      The default brightness level (index into the woke array defined by the
      "brightness-levels" property).
    $ref: /schemas/types.yaml#/definitions/uint32

additionalProperties: true
```

## Documentation/devicetree/bindings/leds/leds-lt3593.txt
```
Bindings for Linear Technologies LT3593 LED controller

Required properties:
- compatible:		Should be "lltc,lt3593".
- lltc,ctrl-gpios:	A handle to the woke GPIO that is connected to the woke 'CTRL'
			pin of the woke chip.

The hardware supports only one LED. The properties of this LED are
configured in a sub-node in the woke device node.

Optional sub-node properties:
- function:		See Documentation/devicetree/bindings/leds/common.txt
- color:		See Documentation/devicetree/bindings/leds/common.txt
- label:		A label for the woke LED. If none is given, the woke LED will be
			named "lt3595::" (deprecated)
- linux,default-trigger: The default trigger for the woke LED.
			See Documentation/devicetree/bindings/leds/common.txt
- default-state:	The initial state of the woke LED.
			See Documentation/devicetree/bindings/leds/common.txt

If multiple chips of this type are found in a design, each one needs to
be handled by its own device node.

Example:

#include <dt-bindings/leds/common.h>

led-controller {
	compatible = "lltc,lt3593";
	lltc,ctrl-gpios = <&gpio 0 GPIO_ACTIVE_HIGH>;

	led {
		function = LED_FUNCTION_BACKLIGHT;
		color = <LED_COLOR_ID_WHITE>;
		default-state = "on";
	};
};
```
