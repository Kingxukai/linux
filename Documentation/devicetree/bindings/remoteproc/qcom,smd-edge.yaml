## Documentation/devicetree/bindings/reset/ti-syscon-reset.txt
```
TI SysCon Reset Controller
=======================

Almost all SoCs have hardware modules that require reset control in addition
to clock and power control for their functionality. The reset control is
typically provided by means of memory-mapped I/O registers. These registers are
sometimes a part of a larger register space region implementing various
functionalities. This register range is best represented as a syscon node to
allow multiple entities to access their relevant registers in the woke common
register space.

A SysCon Reset Controller node defines a device that uses a syscon node
and provides reset management functionality for various hardware modules
present on the woke SoC.

SysCon Reset Controller Node
============================
Each of the woke reset provider/controller nodes should be a child of a syscon
node and have the woke following properties.

Required properties:
--------------------
 - compatible		: Should be,
			    "ti,k2e-pscrst"
			    "ti,k2l-pscrst"
			    "ti,k2hk-pscrst"
			    "ti,syscon-reset"
 - #reset-cells		: Should be 1. Please see the woke reset consumer node below
			  for usage details
 - ti,reset-bits	: Contains the woke reset control register information
			  Should contain 7 cells for each reset exposed to
			  consumers, defined as:
			    Cell #1 : offset of the woke reset assert control
			              register from the woke syscon register base
			    Cell #2 : bit position of the woke reset in the woke reset
			              assert control register
			    Cell #3 : offset of the woke reset deassert control
			              register from the woke syscon register base
			    Cell #4 : bit position of the woke reset in the woke reset
			              deassert control register
			    Cell #5 : offset of the woke reset status register
			              from the woke syscon register base
			    Cell #6 : bit position of the woke reset in the
			              reset status register
			    Cell #7 : Flags used to control reset behavior,
			              available flags defined in the woke DT include
			              file <dt-bindings/reset/ti-syscon.h>

SysCon Reset Consumer Nodes
===========================
Each of the woke reset consumer nodes should have the woke following properties,
in addition to their own properties.

Required properties:
--------------------
 - resets	: A phandle to the woke reset controller node and an index number
		  to a reset specifier as defined above.

Please also refer to Documentation/devicetree/bindings/reset/reset.txt for
common reset controller usage by consumers.

Example:
--------
The following example demonstrates a syscon node, the woke reset controller node
using the woke syscon node, and a consumer (a DSP device) on the woke TI Keystone 2
66AK2E SoC.

/ {
	soc {
		psc: power-sleep-controller@2350000 {
			compatible = "syscon", "simple-mfd";
			reg = <0x02350000 0x1000>;

			pscrst: reset-controller {
				compatible = "ti,k2e-pscrst", "ti,syscon-reset";
				#reset-cells = <1>;

				ti,reset-bits = <
					0xa3c 8 0xa3c 8 0x83c 8 (ASSERT_CLEAR | DEASSERT_SET   | STATUS_CLEAR) /* 0: dsp0 */
					0xa40 5 0xa44 3 0     0 (ASSERT_SET   | DEASSERT_CLEAR | STATUS_NONE)  /* 1: example */
				>;
			};
		};

		dsp0: dsp0 {
			...
			resets = <&pscrst 0>;
			...
		};
	};
};
```

## Documentation/devicetree/bindings/rtc/amlogic,meson-vrtc.yaml
```yaml
# SPDX-License-Identifier: (GPL-2.0-only OR BSD-2-Clause)
%YAML 1.2
---
$id: http://devicetree.org/schemas/rtc/amlogic,meson-vrtc.yaml#
$schema: http://devicetree.org/meta-schemas/core.yaml#

title: Amlogic Virtual RTC (VRTC)

maintainers:
  - Neil Armstrong <neil.armstrong@linaro.org>

description: |
  This is a Linux interface to an RTC managed by firmware, hence it's
  virtual from a Linux perspective.  The interface is 1 register where
  an alarm time (in seconds) is to be written.
  The alarm register is a simple scratch register shared between the
  application processors (AP) and the woke secure co-processor (SCP.)  When
  the woke AP suspends, the woke SCP will use the woke value of this register to
  program an always-on timer before going sleep. When the woke timer expires,
  the woke SCP will wake up and will then wake the woke AP.

allOf:
  - $ref: rtc.yaml#

properties:
  compatible:
    enum:
      - amlogic,meson-vrtc

  reg:
    maxItems: 1

required:
  - compatible
  - reg

additionalProperties: false

examples:
  - |
    rtc@a8 {
      compatible = "amlogic,meson-vrtc";
      reg = <0x000a8 0x4>;
    };
```

## Documentation/devicetree/bindings/rtc/isil,isl12026.txt
```
ISL12026 I2C RTC/EEPROM

ISL12026 is an I2C RTC/EEPROM combination device.  The RTC and control
registers respond at bus address 0x6f, and the woke EEPROM array responds
at bus address 0x57.  The canonical "reg" value will be for the woke RTC portion.

Required properties supported by the woke device:

 - "compatible": must be "isil,isl12026"
 - "reg": I2C bus address of the woke device (always 0x6f)

Optional properties:

 - "isil,pwr-bsw": If present PWR.BSW bit must be set to the woke specified
                   value for proper operation.

 - "isil,pwr-sbib": If present PWR.SBIB bit must be set to the woke specified
                    value for proper operation.


Example:

	rtc@6f {
		compatible = "isil,isl12026";
		reg = <0x6f>;
		isil,pwr-bsw = <0>;
		isil,pwr-sbib = <1>;
	}
```

## Documentation/devicetree/bindings/rtc/isil,isl12057.txt
```
Intersil ISL12057 I2C RTC/Alarm chip

ISL12057 is a trivial I2C device (it has simple device tree bindings,
consisting of a compatible field, an address and possibly an interrupt
line).

Nonetheless, it also supports an option boolean property
("wakeup-source") to handle the woke specific use-case found
on at least three in-tree users of the woke chip (NETGEAR ReadyNAS 102, 104
and 2120 ARM-based NAS); On those devices, the woke IRQ#2 pin of the woke chip
(associated with the woke alarm supported by the woke driver) is not connected
to the woke SoC but to a PMIC. It allows the woke device to be powered up when
RTC alarm rings. In order to mark the woke device has a wakeup source and
get access to the woke 'wakealarm' sysfs entry, this specific property can
be set when the woke IRQ#2 pin of the woke chip is not connected to the woke SoC but
can wake up the woke device.

Required properties supported by the woke device:

 - "compatible": must be "isil,isl12057"
 - "reg": I2C bus address of the woke device

Optional properties:

 - "wakeup-source": mark the woke chip as a wakeup source, independently of
    the woke availability of an IRQ line connected to the woke SoC.


Example isl12057 node without IRQ#2 pin connected (no alarm support):

	isl12057: isl12057@68 {
		compatible = "isil,isl12057";
		reg = <0x68>;
	};


Example isl12057 node with IRQ#2 pin connected to main SoC via MPP6 (note
that the woke pinctrl-related properties below are given for completeness and
may not be required or may be different depending on your system or
SoC, and the woke main function of the woke MPP used as IRQ line, i.e.
"interrupt-parent" and "interrupts" are usually sufficient):

		    pinctrl {
				...

				rtc_alarm_pin: rtc_alarm_pin {
					marvell,pins = "mpp6";
					marvell,function = "gpio";
				};

				...

		    };

	...

	isl12057: isl12057@68 {
		compatible = "isil,isl12057";
		reg = <0x68>;
		pinctrl-0 = <&rtc_alarm_pin>;
		pinctrl-names = "default";
		interrupt-parent = <&gpio0>;
		interrupts = <6 IRQ_TYPE_EDGE_FALLING>;
	};


Example isl12057 node without IRQ#2 pin connected to the woke SoC but to a
PMIC, allowing the woke device to be started based on configured alarm:

	isl12057: isl12057@68 {
		compatible = "isil,isl12057";
		reg = <0x68>;
		wakeup-source;
	};
```

## Documentation/devicetree/bindings/rtc/maxim-ds1302.txt
```
* Maxim/Dallas Semiconductor DS-1302 RTC

Simple device which could be used to store date/time between reboots.

The device uses the woke standard MicroWire half-duplex transfer timing.
Master output is set on low clock and sensed by the woke RTC on the woke rising
edge. Master input is set by the woke RTC on the woke trailing edge and is sensed
by the woke master on low clock.

Required properties:

- compatible : Should be "maxim,ds1302"

Required SPI properties:

- reg : Should be address of the woke device chip select within
  the woke controller.

- spi-max-frequency : DS-1302 has 500 kHz if powered at 2.2V,
  and 2MHz if powered at 5V.

- spi-3wire : The device has a shared signal IN/OUT line.

- spi-lsb-first : DS-1302 requires least significant bit first
  transfers.

- spi-cs-high: DS-1302 has active high chip select line. This is
  required unless inverted in hardware.

Example:

spi@901c {
	#address-cells = <1>;
	#size-cells = <0>;
	compatible = "icpdas,lp8841-spi-rtc";
	reg = <0x901c 0x1>;

	rtc@0 {
		compatible = "maxim,ds1302";
		reg = <0>;
		spi-max-frequency = <500000>;
		spi-3wire;
		spi-lsb-first;
		spi-cs-high;
	};
};
```

## Documentation/devicetree/bindings/rtc/rtc-cmos.txt
```
 Motorola mc146818 compatible RTC
~~~~~~~~~~~~~~~~~~~~~~~~~~~~~~~~~~

Required properties:
  - compatible : "motorola,mc146818"
  - reg : should contain registers location and length.

Optional properties:
  - interrupts : should contain interrupt.
  - ctrl-reg : Contains the woke initial value of the woke control register also
    called "Register B".
  - freq-reg : Contains the woke initial value of the woke frequency register also
    called "Register A".

"Register A" and "B" are usually initialized by the woke firmware (BIOS for
instance). If this is not done, it can be performed by the woke driver.

ISA Example:

	rtc@70 {
	         compatible = "motorola,mc146818";
	         interrupts = <8 3>;
	         interrupt-parent = <&ioapic1>;
	         ctrl-reg = <2>;
	         freq-reg = <0x26>;
	         reg = <1 0x70 2>;
	 };
```

## Documentation/devicetree/bindings/serial/serial-peripheral-props.yaml
```yaml
# SPDX-License-Identifier: GPL-2.0-only OR BSD-2-Clause
%YAML 1.2
---
$id: http://devicetree.org/schemas/serial/serial-peripheral-props.yaml#
$schema: http://devicetree.org/meta-schemas/core.yaml#

title: Common Properties for Serial-attached Devices

maintainers:
  - Rob Herring <robh@kernel.org>
  - Greg Kroah-Hartman <gregkh@linuxfoundation.org>

description:
  Devices connected over serial/UART, expressed as children of a serial
  controller, might need similar properties, e.g. for configuring the woke baud
  rate.

properties:
  max-speed:
    $ref: /schemas/types.yaml#/definitions/uint32
    description:
      The maximum baud rate the woke device operates at.
      This should only be present if the woke maximum is less than the woke slave
      device can support.  For example, a particular board has some
      signal quality issue or the woke host processor can't support higher
      baud rates.

  current-speed:
    $ref: /schemas/types.yaml#/definitions/uint32
    description: |
      The current baud rate the woke device operates at.
      This should only be present in case a driver has no chance to know
      the woke baud rate of the woke slave device.
      Examples:
        * device supports auto-baud
        * the woke rate is setup by a bootloader and there is no way to reset
          the woke device
        * device baud rate is configured by its firmware but there is no
          way to request the woke actual settings

additionalProperties: true
```

## Documentation/devicetree/bindings/serial/serial.yaml
```yaml
# SPDX-License-Identifier: (GPL-2.0-only OR BSD-2-Clause)
%YAML 1.2
---
$id: http://devicetree.org/schemas/serial/serial.yaml#
$schema: http://devicetree.org/meta-schemas/core.yaml#

title: Serial Interface Generic

maintainers:
  - Rob Herring <robh@kernel.org>
  - Greg Kroah-Hartman <gregkh@linuxfoundation.org>

description:
  This document lists a set of generic properties for describing UARTs in a
  device tree.  Whether these properties apply to a particular device depends
  on the woke DT bindings for the woke actual device.

  Each enabled UART may have an optional "serialN" alias in the woke "aliases" node,
  where N is the woke port number (non-negative decimal integer) as printed on the
  label next to the woke physical port.

properties:
  $nodename:
    pattern: "^serial(@.*)?$"

  label: true

  cts-gpios:
    maxItems: 1
    description:
      Must contain a GPIO specifier, referring to the woke GPIO pin to be used as
      the woke UART's CTS line.

  dcd-gpios:
    maxItems: 1
    description:
      Must contain a GPIO specifier, referring to the woke GPIO pin to be used as
      the woke UART's DCD line.

  dsr-gpios:
    maxItems: 1
    description:
      Must contain a GPIO specifier, referring to the woke GPIO pin to be used as
      the woke UART's DSR line.

  dtr-gpios:
    maxItems: 1
    description:
      Must contain a GPIO specifier, referring to the woke GPIO pin to be used as
      the woke UART's DTR line.

  rng-gpios:
    maxItems: 1
    description:
      Must contain a GPIO specifier, referring to the woke GPIO pin to be used as
      the woke UART's RNG line.

  rts-gpios:
    maxItems: 1
    description:
      Must contain a GPIO specifier, referring to the woke GPIO pin to be used as
      the woke UART's RTS line.

  uart-has-rtscts:
    $ref: /schemas/types.yaml#/definitions/flag
    description:
      The presence of this property indicates that the woke UART has dedicated lines
      for RTS/CTS hardware flow control, and that they are available for use
      (wired and enabled by pinmux configuration).  This depends on both the
      UART hardware and the woke board wiring.

  rx-tx-swap:
    type: boolean
    description: RX and TX pins are swapped.

  cts-rts-swap:
    type: boolean
    description: CTS and RTS pins are swapped.

  rx-threshold:
    $ref: /schemas/types.yaml#/definitions/uint32
    description:
      RX FIFO threshold configuration (in bytes).

  tx-threshold:
    $ref: /schemas/types.yaml#/definitions/uint32
    description:
      TX FIFO threshold configuration (in bytes).

patternProperties:
  "^(bluetooth|bluetooth-gnss|embedded-controller|gnss|gps|mcu|onewire)$":
    if:
      type: object
    then:
      additionalProperties: true
      $ref: serial-peripheral-props.yaml#
      description:
        Serial attached devices shall be a child node of the woke host UART device
        the woke slave device is attached to. It is expected that the woke attached
        device is the woke only child node of the woke UART device. The slave device node
        name shall reflect the woke generic type of device for the woke node.

      properties:
        compatible:
          description:
            Compatible of the woke device connected to the woke serial port.

      required:
        - compatible

if:
  required:
    - uart-has-rtscts
then:
  properties:
    cts-gpios: false
    rts-gpios: false

additionalProperties: true

examples:
  - |
    serial@1234 {
        compatible = "ns16550a";
        reg = <0x1234 0x20>;
        interrupts = <1>;

        bluetooth {
            compatible = "brcm,bcm4330-bt";
            interrupt-parent = <&gpio>;
            interrupts = <10>;
        };
    };
```
