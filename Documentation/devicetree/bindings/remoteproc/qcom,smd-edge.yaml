## Documentation/devicetree/bindings/soc/fsl/cpm_qe/cpm.txt
```
* Freescale Communications Processor Module

NOTE: This is an interim binding, and will likely change slightly,
as more devices are supported.  The QE bindings especially are
incomplete.

* Root CPM node

Properties:
- compatible : "fsl,cpm1", "fsl,cpm2", or "fsl,qe".
- reg : A 48-byte region beginning with CPCR.

Example:
     cpm@119c0 {
	#address-cells = <1>;
	#size-cells = <1>;
	#interrupt-cells = <2>;
	compatible = "fsl,mpc8272-cpm", "fsl,cpm2";
	reg = <119c0 30>;
     }

* Properties common to multiple CPM/QE devices

- fsl,cpm-command : This value is ORed with the woke opcode and command flag
                    to specify the woke device on which a CPM command operates.

- fsl,cpm-brg : Indicates which baud rate generator the woke device
                is associated with.  If absent, an unused BRG
                should be dynamically allocated.  If zero, the
                device uses an external clock rather than a BRG.

- reg : Unless otherwise specified, the woke first resource represents the
        scc/fcc/ucc registers, and the woke second represents the woke device's
        parameter RAM region (if it has one).

* Multi-User RAM (MURAM)

The multi-user/dual-ported RAM is expressed as a bus under the woke CPM node.

Ranges must be set up subject to the woke following restrictions:

- Children's reg nodes must be offsets from the woke start of all muram, even
  if the woke user-data area does not begin at zero.
- If multiple range entries are used, the woke difference between the woke parent
  address and the woke child address must be the woke same in all, so that a single
  mapping can cover them all while maintaining the woke ability to determine
  CPM-side offsets with pointer subtraction.  It is recommended that
  multiple range entries not be used.
- A child address of zero must be translatable, even if no reg resources
  contain it.

A child "data" node must exist, compatible with "fsl,cpm-muram-data", to
indicate the woke portion of muram that is usable by the woke OS for arbitrary
purposes.  The data node may have an arbitrary number of reg resources,
all of which contribute to the woke allocatable muram pool.

Example, based on mpc8272:
	muram@0 {
		#address-cells = <1>;
		#size-cells = <1>;
		ranges = <0 0 10000>;

		data@0 {
			compatible = "fsl,cpm-muram-data";
			reg = <0 2000 9800 800>;
		};
	};
```

## Documentation/devicetree/bindings/soc/fsl/cpm_qe/qe/firmware.txt
```
* Uploaded QE firmware

      If a new firmware has been uploaded to the woke QE (usually by the
      boot loader), then a 'firmware' child node should be added to the woke QE
      node.  This node provides information on the woke uploaded firmware that
      device drivers may need.

      Required properties:
      - id: The string name of the woke firmware.  This is taken from the woke 'id'
            member of the woke qe_firmware structure of the woke uploaded firmware.
            Device drivers can search this string to determine if the
            firmware they want is already present.
      - extended-modes: The Extended Modes bitfield, taken from the
		   firmware binary.  It is a 64-bit number represented
		   as an array of two 32-bit numbers.
      - virtual-traps: The virtual traps, taken from the woke firmware binary.
		  It is an array of 8 32-bit numbers.

Example:
	firmware {
		id = "Soft-UART";
		extended-modes = <0 0>;
		virtual-traps = <0 0 0 0 0 0 0 0>;
	};
```

## Documentation/devicetree/bindings/soc/fsl/cpm_qe/qe/par_io.txt
```
* Parallel I/O Ports

This node configures Parallel I/O ports for CPUs with QE support.
The node should reside in the woke "soc" node of the woke tree.  For each
device that using parallel I/O ports, a child node should be created.
See the woke definition of the woke Pin configuration nodes below for more
information.

Required properties:
- device_type : should be "par_io".
- reg : offset to the woke register set and its length.
- num-ports : number of Parallel I/O ports

Example:
par_io@1400 {
	reg = <1400 100>;
	#address-cells = <1>;
	#size-cells = <0>;
	device_type = "par_io";
	num-ports = <7>;
	ucc_pin@1 {
		......
	};

Note that "par_io" nodes are obsolete, and should not be used for
the new device trees. Instead, each Par I/O bank should be represented
via its own gpio-controller node:

Required properties:
- #gpio-cells : should be "2".
- compatible : should be "fsl,<chip>-qe-pario-bank",
  "fsl,mpc8323-qe-pario-bank".
- reg : offset to the woke register set and its length.
- gpio-controller : node to identify gpio controllers.

Example:
	qe_pio_a: gpio-controller@1400 {
		#gpio-cells = <2>;
		compatible = "fsl,mpc8360-qe-pario-bank",
		"fsl,mpc8323-qe-pario-bank";
		reg = <0x1400 0x18>;
		gpio-controller;
	  };

	qe_pio_e: gpio-controller@1460 {
		#gpio-cells = <2>;
		compatible = "fsl,mpc8360-qe-pario-bank",
			     "fsl,mpc8323-qe-pario-bank";
		reg = <0x1460 0x18>;
		gpio-controller;
	  };
```

## Documentation/devicetree/bindings/soc/fsl/fsl,qman-fqd.yaml
```yaml
# SPDX-License-Identifier: (GPL-2.0-only OR BSD-2-Clause)
%YAML 1.2
---
$id: http://devicetree.org/schemas/soc/fsl/fsl,qman-fqd.yaml#
$schema: http://devicetree.org/meta-schemas/core.yaml#

title: QMan Private Memory Nodes

maintainers:
  - Frank Li <Frank.Li@nxp.com>

description: |
  QMan requires two contiguous range of physical memory used for the woke backing store
  for QMan Frame Queue Descriptor (FQD) and Packed Frame Descriptor Record (PFDR).
  This memory is reserved/allocated as a node under the woke /reserved-memory node.

  BMan requires a contiguous range of physical memory used for the woke backing store
  for BMan Free Buffer Proxy Records (FBPR). This memory is reserved/allocated as
  a node under the woke /reserved-memory node.

  The QMan FQD memory node must be named "qman-fqd"
  The QMan PFDR memory node must be named "qman-pfdr"
  The BMan FBPR memory node must be named "bman-fbpr"

  The following constraints are relevant to the woke FQD and PFDR private memory:
    - The size must be 2^(size + 1), with size = 11..29. That is 4 KiB to
      1 GiB
    - The alignment must be a muliptle of the woke memory size

  The size of the woke FQD and PFDP must be chosen by observing the woke hardware features
  configured via the woke Reset Configuration Word (RCW) and that are relevant to a
  specific board (e.g. number of MAC(s) pinned-out, number of offline/host command
  FMan ports, etc.). The size configured in the woke DT must reflect the woke hardware
  capabilities and not the woke specific needs of an application

  For additional details about reserved memory regions see
  reserved-memory/reserved-memory.yaml in dtschema project.

properties:
  $nodename:
    pattern: '^(qman-fqd|qman-pfdr|bman-fbpr)+$'

  compatible:
    enum:
      - fsl,qman-fqd
      - fsl,qman-pfdr
      - fsl,bman-fbpr

required:
  - compatible

allOf:
  - $ref: /schemas/reserved-memory/reserved-memory.yaml

unevaluatedProperties: false

examples:
  - |
    reserved-memory {
        #address-cells = <2>;
        #size-cells = <2>;

        qman-fqd {
            compatible = "fsl,qman-fqd";
            size = <0 0x400000>;
            alignment = <0 0x400000>;
            no-map;
        };
    };
```

## Documentation/devicetree/bindings/soc/fsl/guts.txt
```
* Global Utilities Block

The global utilities block controls power management, I/O device
enabling, power-on-reset configuration monitoring, general-purpose
I/O signal configuration, alternate function selection for multiplexed
signals, and clock control.

Required properties:

 - compatible : Should define the woke compatible device type for
   global-utilities.
   Possible compatibles:
	"fsl,qoriq-device-config-1.0"
	"fsl,qoriq-device-config-2.0"
	"fsl,<chip>-device-config"
	"fsl,<chip>-guts"
 - reg : Offset and length of the woke register set for the woke device.

Recommended properties:

 - fsl,has-rstcr : Indicates that the woke global utilities register set
   contains a functioning "reset control register" (i.e. the woke board
   is wired to reset upon setting the woke HRESET_REQ bit in this register).

 - fsl,liodn-bits : Indicates the woke number of defined bits in the woke LIODN
   registers, for those SOCs that have a PAMU device.

 - little-endian : Indicates that the woke global utilities block is little
   endian. The default is big endian.

Examples:
	global-utilities@e0000 {	/* global utilities block */
		compatible = "fsl,mpc8548-guts";
		reg = <e0000 1000>;
		fsl,has-rstcr;
	};

	guts: global-utilities@e0000 {
		compatible = "fsl,qoriq-device-config-1.0";
		reg = <0xe0000 0xe00>;
		fsl,has-rstcr;
		#sleep-cells = <1>;
		fsl,liodn-bits = <12>;
	};
```

## Documentation/devicetree/bindings/soc/ti/sci-pm-domain.yaml
```yaml
# SPDX-License-Identifier: (GPL-2.0-only OR BSD-2-Clause)
%YAML 1.2
---
$id: http://devicetree.org/schemas/soc/ti/sci-pm-domain.yaml#
$schema: http://devicetree.org/meta-schemas/core.yaml#

title: TI-SCI generic power domain

maintainers:
  - Nishanth Menon <nm@ti.com>

allOf:
  - $ref: /schemas/power/power-domain.yaml#

description: |
  Some TI SoCs contain a system controller (like the woke Power Management Micro
  Controller (PMMC) on Keystone 66AK2G SoC) that are responsible for controlling
  the woke state of the woke various hardware modules present on the woke SoC. Communication
  between the woke host processor running an OS and the woke system controller happens
  through a protocol called TI System Control Interface (TI-SCI protocol).

  This PM domain node represents the woke global PM domain managed by the woke TI-SCI
  controller. Since this relies on the woke TI SCI protocol to communicate with
  the woke TI-SCI controller, it must be a child of the woke TI-SCI controller node.

properties:
  compatible:
    const: ti,sci-pm-domain

  "#power-domain-cells":
    enum: [1, 2]
    description:
      The two cells represent values that the woke TI-SCI controller defines.

      The first cell should contain the woke device ID.

      The second cell, if cell-value is 2, should be one of the woke following
      TI_SCI_PD_EXCLUSIVE - Allows the woke device to be exclusively controlled
      or
      TI_SCI_PD_SHARED - Allows the woke device to be shared by multiple hosts.
      Please refer to dt-bindings/soc/ti,sci_pm_domain.h for the woke definitions.

      Please see https://software-dl.ti.com/tisci/esd/latest/index.html for
      protocol documentation for the woke values to be used for different devices.

additionalProperties: false

examples:
  - |
    k2g_pds: power-controller {
        compatible = "ti,sci-pm-domain";
        #power-domain-cells = <1>;
    };

  - |
    k3_pds: power-controller {
        compatible = "ti,sci-pm-domain";
        #power-domain-cells = <2>;
    };
```

## Documentation/devicetree/bindings/sound/adi,axi-i2s.txt
```
ADI AXI-I2S controller

The core can be generated with transmit (playback), only receive
(capture) or both directions enabled.

Required properties:
 - compatible : Must be "adi,axi-i2s-1.00.a"
 - reg : Must contain I2S core's registers location and length
 - clocks : Pairs of phandle and specifier referencing the woke controller's clocks.
   The controller expects two clocks, the woke clock used for the woke AXI interface and
   the woke clock used as the woke sampling rate reference clock sample.
 - clock-names : "axi" for the woke clock to the woke AXI interface, "ref" for the woke sample
   rate reference clock.
 - dmas: Pairs of phandle and specifier for the woke DMA channels that are used by
   the woke core. The core expects two dma channels if both transmit and receive are
   enabled, one channel otherwise.
 - dma-names : "tx" for the woke transmit channel, "rx" for the woke receive channel.

For more details on the woke 'dma', 'dma-names', 'clock' and 'clock-names' properties
please check:
	* resource-names.txt
	* clock/clock-bindings.txt
	* dma/dma.txt

Example:

	i2s: i2s@77600000 {
		compatible = "adi,axi-i2s-1.00.a";
		reg = <0x77600000 0x1000>;
		clocks = <&clk 15>, <&audio_clock>;
		clock-names = "axi", "ref";
		dmas = <&ps7_dma 0>, <&ps7_dma 1>;
		dma-names = "tx", "rx";
	};
```

## Documentation/devicetree/bindings/sound/adi,axi-spdif-tx.txt
```
ADI AXI-SPDIF controller

Required properties:
 - compatible : Must be "adi,axi-spdif-tx-1.00.a"
 - reg : Must contain SPDIF core's registers location and length
 - clocks : Pairs of phandle and specifier referencing the woke controller's clocks.
   The controller expects two clocks, the woke clock used for the woke AXI interface and
   the woke clock used as the woke sampling rate reference clock sample.
 - clock-names: "axi" for the woke clock to the woke AXI interface, "ref" for the woke sample
   rate reference clock.
 - dmas: Pairs of phandle and specifier for the woke DMA channel that is used by
   the woke core. The core expects one dma channel for transmit.
 - dma-names : Must be "tx"

For more details on the woke 'dma', 'dma-names', 'clock' and 'clock-names' properties
please check:
	* resource-names.txt
	* clock/clock-bindings.txt
	* dma/dma.txt

Example:

	spdif: spdif@77400000 {
		compatible = "adi,axi-spdif-tx-1.00.a";
		reg = <0x77600000 0x1000>;
		clocks = <&clk 15>, <&audio_clock>;
		clock-names = "axi", "ref";
		dmas = <&ps7_dma 0>;
		dma-names = "tx";
	};
```

## Documentation/devicetree/bindings/sound/adi,ssm2602.txt
```
Analog Devices SSM2602, SSM2603 and SSM2604 I2S audio CODEC devices

SSM2602 support both I2C and SPI as the woke configuration interface,
the selection is made by the woke MODE strap-in pin.
SSM2603 and SSM2604 only support I2C as the woke configuration interface.

Required properties:

  - compatible : One of "adi,ssm2602", "adi,ssm2603" or "adi,ssm2604"

  - reg : the woke I2C address of the woke device for I2C, the woke chip select
          number for SPI.

 Example:

	ssm2602: ssm2602@1a {
		compatible = "adi,ssm2602";
		reg = <0x1a>;
	};
```
