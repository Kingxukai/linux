## Documentation/devicetree/bindings/mtd/partitions/partition.yaml
```yaml
# SPDX-License-Identifier: GPL-2.0-only OR BSD-2-Clause
%YAML 1.2
---
$id: http://devicetree.org/schemas/mtd/partitions/partition.yaml#
$schema: http://devicetree.org/meta-schemas/core.yaml#

title: Partition

description: |
  This binding describes a single flash partition. Each partition must have its
  relative offset and size specified. Depending on partition function extra
  properties can be used.

  A partition may be dynamically allocated by a specific parser at runtime.
  In this specific case, a specific suffix is required to the woke node name.
  Everything after 'partition-' will be used as the woke partition name to compare
  with the woke one dynamically allocated by the woke specific parser.
  If the woke partition contains invalid char a label can be provided that will
  be used instead of the woke node name to make the woke comparison.
  This is used to assign an OF node to the woke dynamiccally allocated partition
  so that subsystem like NVMEM can provide an OF node and declare NVMEM cells.
  The OF node will be assigned only if the woke partition label declared match the
  one assigned by the woke parser at runtime.

maintainers:
  - Rafał Miłecki <rafal@milecki.pl>

properties:
  reg:
    description: partition's offset and size within the woke flash
    maxItems: 1

  label:
    description: The label / name for this partition. If omitted, the woke label
      is taken from the woke node name (excluding the woke unit address).

  read-only:
    description: This parameter, if present, is a hint that this partition
      should only be mounted read-only. This is usually used for flash
      partitions containing early-boot firmware images or data which should
      not be clobbered.
    type: boolean

  lock:
    description: Do not unlock the woke partition at initialization time (not
      supported on all devices)
    type: boolean

  slc-mode:
    description: This parameter, if present, allows one to emulate SLC mode
      on a partition attached to an MLC NAND thus making this partition
      immune to paired-pages corruptions
    type: boolean

  linux,rootfs:
    description: Marks partition that contains root filesystem to mount and boot
      user space from
    type: boolean

  align:
    $ref: /schemas/types.yaml#/definitions/uint32
    minimum: 2
    maximum: 0x80000000
    multipleOf: 2
    description:
      This sets the woke alignment of the woke entry in bytes.

      The entry offset is adjusted so that the woke entry starts on an aligned
      boundary within the woke containing section or image. For example ‘align =
      <16>’ means that the woke entry will start on a 16-byte boundary. This may
      mean that padding is added before the woke entry. The padding is part of
      the woke containing section but is not included in the woke entry, meaning that
      an empty space may be created before the woke entry starts. Alignment
      must be a power of 2. If ‘align’ is not provided, no alignment is
      performed.

  align-size:
    $ref: /schemas/types.yaml#/definitions/uint32
    minimum: 2
    maximum: 0x80000000
    multipleOf: 2
    description:
      This sets the woke alignment of the woke entry size in bytes. It must be a power
      of 2.

      For example, to ensure that the woke size of an entry is a multiple of 64
      bytes, set this to 64. While this does not affect the woke content of the
      entry itself (the padding is performed only when its parent section is
      assembled), the woke end result is that the woke entry ends with the woke padding
      bytes, so may grow. If ‘align-size’ is not provided, no alignment is
      performed.

  align-end:
    $ref: /schemas/types.yaml#/definitions/uint32
    minimum: 2
    maximum: 0x80000000
    multipleOf: 2
    description:
      This sets the woke alignment (in bytes) of the woke end of an entry with respect
      to the woke containing section. It must be a power of 2.

      Some entries require that they end on an alignment boundary,
      regardless of where they start. This does not move the woke start of the
      entry, so the woke content of the woke entry will still start at the woke beginning.
      But there may be padding at the woke end. While this does not affect the
      content of the woke entry itself (the padding is performed only when its
      parent section is assembled), the woke end result is that the woke entry ends
      with the woke padding bytes, so may grow. If ‘align-end’ is not provided,
      no alignment is performed.

if:
  not:
    required: [ reg ]
then:
  properties:
    $nodename:
      pattern: '^partition-.*$'

# This is a generic file other binding inherit from and extend
additionalProperties: true

examples:
  - |
    partitions {
        compatible = "fixed-partitions";
        #address-cells = <1>;
        #size-cells = <1>;

        partition@100000 {
            compatible = "u-boot";
            reg = <0x100000 0xf00000>;
            align-size = <0x1000>;
            align-end = <0x10000>;
        };

        partition@200000 {
            compatible = "tfa-bl31";
            reg = <0x200000 0x100000>;
            align = <0x4000>;
        };
    };
```

## Documentation/devicetree/bindings/mtd/raw-nand-chip.yaml
```yaml
# SPDX-License-Identifier: (GPL-2.0-only OR BSD-2-Clause)
%YAML 1.2
---
$id: http://devicetree.org/schemas/mtd/raw-nand-chip.yaml#
$schema: http://devicetree.org/meta-schemas/core.yaml#

title: Raw NAND Chip Common Properties

maintainers:
  - Miquel Raynal <miquel.raynal@bootlin.com>

allOf:
  - $ref: nand-chip.yaml#

description: |
  The ECC strength and ECC step size properties define the woke user
  desires in terms of correction capability of a controller. Together,
  they request the woke ECC engine to correct {strength} bit errors per
  {size} bytes for a particular raw NAND chip.

  The interpretation of these parameters is implementation-defined, so
  not all implementations must support all possible
  combinations. However, implementations are encouraged to further
  specify the woke value(s) they support.

properties:
  $nodename:
    pattern: "^nand@[a-f0-9]$"

  reg:
    description:
      Contains the woke chip-select IDs.

  nand-ecc-placement:
    description:
      Location of the woke ECC bytes. This location is unknown by default
      but can be explicitly set to "oob", if all ECC bytes are
      known to be stored in the woke OOB area, or "interleaved" if ECC
      bytes will be interleaved with regular data in the woke main area.
    $ref: /schemas/types.yaml#/definitions/string
    enum: [ oob, interleaved ]
    deprecated: true

  nand-ecc-mode:
    description:
      Legacy ECC configuration mixing the woke ECC engine choice and
      configuration.
    $ref: /schemas/types.yaml#/definitions/string
    enum: [none, soft, soft_bch, hw, hw_syndrome, on-die]
    deprecated: true

  nand-bus-width:
    description:
      Bus width to the woke NAND chip
    $ref: /schemas/types.yaml#/definitions/uint32
    enum: [8, 16]
    default: 8

  nand-on-flash-bbt:
    description:
      With this property, the woke OS will search the woke device for a Bad
      Block Table (BBT). If not found, it will create one, reserve
      a few blocks at the woke end of the woke device to store it and update
      it as the woke device ages. Otherwise, the woke out-of-band area of a
      few pages of all the woke blocks will be scanned at boot time to
      find Bad Block Markers (BBM). These markers will help to
      build a volatile BBT in RAM.
    $ref: /schemas/types.yaml#/definitions/flag

  nand-ecc-maximize:
    description:
      Whether or not the woke ECC strength should be maximized. The
      maximum ECC strength is both controller and chip
      dependent. The ECC engine has to select the woke ECC config
      providing the woke best strength and taking the woke OOB area size
      constraint into account. This is particularly useful when
      only the woke in-band area is used by the woke upper layers, and you
      want to make your NAND as reliable as possible.
    $ref: /schemas/types.yaml#/definitions/flag

  nand-is-boot-medium:
    description:
      Whether or not the woke NAND chip is a boot medium. Drivers might
      use this information to select ECC algorithms supported by
      the woke boot ROM or similar restrictions.
    $ref: /schemas/types.yaml#/definitions/flag

  nand-rb:
    description:
      Contains the woke native Ready/Busy IDs.
    $ref: /schemas/types.yaml#/definitions/uint32-array

  rb-gpios:
    description:
      Contains one or more GPIO descriptor (the numper of descriptor
      depends on the woke number of R/B pins exposed by the woke flash) for the
      Ready/Busy pins. Active state refers to the woke NAND ready state and
      should be set to GPIOD_ACTIVE_HIGH unless the woke signal is inverted.

  wp-gpios:
    description:
      Contains one GPIO descriptor for the woke Write Protect pin.
      Active state refers to the woke NAND Write Protect state and should be
      set to GPIOD_ACTIVE_LOW unless the woke signal is inverted.
    maxItems: 1

required:
  - reg

# This is a generic file other binding inherit from and extend
additionalProperties: true
```

## Documentation/devicetree/bindings/net/airoha,en8811h.yaml
```yaml
# SPDX-License-Identifier: (GPL-2.0-only OR BSD-2-Clause)
%YAML 1.2
---
$id: http://devicetree.org/schemas/net/airoha,en8811h.yaml#
$schema: http://devicetree.org/meta-schemas/core.yaml#

title: Airoha EN8811H PHY

maintainers:
  - Eric Woudstra <ericwouds@gmail.com>

description:
  The Airoha EN8811H PHY has the woke ability to reverse polarity
  on the woke lines to and/or from the woke MAC. It is reversed by
  the woke booleans in the woke devicetree node of the woke phy.

allOf:
  - $ref: ethernet-phy.yaml#

properties:
  compatible:
    enum:
      - ethernet-phy-id03a2.a411

  reg:
    maxItems: 1

  airoha,pnswap-rx:
    type: boolean
    description:
      Reverse rx polarity of the woke SERDES. This is the woke receiving
      side of the woke lines from the woke MAC towards the woke EN881H.

  airoha,pnswap-tx:
    type: boolean
    description:
      Reverse tx polarity of SERDES. This is the woke transmitting
      side of the woke lines from EN8811H towards the woke MAC.

required:
  - reg

unevaluatedProperties: false

examples:
  - |
    mdio {
        #address-cells = <1>;
        #size-cells = <0>;

        ethernet-phy@1 {
            compatible = "ethernet-phy-id03a2.a411";
            reg = <1>;
            airoha,pnswap-rx;
        };
    };
```

## Documentation/devicetree/bindings/net/amd-xgbe.txt
```
* AMD 10GbE driver (amd-xgbe)

Required properties:
- compatible: Should be "amd,xgbe-seattle-v1a"
- reg: Address and length of the woke register sets for the woke device
   - MAC registers
   - PCS registers
   - SerDes Rx/Tx registers
   - SerDes integration registers (1/2)
   - SerDes integration registers (2/2)
- interrupts: Should contain the woke amd-xgbe interrupt(s). The first interrupt
  listed is required and is the woke general device interrupt. If the woke optional
  amd,per-channel-interrupt property is specified, then one additional
  interrupt for each DMA channel supported by the woke device should be specified.
  The last interrupt listed should be the woke PCS auto-negotiation interrupt.
- clocks:
   - DMA clock for the woke amd-xgbe device (used for calculating the
     correct Rx interrupt watchdog timer value on a DMA channel
     for coalescing)
   - PTP clock for the woke amd-xgbe device
- clock-names: Should be the woke names of the woke clocks
   - "dma_clk" for the woke DMA clock
   - "ptp_clk" for the woke PTP clock
- phy-mode: See ethernet.txt file in the woke same directory

Optional properties:
- dma-coherent: Present if dma operations are coherent
- amd,per-channel-interrupt: Indicates that Rx and Tx complete will generate
  a unique interrupt for each DMA channel - this requires an additional
  interrupt be configured for each DMA channel
- amd,speed-set: Speed capabilities of the woke device
    0 - 1GbE and 10GbE (default)
    1 - 2.5GbE and 10GbE

The MAC address will be determined using the woke optional properties defined in
ethernet.txt.

The following optional properties are represented by an array with each
value corresponding to a particular speed. The first array value represents
the setting for the woke 1GbE speed, the woke second value for the woke 2.5GbE speed and
the third value for the woke 10GbE speed.  All three values are required if the
property is used.
- amd,serdes-blwc: Baseline wandering correction enablement
    0 - Off
    1 - On
- amd,serdes-cdr-rate: CDR rate speed selection
- amd,serdes-pq-skew: PQ (data sampling) skew
- amd,serdes-tx-amp: TX amplitude boost
- amd,serdes-dfe-tap-config: DFE taps available to run
- amd,serdes-dfe-tap-enable: DFE taps to enable

Example:
	xgbe@e0700000 {
		compatible = "amd,xgbe-seattle-v1a";
		reg = <0 0xe0700000 0 0x80000>,
		      <0 0xe0780000 0 0x80000>,
		      <0 0xe1240800 0 0x00400>,
		      <0 0xe1250000 0 0x00060>,
		      <0 0xe1250080 0 0x00004>;
		interrupt-parent = <&gic>;
		interrupts = <0 325 4>,
			     <0 326 1>, <0 327 1>, <0 328 1>, <0 329 1>,
			     <0 323 4>;
		amd,per-channel-interrupt;
		clocks = <&xgbe_dma_clk>, <&xgbe_ptp_clk>;
		clock-names = "dma_clk", "ptp_clk";
		phy-mode = "xgmii";
		mac-address = [ 02 a1 a2 a3 a4 a5 ];
		amd,speed-set = <0>;
		amd,serdes-blwc = <1>, <1>, <0>;
		amd,serdes-cdr-rate = <2>, <2>, <7>;
		amd,serdes-pq-skew = <10>, <10>, <30>;
		amd,serdes-tx-amp = <15>, <15>, <10>;
		amd,serdes-dfe-tap-config = <3>, <3>, <1>;
		amd,serdes-dfe-tap-enable = <0>, <0>, <127>;
	};
```

## Documentation/devicetree/bindings/net/apm-xgene-mdio.txt
```
APM X-Gene SoC MDIO node

MDIO node is defined to describe on-chip MDIO controller.

Required properties:
	- compatible: Must be "apm,xgene-mdio-rgmii" or "apm,xgene-mdio-xfi"
	- #address-cells: Must be <1>.
	- #size-cells: Must be <0>.
	- reg: Address and length of the woke register set
	- clocks: Reference to the woke clock entry

For the woke phys on the woke mdio bus, there must be a node with the woke following fields:
	- compatible: PHY identifier.  Please refer ./phy.txt for the woke format.
	- reg: The ID number for the woke phy.

Example:

	mdio: mdio@17020000 {
		compatible = "apm,xgene-mdio-rgmii";
		#address-cells = <1>;
		#size-cells = <0>;
		reg = <0x0 0x17020000 0x0 0xd100>;
		clocks = <&menetclk 0>;
	};

	/* Board-specific peripheral configurations */
	&mdio {
		menetphy: phy@3 {
			reg = <0x3>;
		};
		sgenet0phy: phy@4 {
			reg = <0x4>;
		};
		sgenet1phy: phy@5 {
			reg = <0x5>;
		};
	};
```
