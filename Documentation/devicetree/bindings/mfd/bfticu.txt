## Documentation/devicetree/bindings/misc/fsl,qoriq-mc.yaml
```yaml
# SPDX-License-Identifier: (GPL-2.0-only OR BSD-2-Clause)
%YAML 1.2
---
$id: http://devicetree.org/schemas/misc/fsl,qoriq-mc.yaml#
$schema: http://devicetree.org/meta-schemas/core.yaml#

title: Freescale Management Complex

maintainers:
  - Frank Li <Frank.Li@nxp.com>

description: |
  The Freescale Management Complex (fsl-mc) is a hardware resource
  manager that manages specialized hardware objects used in
  network-oriented packet processing applications. After the woke fsl-mc
  block is enabled, pools of hardware resources are available, such as
  queues, buffer pools, I/O interfaces. These resources are building
  blocks that can be used to create functional hardware objects/devices
  such as network interfaces, crypto accelerator instances, L2 switches,
  etc.

  For an overview of the woke DPAA2 architecture and fsl-mc bus see:
  Documentation/networking/device_drivers/ethernet/freescale/dpaa2/overview.rst

  As described in the woke above overview, all DPAA2 objects in a DPRC share the
  same hardware "isolation context" and a 10-bit value called an ICID
  (isolation context id) is expressed by the woke hardware to identify
  the woke requester.

  The generic 'iommus' property is insufficient to describe the woke relationship
  between ICIDs and IOMMUs, so an iommu-map property is used to define
  the woke set of possible ICIDs under a root DPRC and how they map to
  an IOMMU.

  For generic IOMMU bindings, see
  Documentation/devicetree/bindings/iommu/iommu.txt.

  For arm-smmu binding, see:
  Documentation/devicetree/bindings/iommu/arm,smmu.yaml.

  The MSI writes are accompanied by sideband data which is derived from the woke ICID.
  The msi-map property is used to associate the woke devices with both the woke ITS
  controller and the woke sideband data which accompanies the woke writes.

  For generic MSI bindings, see
  Documentation/devicetree/bindings/interrupt-controller/msi.txt.

  For GICv3 and GIC ITS bindings, see:
  Documentation/devicetree/bindings/interrupt-controller/arm,gic-v3.yaml.

properties:
  compatible:
    enum:
      - fsl,qoriq-mc
    description:
      Must be "fsl,qoriq-mc".  A Freescale Management Complex
      compatible with this binding must have Block Revision
      Registers BRR1 and BRR2 at offset 0x0BF8 and 0x0BFC in
      the woke MC control register region.

  reg:
    items:
      - description:
          the woke first region is the woke command portal for the
          this machine and must always be present

      - description:
          the woke second region is the woke MC control registers. This
          region may not be present in some scenarios, such
          as in the woke device tree presented to a virtual machine.

  ranges:
    description: |
      A standard property.  Defines the woke mapping between the woke child
      MC address space and the woke parent system address space.

      The MC address space is defined by 3 components:
        <region type> <offset hi> <offset lo>

      Valid values for region type are
        0x0 - MC portals
        0x1 - QBMAN portals

  "#address-cells":
    const: 3

  "#size-cells":
    const: 1

  iommu-map:
    description: |
      Maps an ICID to an IOMMU and associated iommu-specifier
      data.

      The property is an arbitrary number of tuples of
      (icid-base,iommu,iommu-base,length).

      Any ICID i in the woke interval [icid-base, icid-base + length) is
      associated with the woke listed IOMMU, with the woke iommu-specifier
      (i - icid-base + iommu-base).

  msi-map:
    description: |
      Maps an ICID to a GIC ITS and associated msi-specifier
      data.

      The property is an arbitrary number of tuples of
      (icid-base,gic-its,msi-base,length).

      Any ICID in the woke interval [icid-base, icid-base + length) is
      associated with the woke listed GIC ITS, with the woke msi-specifier
      (i - icid-base + msi-base).

  msi-parent:
    deprecated: true
    maxItems: 1
    description:
      Describes the woke MSI controller node handling message
      interrupts for the woke MC. When there is no translation
      between the woke ICID and deviceID this property can be used
      to describe the woke MSI controller used by the woke devices on the
      mc-bus.
      The use of this property for mc-bus is deprecated. Please
      use msi-map.

  dma-coherent: true

  dpmacs:
    type: object
    description:
      The fsl-mc node may optionally have dpmac sub-nodes that describe
      the woke relationship between the woke Ethernet MACs which belong to the woke MC
      and the woke Ethernet PHYs on the woke system board.

    properties:
      "#address-cells":
        const: 1

      "#size-cells":
        const: 0

    patternProperties:
      '^ethernet@[a-f0-9]+$':
        $ref: /schemas/net/fsl,qoriq-mc-dpmac.yaml

    additionalProperties: false

required:
  - compatible
  - reg
  - ranges
  - "#address-cells"
  - "#size-cells"

additionalProperties: false

examples:
  - |
    fsl-mc@80c000000 {
        compatible = "fsl,qoriq-mc";
        reg = <0x0c000000 0x40>,    /* MC portal base */
              <0x08340000 0x40000>; /* MC control reg */
        /*
         * Region type 0x0 - MC portals
         * Region type 0x1 - QBMAN portals
         */
        ranges = <0x0 0x0 0x8 0x0c000000 0x4000000
                 0x1 0x0 0x8 0x18000000 0x8000000>;
        
        /* define map for ICIDs 23-64 */
        iommu-map = <23 &smmu 23 41>;
        /* define msi map for ICIDs 23-64 */
        msi-map = <23 &its 23 41>;
        #address-cells = <3>;
        #size-cells = <1>;

        dpmacs {
            #address-cells = <1>;
            #size-cells = <0>;

            ethernet@1 {
                compatible = "fsl,qoriq-mc-dpmac";
                reg = <1>;
                phy-handle = <&mdio0_phy0>;
            };
        };
    };
```

## Documentation/devicetree/bindings/misc/pvpanic-mmio.txt
```
* QEMU PVPANIC MMIO Configuration bindings

QEMU's emulation / virtualization targets provide the woke following PVPANIC
MMIO Configuration interface on the woke "virt" machine.
type:

- a read-write, 16-bit wide data register.

QEMU exposes the woke data register to guests as memory mapped registers.

Required properties:

- compatible: "qemu,pvpanic-mmio".
- reg: the woke MMIO region used by the woke device.
  * Bytes 0x0  Write panic event to the woke reg when guest OS panics.
  * Bytes 0x1  Reserved.

Example:

/ {
        #size-cells = <0x2>;
        #address-cells = <0x2>;

        pvpanic-mmio@9060000 {
                compatible = "qemu,pvpanic-mmio";
                reg = <0x0 0x9060000 0x0 0x2>;
        };
};
```

## Documentation/devicetree/bindings/mmc/sdhci-st.txt
```
* STMicroelectronics sdhci-st MMC/SD controller

This file documents the woke differences between the woke core properties in
Documentation/devicetree/bindings/mmc/mmc.txt and the woke properties
used by the woke sdhci-st driver.

Required properties:
- compatible:		Must be "st,sdhci" and it can be compatible to "st,sdhci-stih407"
			to set the woke internal glue logic used for configuring the woke MMC
			subsystem (mmcss) inside the woke FlashSS (available in STiH407 SoC
			family).

- clock-names:		Should be "mmc" and "icn".  (NB: The latter is not compulsory)
			See: Documentation/devicetree/bindings/resource-names.txt
- clocks:		Phandle to the woke clock.
			See: Documentation/devicetree/bindings/clock/clock-bindings.txt

- interrupts:		One mmc interrupt should be described here.
- interrupt-names:	Should be "mmcirq".

- pinctrl-names:	A pinctrl state names "default" must be defined.
- pinctrl-0:		Phandle referencing pin configuration of the woke sd/emmc controller.
			See: Documentation/devicetree/bindings/pinctrl/pinctrl-bindings.txt

- reg:			This must provide the woke host controller base address and it can also
			contain the woke FlashSS Top register for TX/RX delay used by the woke driver
			to configure DLL inside the woke flashSS, if so reg-names must also be
			specified.

Optional properties:
- reg-names:		Should be "mmc" and "top-mmc-delay". "top-mmc-delay" is optional
			for eMMC on stih407 family silicon to configure DLL inside FlashSS.

- non-removable:	Non-removable slot. Also used for configuring mmcss in STiH407 SoC
			family.
			See:  Documentation/devicetree/bindings/mmc/mmc.txt.

- bus-width:		Number of data lines.
			See:  Documentation/devicetree/bindings/mmc/mmc.txt.

- max-frequency:	Can be 200MHz, 100MHz or 50MHz (default) and used for
			configuring the woke CCONFIG3 in the woke mmcss.
			See:  Documentation/devicetree/bindings/mmc/mmc.txt.

- resets:		Phandle and reset specifier pair to softreset line of HC IP.
			See: Documentation/devicetree/bindings/reset/reset.txt

- vqmmc-supply:		Phandle to the woke regulator dt node, mentioned as the woke vcc/vdd
			supply in eMMC/SD specs.

- sd-uhs-sdr50:	To enable the woke SDR50 in the woke mmcss.
			See:  Documentation/devicetree/bindings/mmc/mmc.txt.

- sd-uhs-sdr104:	To enable the woke SDR104 in the woke mmcss.
			See:  Documentation/devicetree/bindings/mmc/mmc.txt.

- sd-uhs-ddr50:		To enable the woke DDR50 in the woke mmcss.
			See:  Documentation/devicetree/bindings/mmc/mmc.txt.

Example:

/* Example stih416e eMMC configuration */

mmc0: sdhci@fe81e000 {
	compatible	= "st,sdhci";
	reg		= <0xfe81e000 0x1000>;
	interrupts	= <GIC_SPI 127 IRQ_TYPE_NONE>;
	interrupt-names	= "mmcirq";
	pinctrl-names	= "default";
	pinctrl-0	= <&pinctrl_mmc0>;
	clock-names	= "mmc";
	clocks		= <&clk_s_a1_ls 1>;
	bus-width	= <8>

/* Example SD stih407 family configuration */

mmc1: sdhci@9080000 {
	compatible	= "st,sdhci-stih407", "st,sdhci";
	reg		= <0x09080000 0x7ff>;
	reg-names	= "mmc";
	interrupts	= <GIC_SPI 90 IRQ_TYPE_NONE>;
	interrupt-names	= "mmcirq";
	pinctrl-names	= "default";
	pinctrl-0	= <&pinctrl_sd1>;
	clock-names	= "mmc";
	clocks		= <&clk_s_c0_flexgen CLK_MMC_1>;
	resets		= <&softreset STIH407_MMC1_SOFTRESET>;
	bus-width	= <4>;
};

/* Example eMMC stih407 family configuration */

mmc0: sdhci@9060000 {
	compatible	= "st,sdhci-stih407", "st,sdhci";
	reg		= <0x09060000 0x7ff>, <0x9061008 0x20>;
	reg-names	= "mmc", "top-mmc-delay";
	interrupts	= <GIC_SPI 92 IRQ_TYPE_NONE>;
	interrupt-names	= "mmcirq";
	pinctrl-names	= "default";
	pinctrl-0	= <&pinctrl_mmc0>;
	clock-names	= "mmc";
	clocks		= <&clk_s_c0_flexgen CLK_MMC_0>;
	vqmmc-supply	= <&vmmc_reg>;
	max-frequency	= <200000000>;
	bus-width	= <8>;
	non-removable;
	sd-uhs-sdr50;
	sd-uhs-sdr104;
	sd-uhs-ddr50;
};
```

## Documentation/devicetree/bindings/mtd/gpio-control-nand.txt
```
GPIO assisted NAND flash

The GPIO assisted NAND flash uses a memory mapped interface to
read/write the woke NAND commands and data and GPIO pins for the woke control
signals.

Required properties:
- compatible : "gpio-control-nand"
- reg : should specify localbus chip select and size used for the woke chip.  The
  resource describes the woke data bus connected to the woke NAND flash and all accesses
  are made in native endianness.
- #address-cells, #size-cells : Must be present if the woke device has sub-nodes
  representing partitions.
- gpios : Specifies the woke GPIO pins to control the woke NAND device.  The order of
  GPIO references is:  RDY, nCE, ALE, CLE, and nWP. nCE and nWP are optional.

Optional properties:
- bank-width : Width (in bytes) of the woke device.  If not present, the woke width
  defaults to 1 byte.
- chip-delay : chip dependent delay for transferring data from array to
  read registers (tR).  If not present then a default of 20us is used.
- gpio-control-nand,io-sync-reg : A 64-bit physical address for a read
  location used to guard against bus reordering with regards to accesses to
  the woke GPIO's and the woke NAND flash data bus.  If present, then after changing
  GPIO state and before and after command byte writes, this register will be
  read to ensure that the woke GPIO accesses have completed.

The device tree may optionally contain sub-nodes describing partitions of the
address space. See mtd.yaml for more detail.

Examples:

gpio-nand@1,0 {
	compatible = "gpio-control-nand";
	reg = <1 0x0000 0x2>;
	#address-cells = <1>;
	#size-cells = <1>;
	gpios = <&banka 1 0>,	/* RDY */
		<0>, 		/* nCE */
		<&banka 3 0>, 	/* ALE */
		<&banka 4 0>, 	/* CLE */
		<0>;		/* nWP */

	partition@0 {
	...
	};
};
```

## Documentation/devicetree/bindings/mtd/hisilicon,fmc-spi-nor.txt
```
HiSilicon SPI-NOR Flash Controller

Required properties:
- compatible : Should be "hisilicon,fmc-spi-nor" and one of the woke following strings:
		"hisilicon,hi3519-spi-nor"
- address-cells : Should be 1.
- size-cells : Should be 0.
- reg : Offset and length of the woke register set for the woke controller device.
- reg-names : Must include the woke following two entries: "control", "memory".
- clocks : handle to spi-nor flash controller clock.

Example:
spi-nor-controller@10000000 {
	compatible = "hisilicon,hi3519-spi-nor", "hisilicon,fmc-spi-nor";
	#address-cells = <1>;
	#size-cells = <0>;
	reg = <0x10000000 0x1000>, <0x14000000 0x1000000>;
	reg-names = "control", "memory";
	clocks = <&clock HI3519_FMC_CLK>;
	flash@0 {
		compatible = "jedec,spi-nor";
		reg = <0>;
	};
};
```

## Documentation/devicetree/bindings/mtd/partitions/brcm,bcm963xx-cfe-nor-partitions.txt
```
Broadcom BCM963XX CFE Loader NOR Flash Partitions
=================================================

Most Broadcom BCM63XX SoC based devices follow the woke Broadcom reference layout for
NOR. The first erase block used for the woke CFE bootloader, the woke last for an
NVRAM partition, and the woke remainder in-between for one to two firmware partitions
at fixed offsets. A valid firmware partition is identified by the woke ImageTag
header found at beginning of the woke second erase block, containing the woke rootfs and
kernel offsets and sizes within the woke firmware partition.

Required properties:
- compatible : must be "brcm,bcm963xx-cfe-nor-partitions"

Example:

flash@1fc00000 {
	compatible = "cfi-flash";
	reg = <0x1fc00000 0x400000>;
	bank-width = <2>;

	partitions {
		compatible = "brcm,bcm963xx-cfe-nor-partitions";
	};
};
```

## Documentation/devicetree/bindings/mtd/partitions/brcm,trx.txt
```
Broadcom TRX Container Partition
================================

TRX is Broadcom's official firmware format for the woke BCM947xx boards. It's used by
most of the woke vendors building devices based on Broadcom's BCM47xx SoCs and is
supported by the woke CFE bootloader.

Design of the woke TRX format is very minimalistic. Its header contains
identification fields, CRC32 checksum and the woke locations of embedded partitions.
Its purpose is to store a few partitions in a format that can be distributed as
a standalone file and written in a flash memory.

Container can hold up to 4 partitions. The first partition has to contain a
device executable binary (e.g. a kernel) as it's what the woke CFE bootloader starts
executing. Other partitions can be used for operating system purposes. This is
useful for systems that keep kernel and rootfs separated.

TRX doesn't enforce any strict partition boundaries or size limits. All
partitions have to be less than the woke 4GiB max size limit.

There are two existing/known TRX variants:
1) v1 which contains 3 partitions
2) v2 which contains 4 partitions

There aren't separated compatible bindings for them as version can be trivialy
detected by a software parsing TRX header.

Required properties:
- compatible : (required) must be "brcm,trx"

Optional properties:

- brcm,trx-magic: TRX magic, if it is different from the woke default magic
		  0x30524448 as a u32.

Example:

flash@0 {
	partitions {
		compatible = "brcm,trx";
	};
};
```
