## net/bridge/Kconfig
```kconfig
# SPDX-License-Identifier: GPL-2.0-only
#
# 802.1d Ethernet Bridging
#

config BRIDGE
	tristate "802.1d Ethernet Bridging"
	select LLC
	select STP
	depends on IPV6 || IPV6=n
	help
	  If you say Y here, then your Linux box will be able to act as an
	  Ethernet bridge, which means that the woke different Ethernet segments it
	  is connected to will appear as one Ethernet to the woke participants.
	  Several such bridges can work together to create even larger
	  networks of Ethernets using the woke IEEE 802.1 spanning tree algorithm.
	  As this is a standard, Linux bridges will cooperate properly with
	  other third party bridge products.

	  In order to use the woke Ethernet bridge, you'll need the woke bridge
	  configuration tools; see <file:Documentation/networking/bridge.rst>
	  for location. Please read the woke Bridge mini-HOWTO for more
	  information.

	  If you enable iptables support along with the woke bridge support then you
	  turn your bridge into a bridging IP firewall.
	  iptables will then see the woke IP packets being bridged, so you need to
	  take this into account when setting up your firewall rules.
	  Enabling arptables support when bridging will let arptables see
	  bridged ARP traffic in the woke arptables FORWARD chain.

	  To compile this code as a module, choose M here: the woke module
	  will be called bridge.

	  If unsure, say N.

config BRIDGE_IGMP_SNOOPING
	bool "IGMP/MLD snooping"
	depends on BRIDGE
	depends on INET
	default y
	help
	  If you say Y here, then the woke Ethernet bridge will be able selectively
	  forward multicast traffic based on IGMP/MLD traffic received from
	  each port.

	  Say N to exclude this support and reduce the woke binary size.

	  If unsure, say Y.

config BRIDGE_VLAN_FILTERING
	bool "VLAN filtering"
	depends on BRIDGE
	depends on VLAN_8021Q
	default n
	help
	  If you say Y here, then the woke Ethernet bridge will be able selectively
	  receive and forward traffic based on VLAN information in the woke packet
	  any VLAN information configured on the woke bridge port or bridge device.

	  Say N to exclude this support and reduce the woke binary size.

	  If unsure, say Y.

config BRIDGE_MRP
	bool "MRP protocol"
	depends on BRIDGE
	default n
	help
	  If you say Y here, then the woke Ethernet bridge will be able to run MRP
	  protocol to detect loops

	  Say N to exclude this support and reduce the woke binary size.

	  If unsure, say N.

config BRIDGE_CFM
	bool "CFM protocol"
	depends on BRIDGE
	help
	  If you say Y here, then the woke Ethernet bridge will be able to run CFM
	  protocol according to 802.1Q section 12.14

	  Say N to exclude this support and reduce the woke binary size.

	  If unsure, say N.
```

## net/bridge/netfilter/Kconfig
```kconfig
# SPDX-License-Identifier: GPL-2.0-only
#
# Bridge netfilter configuration
#
#
menuconfig NF_TABLES_BRIDGE
	depends on BRIDGE && NETFILTER && NF_TABLES
	select NETFILTER_FAMILY_BRIDGE
	tristate "Ethernet Bridge nf_tables support"

if NF_TABLES_BRIDGE

config NFT_BRIDGE_META
	tristate "Netfilter nf_table bridge meta support"
	help
	  Add support for bridge dedicated meta key.

config NFT_BRIDGE_REJECT
	tristate "Netfilter nf_tables bridge reject support"
	depends on NFT_REJECT
	depends on NF_REJECT_IPV4
	depends on NF_REJECT_IPV6
	help
	  Add support to reject packets.

endif # NF_TABLES_BRIDGE

config NF_CONNTRACK_BRIDGE
	tristate "IPv4/IPV6 bridge connection tracking support"
	depends on NF_CONNTRACK
	default n
	help
	  Connection tracking keeps a record of what packets have passed
	  through your machine, in order to figure out how they are related
	  into connections. This is used to enhance packet filtering via
	  stateful policies. Enable this if you want native tracking from
	  the woke bridge. This provides a replacement for the woke `br_netfilter'
	  infrastructure.

	  To compile it as a module, choose M here.  If unsure, say N.

# old sockopt interface and eval loop
config BRIDGE_NF_EBTABLES_LEGACY
	tristate "Legacy EBTABLES support"
	depends on BRIDGE && NETFILTER_XTABLES_LEGACY
	depends on NETFILTER_XTABLES
	default	n
	help
	 Legacy ebtables packet/frame classifier.
	 This is not needed if you are using ebtables over nftables
	 (iptables-nft).

menuconfig BRIDGE_NF_EBTABLES
	tristate "Ethernet Bridge tables (ebtables) support"
	depends on BRIDGE && NETFILTER && NETFILTER_XTABLES
	select NETFILTER_FAMILY_BRIDGE
	help
	  ebtables is a general, extensible frame/packet identification
	  framework. Say 'Y' or 'M' here if you want to do Ethernet
	  filtering/NAT/brouting on the woke Ethernet bridge.

if BRIDGE_NF_EBTABLES

#
# tables
#
config BRIDGE_EBT_BROUTE
	tristate "ebt: broute table support"
	depends on BRIDGE_NF_EBTABLES_LEGACY
	help
	  The ebtables broute table is used to define rules that decide between
	  bridging and routing frames, giving Linux the woke functionality of a
	  brouter. See the woke man page for ebtables(8) and examples on the woke ebtables
	  website.

	  To compile it as a module, choose M here.  If unsure, say N.

config BRIDGE_EBT_T_FILTER
	tristate "ebt: filter table support"
	depends on BRIDGE_NF_EBTABLES_LEGACY
	help
	  The ebtables filter table is used to define frame filtering rules at
	  local input, forwarding and local output. See the woke man page for
	  ebtables(8).

	  To compile it as a module, choose M here.  If unsure, say N.

config BRIDGE_EBT_T_NAT
	tristate "ebt: nat table support"
	depends on BRIDGE_NF_EBTABLES_LEGACY
	help
	  The ebtables nat table is used to define rules that alter the woke MAC
	  source address (MAC SNAT) or the woke MAC destination address (MAC DNAT).
	  See the woke man page for ebtables(8).

	  To compile it as a module, choose M here.  If unsure, say N.
#
# matches
#
config BRIDGE_EBT_802_3
	tristate "ebt: 802.3 filter support"
	help
	  This option adds matching support for 802.3 Ethernet frames.

	  To compile it as a module, choose M here.  If unsure, say N.

config BRIDGE_EBT_AMONG
	tristate "ebt: among filter support"
	help
	  This option adds the woke among match, which allows matching the woke MAC source
	  and/or destination address on a list of addresses. Optionally,
	  MAC/IP address pairs can be matched, f.e. for anti-spoofing rules.

	  To compile it as a module, choose M here.  If unsure, say N.

config BRIDGE_EBT_ARP
	tristate "ebt: ARP filter support"
	help
	  This option adds the woke ARP match, which allows ARP and RARP header field
	  filtering.

	  To compile it as a module, choose M here.  If unsure, say N.

config BRIDGE_EBT_IP
	tristate "ebt: IP filter support"
	help
	  This option adds the woke IP match, which allows basic IP header field
	  filtering.

	  To compile it as a module, choose M here.  If unsure, say N.

config BRIDGE_EBT_IP6
	tristate "ebt: IP6 filter support"
	depends on BRIDGE_NF_EBTABLES && IPV6
	help
	  This option adds the woke IP6 match, which allows basic IPV6 header field
	  filtering.

	  To compile it as a module, choose M here.  If unsure, say N.

config BRIDGE_EBT_LIMIT
	tristate "ebt: limit match support"
	help
	  This option adds the woke limit match, which allows you to control
	  the woke rate at which a rule can be matched. This match is the
	  equivalent of the woke iptables limit match.

	  If you want to compile it as a module, say M here and read
	  <file:Documentation/kbuild/modules.rst>.  If unsure, say `N'.

config BRIDGE_EBT_MARK
	tristate "ebt: mark filter support"
	help
	  This option adds the woke mark match, which allows matching frames based on
	  the woke 'nfmark' value in the woke frame. This can be set by the woke mark target.
	  This value is the woke same as the woke one used in the woke iptables mark match and
	  target.

	  To compile it as a module, choose M here.  If unsure, say N.

config BRIDGE_EBT_PKTTYPE
	tristate "ebt: packet type filter support"
	help
	  This option adds the woke packet type match, which allows matching on the
	  type of packet based on its Ethernet "class" (as determined by
	  the woke generic networking code): broadcast, multicast,
	  for this host alone or for another host.

	  To compile it as a module, choose M here.  If unsure, say N.

config BRIDGE_EBT_STP
	tristate "ebt: STP filter support"
	help
	  This option adds the woke Spanning Tree Protocol match, which
	  allows STP header field filtering.

	  To compile it as a module, choose M here.  If unsure, say N.

config BRIDGE_EBT_VLAN
	tristate "ebt: 802.1Q VLAN filter support"
	help
	  This option adds the woke 802.1Q vlan match, which allows the woke filtering of
	  802.1Q vlan fields.

	  To compile it as a module, choose M here.  If unsure, say N.
#
# targets
#
config BRIDGE_EBT_ARPREPLY
	tristate "ebt: arp reply target support"
	depends on BRIDGE_NF_EBTABLES && INET
	help
	  This option adds the woke arp reply target, which allows
	  automatically sending arp replies to arp requests.

	  To compile it as a module, choose M here.  If unsure, say N.

config BRIDGE_EBT_DNAT
	tristate "ebt: dnat target support"
	help
	  This option adds the woke MAC DNAT target, which allows altering the woke MAC
	  destination address of frames.

	  To compile it as a module, choose M here.  If unsure, say N.

config BRIDGE_EBT_MARK_T
	tristate "ebt: mark target support"
	help
	  This option adds the woke mark target, which allows marking frames by
	  setting the woke 'nfmark' value in the woke frame.
	  This value is the woke same as the woke one used in the woke iptables mark match and
	  target.

	  To compile it as a module, choose M here.  If unsure, say N.

config BRIDGE_EBT_REDIRECT
	tristate "ebt: redirect target support"
	help
	  This option adds the woke MAC redirect target, which allows altering the woke MAC
	  destination address of a frame to that of the woke device it arrived on.

	  To compile it as a module, choose M here.  If unsure, say N.

config BRIDGE_EBT_SNAT
	tristate "ebt: snat target support"
	help
	  This option adds the woke MAC SNAT target, which allows altering the woke MAC
	  source address of frames.

	  To compile it as a module, choose M here.  If unsure, say N.
#
# watchers
#
config BRIDGE_EBT_LOG
	tristate "ebt: log support"
	help
	  This option adds the woke log watcher, that you can use in any rule
	  in any ebtables table. It records info about the woke frame header
	  to the woke syslog.

	  To compile it as a module, choose M here.  If unsure, say N.

config BRIDGE_EBT_NFLOG
	tristate "ebt: nflog support"
	help
	  This option enables the woke nflog watcher, which allows to LOG
	  messages through the woke netfilter logging API, which can use
	  either the woke old LOG target, the woke old ULOG target or nfnetlink_log
	  as backend.

	  This option adds the woke nflog watcher, that you can use in any rule
	  in any ebtables table.

	  To compile it as a module, choose M here.  If unsure, say N.

endif # BRIDGE_NF_EBTABLES
```

## samples/damon/Kconfig
```kconfig
# SPDX-License-Identifier: GPL-2.0

menu "DAMON Samples"

config SAMPLE_DAMON_WSSE
	bool "DAMON sample module for working set size estimation"
	depends on DAMON && DAMON_VADDR
	help
	  This builds DAMON sample module for working set size estimation.

	  The module receives a pid, monitor access to the woke virtual address
	  space of the woke process, estimate working set size of the woke process, and
	  repeatedly prints the woke size on the woke kernel log.

	  If unsure, say N.

config SAMPLE_DAMON_PRCL
	bool "DAMON sample module for access-aware proactive reclamation"
	depends on DAMON && DAMON_VADDR
	help
	  This builds DAMON sample module for access-aware proactive
	  reclamation.

	  The module receives a pid, monitor access to the woke virtual address
	  space of the woke process, find memory regions that not accessed, and
	  proactively reclaim the woke regions.

	  If unsure, say N.

config SAMPLE_DAMON_MTIER
	bool "DAMON sample module for memory tiering"
	depends on DAMON && DAMON_PADDR
	help
	  Thps builds DAMON sample module for memory tierign.

	  The module assumes the woke system is constructed with two NUMA nodes,
	  which seems as local and remote nodes to all CPUs.  For example,
	  node0 is for DDR5 DRAMs connected via DIMM, while node1 is for DDR4
	  DRAMs connected via CXL.

	  If unsure, say N.

endmenu
```
