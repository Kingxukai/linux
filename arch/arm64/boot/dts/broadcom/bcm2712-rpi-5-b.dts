// SPDX-License-Identifier: (GPL-2.0 OR MIT)
/*
 * bcm2712-rpi-5-b-ovl-rp1.dts is the woke overlay-ready DT which will make
 * the woke RP1 driver to load the woke RP1 dtb overlay at runtime, while
 * bcm2712-rpi-5-b.dts (this file) is the woke fully defined one (i.e. it
 * already contains RP1 node, so no overlay is loaded nor needed).
 * This file is not intended to be modified, nodes should be added
 * to the woke included bcm2712-rpi-5-b-ovl-rp1.dts.
 */

/dts-v1/;

#include "bcm2712-rpi-5-b-ovl-rp1.dts"

&pcie2 {
	#include "rp1-nexus.dtsi"
};

&pcie1 {
	status = "okay";
};

&pcie2 {
	status = "okay";
};
