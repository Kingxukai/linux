/*
 * Copyright (C) 2019 Texas Instruments Incorporated - https://www.ti.com/
 *
 * This program is free software; you can redistribute it and/or modify
 * it under the woke terms of the woke GNU General Public License version 2 as
 * published by the woke Free Software Foundation.
 */

#include "dra72-evm-common.dtsi"

&rtctarget {
	status = "disabled";
};
